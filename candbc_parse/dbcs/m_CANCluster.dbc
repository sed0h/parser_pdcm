VERSION "created by canmatrix"

NS_ :

BS_:

BU_: FVCM

BO_ 264 FVCM_Obj03_B: 64 FVCM
 SG_ OD_03_B_Head_CRC : 0|16@1+ (1,0) [0|65535] "" Vector__XXX
 SG_ OD_03_B_Head_ALIVE : 16|8@1+ (1,0) [0|255] "" Vector__XXX
 SG_ Obj_03_Id_B : 24|8@1+ (1,0) [0|255] "" Vector__XXX
 SG_ Obj_03_SyncCounter_B : 32|8@1+ (1,0) [0|255] "" Vector__XXX
 SG_ Obj_03_AbsLongVelocity : 40|12@1+ (0.05,-100) [-100.00|104.75] "m/s" Vector__XXX
 SG_ Obj_03_AbsLongVelocityV : 52|1@1+ (1,0) [0|1] "" Vector__XXX
 SG_ Obj_03_AbsLongVelocitySTD : 53|13@1+ (0.01,0) [0.00|81.91] "m/s" Vector__XXX
 SG_ Obj_03_AbsLongVelSTDV : 66|1@1+ (1,0) [0|1] "" Vector__XXX
 SG_ Obj_03_AbsLatVelocity : 67|11@1+ (0.05,-50) [-50.00|52.35] "m/s" Vector__XXX
 SG_ Obj_03_AbsLatVelocityV : 78|1@1+ (1,0) [0|1] "" Vector__XXX
 SG_ Obj_03_AbsLatVelocitySTD : 79|13@1+ (0.01,0) [0.00|81.91] "m/s" Vector__XXX
 SG_ Obj_03_AbsLatVelSTDV : 92|1@1+ (1,0) [0|1] "" Vector__XXX
 SG_ Obj_03_AbsLongAcc : 93|9@1+ (0.05,-10) [-10.00|15.55] "m/s²" Vector__XXX
 SG_ Obj_03_AbsLongAccV : 102|1@1+ (1,0) [0|1] "" Vector__XXX
 SG_ Obj_03_AbsLongAccSTD : 103|10@1+ (0.01,0) [0.00|10.23] "m/s²" Vector__XXX
 SG_ Obj_03_AbsLongAccSTDV : 113|1@1+ (1,0) [0|1] "" Vector__XXX
 SG_ Obj_03_AbsLatAcc : 114|9@1+ (0.05,-10) [-10.00|15.55] "m/s²" Vector__XXX
 SG_ Obj_03_AbsLatAccV : 123|1@1+ (1,0) [0|1] "" Vector__XXX
 SG_ Obj_03_AbsLatAccSTD : 124|10@1+ (0.01,0) [0.00|10.23] "m/s²" Vector__XXX
 SG_ Obj_03_AbsLatAccSTDV : 134|1@1+ (1,0) [0|1] "" Vector__XXX
 SG_ Obj_03_AbsAcceleration : 135|9@1+ (0.05,-12.7) [-12.70|12.85] "m/s²" Vector__XXX
 SG_ Obj_03_AbsAccelerationV : 144|1@1+ (1,0) [0|1] "" Vector__XXX
 SG_ Obj_03_AbsAccSTD : 145|10@1+ (0.01,0) [0.00|10.23] "m/s²" Vector__XXX
 SG_ Obj_03_AbsAccSTDV : 155|1@1+ (1,0) [0|1] "" Vector__XXX
 SG_ Obj_03_InvTTC : 156|11@1+ (0.01,-8) [-8.00|12.47] "1/s" Vector__XXX
 SG_ Obj_03_InvTTCV : 167|1@1+ (1,0) [0|1] "" Vector__XXX
 SG_ Obj_03_InvTTCSTD : 168|12@1+ (0.001,0) [0.000|4.095] "1/s" Vector__XXX
 SG_ Obj_03_InvTTCSTDV : 180|1@1+ (1,0) [0|1] "" Vector__XXX
 SG_ Obj_03_RelativeLongAcc : 181|10@1+ (0.05,-20) [-20.00|31.15] "m/s²" Vector__XXX
 SG_ Obj_03_RelativeLongAccV : 191|1@1+ (1,0) [0|1] "" Vector__XXX
 SG_ Obj_03_RelativeLongAccSTD : 192|10@1+ (0.01,0) [0.00|10.23] "m/s²" Vector__XXX
 SG_ Obj_03_RelLongAccSTDV : 202|1@1+ (1,0) [0|1] "" Vector__XXX
 SG_ Obj_03_LongtRltvSpd : 203|13@1+ (0.05,-120) [-120.00|289.55] "m/s" Vector__XXX
 SG_ Obj_03_LongtRltvSpdV : 216|1@1+ (1,0) [0|1] "" Vector__XXX
 SG_ Obj_03_LongtRltvSpdSTD : 217|14@1+ (0.01,0) [0.00|163.83] "m/s" Vector__XXX
 SG_ Obj_03_LongtRltvSpdSTDV : 231|1@1+ (1,0) [0|1] "" Vector__XXX
 SG_ Obj_03_RelativeLatVelocity : 232|11@1+ (0.05,-50) [-50.00|52.35] "m/s" Vector__XXX
 SG_ Obj_03_RelativeLatVelocityV : 243|1@1+ (1,0) [0|1] "" Vector__XXX
 SG_ Obj_03_RelativeLatVelocitySTD : 244|13@1+ (0.01,0) [0.00|81.91] "m/s" Vector__XXX
 SG_ Obj_03_RelLatVelSTDV : 257|1@1+ (1,0) [0|1] "" Vector__XXX
 SG_ Obj_03_LongtRltvDist : 258|14@1+ (0.05,-200) [-200.00|619.15] "m" Vector__XXX
 SG_ Obj_03_LongDistanceV : 272|1@1+ (1,0) [0|1] "" Vector__XXX
 SG_ Obj_03_LongDistanceSTD : 273|15@1+ (0.01,0) [0.00|327.67] "m" Vector__XXX
 SG_ Obj_03_LongDistanceSTDV : 288|1@1+ (1,0) [0|1] "" Vector__XXX
 SG_ Obj_03_LatRltvDist : 289|12@1+ (0.05,-100) [-100.00|104.75] "m" Vector__XXX
 SG_ Obj_03_LatDistanceV : 301|1@1+ (1,0) [0|1] "" Vector__XXX
 SG_ Obj_03_LatDistanceSTD : 302|14@1+ (0.01,0) [0.00|163.83] "m" Vector__XXX
 SG_ Obj_03_LatDistanceSTDV : 316|1@1+ (1,0) [0|1] "" Vector__XXX
 SG_ Obj_03_AbsoluteSpeed : 317|12@1+ (0.05,-65) [-65.00|139.75] "m/s" Vector__XXX
 SG_ Obj_03_AbsoluteSpeedV : 329|1@1+ (1,0) [0|1] "" Vector__XXX
 SG_ Obj_03_AbsoluteSpeedSTD : 330|13@1+ (0.01,0) [0.00|81.91] "m/s" Vector__XXX
 SG_ Obj_03_AbsoluteSpeedSTDV : 343|1@1+ (1,0) [0|1] "" Vector__XXX

BO_ 265 FVCM_Obj04_A: 64 FVCM
 SG_ OD_04_A_Head_CRC : 0|16@1+ (1,0) [0|65535] "" Vector__XXX
 SG_ OD_04_A_Head_ALIVE : 16|8@1+ (1,0) [0|255] "" Vector__XXX
 SG_ Obj_04_Id_A : 24|8@1+ (1,0) [0|255] "" Vector__XXX
 SG_ Obj_04_SyncCounter_A : 32|8@1+ (1,0) [0|255] "" Vector__XXX
 SG_ Obj_04_ExistPrblty : 40|8@1+ (0.01,0) [0.00|2.55] "" Vector__XXX
 SG_ Obj_04_MotionCategory : 48|4@1+ (1,0) [0|15] "" Vector__XXX
 SG_ Obj_04_Age : 52|11@1+ (1,0) [0|2047] "" Vector__XXX
 SG_ Obj_04_MeasSts : 63|3@1+ (1,0) [0|7] "" Vector__XXX
 SG_ Obj_04_Typ : 66|4@1+ (1,0) [0|15] "" Vector__XXX
 SG_ Obj_04_ClassProbability : 70|7@1+ (0.01,0) [0.00|1.27] "" Vector__XXX
 SG_ Obj_04_MotionSts : 77|3@1+ (1,0) [0|7] "" Vector__XXX
 SG_ Obj_04_MotionOrientation : 80|4@1+ (1,0) [0|15] "" Vector__XXX
 SG_ Obj_04_BrakeLight : 84|1@1+ (1,0) [0|1] "" Vector__XXX
 SG_ Obj_04_TurnIndicatorRight : 85|1@1+ (1,0) [0|1] "" Vector__XXX
 SG_ Obj_04_TurnIndicatorLeft : 86|1@1+ (1,0) [0|1] "" Vector__XXX
 SG_ Obj_04_LightIndicatorValidity : 87|1@1+ (1,0) [0|1] "" Vector__XXX
 SG_ Obj_04_LaneAssignment : 88|3@1+ (1,0) [0|7] "" Vector__XXX
 SG_ Obj_04_LaneAssignmentV : 91|1@1+ (1,0) [0|1] "" Vector__XXX
 SG_ Obj_04_Width : 92|9@1+ (0.01,0.4) [0.40|5.51] "m" Vector__XXX
 SG_ Obj_04_WidthV : 101|1@1+ (1,0) [0|1] "" Vector__XXX
 SG_ Obj_04_WidthSTD : 102|11@1+ (0.001,0) [0.000|2.047] "m" Vector__XXX
 SG_ Obj_04_WidthSTDV : 113|1@1+ (1,0) [0|1] "" Vector__XXX
 SG_ Obj_04_Length : 114|9@1+ (0.05,1.2) [1.20|26.75] "m" Vector__XXX
 SG_ Obj_04_LengthV : 123|1@1+ (1,0) [0|1] "" Vector__XXX
 SG_ Obj_04_LengthSTD : 124|10@1+ (0.01,0) [0.00|10.23] "m" Vector__XXX
 SG_ Obj_04_LengthSTDV : 134|1@1+ (1,0) [0|1] "" Vector__XXX
 SG_ Obj_04_RadarID : 135|8@1+ (1,0) [0|255] "" Vector__XXX
 SG_ Obj_04_Height : 143|9@1+ (0.01,0) [0.00|5.11] "m" Vector__XXX
 SG_ Obj_04_HeightV : 152|1@1+ (1,0) [0|1] "" Vector__XXX
 SG_ Obj_04_HeightSTD : 153|11@1+ (0.001,0) [0.000|2.047] "m" Vector__XXX
 SG_ Obj_04_HeightSTDV : 164|1@1+ (1,0) [0|1] "" Vector__XXX
 SG_ Obj_04_Heading : 165|10@1+ (0.01,-3.14) [-3.14|7.09] "rad" Vector__XXX
 SG_ Obj_04_HeadingV : 175|1@1+ (1,0) [0|1] "" Vector__XXX
 SG_ Obj_04_HeadingSTD : 176|15@1+ (0.00010,0) [0.00000|3.27670] "rad" Vector__XXX
 SG_ Obj_04_HeadingSTDV : 191|1@1+ (1,0) [0|1] "" Vector__XXX
 SG_ Obj_04_AngleRateSTD : 192|15@1+ (0.00010,0) [0.00000|3.27670] "RPS" Vector__XXX
 SG_ Obj_04_AngleRateSTDV : 207|1@1+ (1,0) [0|1] "" Vector__XXX
 SG_ Obj_04_AngleRate : 208|12@1+ (0.002,-2.234) [-2.234|5.956] "RPS" Vector__XXX
 SG_ Obj_04_AngleRateV : 220|1@1+ (1,0) [0|1] "" Vector__XXX
 SG_ Obj_04_AngleRight : 221|14@1+ (0.00020,-1.571) [-1.57100|1.70560] "rad" Vector__XXX
 SG_ Obj_04_AngleRightV : 235|1@1+ (1,0) [0|1] "" Vector__XXX
 SG_ Obj_04_AngleRightSTD : 236|14@1+ (0.00010,0) [0.00000|1.63830] "rad" Vector__XXX
 SG_ Obj_04_AngleRightSTDV : 250|1@1+ (1,0) [0|1] "" Vector__XXX
 SG_ Obj_04_AngleLeft : 251|14@1+ (0.00020,-1.571) [-1.57100|1.70560] "rad" Vector__XXX
 SG_ Obj_04_AngleLeftV : 265|1@1+ (1,0) [0|1] "" Vector__XXX
 SG_ Obj_04_AngleLeftSTD : 266|14@1+ (0.00010,0) [0.00000|1.63830] "rad" Vector__XXX
 SG_ Obj_04_AngleLeftSTDV : 280|1@1+ (1,0) [0|1] "" Vector__XXX
 SG_ Obj_04_AngleSide : 281|14@1+ (0.00020,-1.571) [-1.57100|1.70560] "rad" Vector__XXX
 SG_ Obj_04_AngleSideV : 295|1@1+ (1,0) [0|1] "" Vector__XXX
 SG_ Obj_04_AngleSideSTD : 296|14@1+ (0.00010,0) [0.00000|1.63830] "rad" Vector__XXX
 SG_ Obj_04_AngleSideSTDV : 310|1@1+ (1,0) [0|1] "" Vector__XXX
 SG_ Obj_04_AngleBottomV : 311|1@1+ (1,0) [0|1] "" Vector__XXX
 SG_ Obj_04_AngleBottom : 312|14@1+ (0.00020,-1.571) [-1.57100|1.70560] "rad" Vector__XXX
 SG_ Obj_04_AngleBottomSTD : 326|14@1+ (0.00010,0) [0.00000|1.63830] "rad" Vector__XXX
 SG_ Obj_04_AngleBottomSTDV : 340|1@1+ (1,0) [0|1] "" Vector__XXX

BO_ 266 FVCM_Obj04_B: 64 FVCM
 SG_ OD_04_B_Head_CRC : 0|16@1+ (1,0) [0|65535] "" Vector__XXX
 SG_ OD_04_B_Head_ALIVE : 16|8@1+ (1,0) [0|255] "" Vector__XXX
 SG_ Obj_04_Id_B : 24|8@1+ (1,0) [0|255] "" Vector__XXX
 SG_ Obj_04_SyncCounter_B : 32|8@1+ (1,0) [0|255] "" Vector__XXX
 SG_ Obj_04_AbsLongVelocity : 40|12@1+ (0.05,-100) [-100.00|104.75] "m/s" Vector__XXX
 SG_ Obj_04_AbsLongVelocityV : 52|1@1+ (1,0) [0|1] "" Vector__XXX
 SG_ Obj_04_AbsLongVelocitySTD : 53|13@1+ (0.01,0) [0.00|81.91] "m/s" Vector__XXX
 SG_ Obj_04_AbsLongVelSTDV : 66|1@1+ (1,0) [0|1] "" Vector__XXX
 SG_ Obj_04_AbsLatVelocity : 67|11@1+ (0.05,-50) [-50.00|52.35] "m/s" Vector__XXX
 SG_ Obj_04_AbsLatVelocityV : 78|1@1+ (1,0) [0|1] "" Vector__XXX
 SG_ Obj_04_AbsLatVelocitySTD : 79|13@1+ (0.01,0) [0.00|81.91] "m/s" Vector__XXX
 SG_ Obj_04_AbsLatVelSTDV : 92|1@1+ (1,0) [0|1] "" Vector__XXX
 SG_ Obj_04_AbsLongAcc : 93|9@1+ (0.05,-10) [-10.00|15.55] "m/s²" Vector__XXX
 SG_ Obj_04_AbsLongAccV : 102|1@1+ (1,0) [0|1] "" Vector__XXX
 SG_ Obj_04_AbsLongAccSTD : 103|10@1+ (0.01,0) [0.00|10.23] "m/s²" Vector__XXX
 SG_ Obj_04_AbsLongAccSTDV : 113|1@1+ (1,0) [0|1] "" Vector__XXX
 SG_ Obj_04_AbsLatAcc : 114|9@1+ (0.05,-10) [-10.00|15.55] "m/s²" Vector__XXX
 SG_ Obj_04_AbsLatAccV : 123|1@1+ (1,0) [0|1] "" Vector__XXX
 SG_ Obj_04_AbsLatAccSTD : 124|10@1+ (0.01,0) [0.00|10.23] "m/s²" Vector__XXX
 SG_ Obj_04_AbsLatAccSTDV : 134|1@1+ (1,0) [0|1] "" Vector__XXX
 SG_ Obj_04_AbsAcceleration : 135|9@1+ (0.05,-12.7) [-12.70|12.85] "m/s²" Vector__XXX
 SG_ Obj_04_AbsAccelerationV : 144|1@1+ (1,0) [0|1] "" Vector__XXX
 SG_ Obj_04_AbsAccSTD : 145|10@1+ (0.01,0) [0.00|10.23] "m/s²" Vector__XXX
 SG_ Obj_04_AbsAccSTDV : 155|1@1+ (1,0) [0|1] "" Vector__XXX
 SG_ Obj_04_InvTTC : 156|11@1+ (0.01,-8) [-8.00|12.47] "1/s" Vector__XXX
 SG_ Obj_04_InvTTCV : 167|1@1+ (1,0) [0|1] "" Vector__XXX
 SG_ Obj_04_InvTTCSTD : 168|12@1+ (0.001,0) [0.000|4.095] "1/s" Vector__XXX
 SG_ Obj_04_InvTTCSTDV : 180|1@1+ (1,0) [0|1] "" Vector__XXX
 SG_ Obj_04_RelativeLongAcc : 181|10@1+ (0.05,-20) [-20.00|31.15] "m/s²" Vector__XXX
 SG_ Obj_04_RelativeLongAccV : 191|1@1+ (1,0) [0|1] "" Vector__XXX
 SG_ Obj_04_RelativeLongAccSTD : 192|10@1+ (0.01,0) [0.00|10.23] "m/s²" Vector__XXX
 SG_ Obj_04_RelLongAccSTDV : 202|1@1+ (1,0) [0|1] "" Vector__XXX
 SG_ Obj_04_LongtRltvSpd : 203|13@1+ (0.05,-120) [-120.00|289.55] "m/s" Vector__XXX
 SG_ Obj_04_LongtRltvSpdV : 216|1@1+ (1,0) [0|1] "" Vector__XXX
 SG_ Obj_04_LongtRltvSpdSTD : 217|14@1+ (0.01,0) [0.00|163.83] "m/s" Vector__XXX
 SG_ Obj_04_LongtRltvSpdSTDV : 231|1@1+ (1,0) [0|1] "" Vector__XXX
 SG_ Obj_04_RelativeLatVelocity : 232|11@1+ (0.05,-50) [-50.00|52.35] "m/s" Vector__XXX
 SG_ Obj_04_RelativeLatVelocityV : 243|1@1+ (1,0) [0|1] "" Vector__XXX
 SG_ Obj_04_RelativeLatVelocitySTD : 244|13@1+ (0.01,0) [0.00|81.91] "m/s" Vector__XXX
 SG_ Obj_04_RelLatVelSTDV : 257|1@1+ (1,0) [0|1] "" Vector__XXX
 SG_ Obj_04_LongtRltvDist : 258|14@1+ (0.05,-200) [-200.00|619.15] "m" Vector__XXX
 SG_ Obj_04_LongDistanceV : 272|1@1+ (1,0) [0|1] "" Vector__XXX
 SG_ Obj_04_LongDistanceSTD : 273|15@1+ (0.01,0) [0.00|327.67] "m" Vector__XXX
 SG_ Obj_04_LongDistanceSTDV : 288|1@1+ (1,0) [0|1] "" Vector__XXX
 SG_ Obj_04_LatRltvDist : 289|12@1+ (0.05,-100) [-100.00|104.75] "m" Vector__XXX
 SG_ Obj_04_LatDistanceV : 301|1@1+ (1,0) [0|1] "" Vector__XXX
 SG_ Obj_04_LatDistanceSTD : 302|14@1+ (0.01,0) [0.00|163.83] "m" Vector__XXX
 SG_ Obj_04_LatDistanceSTDV : 316|1@1+ (1,0) [0|1] "" Vector__XXX
 SG_ Obj_04_AbsoluteSpeed : 317|12@1+ (0.05,-65) [-65.00|139.75] "m/s" Vector__XXX
 SG_ Obj_04_AbsoluteSpeedV : 329|1@1+ (1,0) [0|1] "" Vector__XXX
 SG_ Obj_04_AbsoluteSpeedSTD : 330|13@1+ (0.01,0) [0.00|81.91] "m/s" Vector__XXX
 SG_ Obj_04_AbsoluteSpeedSTDV : 343|1@1+ (1,0) [0|1] "" Vector__XXX

BO_ 267 FVCM_Obj05_A: 64 FVCM
 SG_ OD_05_A_Head_CRC : 0|16@1+ (1,0) [0|65535] "" Vector__XXX
 SG_ OD_05_A_Head_ALIVE : 16|8@1+ (1,0) [0|255] "" Vector__XXX
 SG_ Obj_05_Id_A : 24|8@1+ (1,0) [0|255] "" Vector__XXX
 SG_ Obj_05_SyncCounter_A : 32|8@1+ (1,0) [0|255] "" Vector__XXX
 SG_ Obj_05_ExistPrblty : 40|8@1+ (0.01,0) [0.00|2.55] "" Vector__XXX
 SG_ Obj_05_MotionCategory : 48|4@1+ (1,0) [0|15] "" Vector__XXX
 SG_ Obj_05_Age : 52|11@1+ (1,0) [0|2047] "" Vector__XXX
 SG_ Obj_05_MeasSts : 63|3@1+ (1,0) [0|7] "" Vector__XXX
 SG_ Obj_05_Typ : 66|4@1+ (1,0) [0|15] "" Vector__XXX
 SG_ Obj_05_ClassProbability : 70|7@1+ (0.01,0) [0.00|1.27] "" Vector__XXX
 SG_ Obj_05_MotionSts : 77|3@1+ (1,0) [0|7] "" Vector__XXX
 SG_ Obj_05_MotionOrientation : 80|4@1+ (1,0) [0|15] "" Vector__XXX
 SG_ Obj_05_BrakeLight : 84|1@1+ (1,0) [0|1] "" Vector__XXX
 SG_ Obj_05_TurnIndicatorRight : 85|1@1+ (1,0) [0|1] "" Vector__XXX
 SG_ Obj_05_TurnIndicatorLeft : 86|1@1+ (1,0) [0|1] "" Vector__XXX
 SG_ Obj_05_LightIndicatorValidity : 87|1@1+ (1,0) [0|1] "" Vector__XXX
 SG_ Obj_05_LaneAssignment : 88|3@1+ (1,0) [0|7] "" Vector__XXX
 SG_ Obj_05_LaneAssignmentV : 91|1@1+ (1,0) [0|1] "" Vector__XXX
 SG_ Obj_05_Width : 92|9@1+ (0.01,0.4) [0.40|5.51] "m" Vector__XXX
 SG_ Obj_05_WidthV : 101|1@1+ (1,0) [0|1] "" Vector__XXX
 SG_ Obj_05_WidthSTD : 102|11@1+ (0.001,0) [0.000|2.047] "m" Vector__XXX
 SG_ Obj_05_WidthSTDV : 113|1@1+ (1,0) [0|1] "" Vector__XXX
 SG_ Obj_05_Length : 114|9@1+ (0.05,1.2) [1.20|26.75] "m" Vector__XXX
 SG_ Obj_05_LengthV : 123|1@1+ (1,0) [0|1] "" Vector__XXX
 SG_ Obj_05_LengthSTD : 124|10@1+ (0.01,0) [0.00|10.23] "m" Vector__XXX
 SG_ Obj_05_LengthSTDV : 134|1@1+ (1,0) [0|1] "" Vector__XXX
 SG_ Obj_05_RadarID : 135|8@1+ (1,0) [0|255] "" Vector__XXX
 SG_ Obj_05_Height : 143|9@1+ (0.01,0) [0.00|5.11] "m" Vector__XXX
 SG_ Obj_05_HeightV : 152|1@1+ (1,0) [0|1] "" Vector__XXX
 SG_ Obj_05_HeightSTD : 153|11@1+ (0.001,0) [0.000|2.047] "m" Vector__XXX
 SG_ Obj_05_HeightSTDV : 164|1@1+ (1,0) [0|1] "" Vector__XXX
 SG_ Obj_05_Heading : 165|10@1+ (0.01,-3.14) [-3.14|7.09] "rad" Vector__XXX
 SG_ Obj_05_HeadingV : 175|1@1+ (1,0) [0|1] "" Vector__XXX
 SG_ Obj_05_HeadingSTD : 176|15@1+ (0.00010,0) [0.00000|3.27670] "rad" Vector__XXX
 SG_ Obj_05_HeadingSTDV : 191|1@1+ (1,0) [0|1] "" Vector__XXX
 SG_ Obj_05_AngleRateSTD : 192|15@1+ (0.00010,0) [0.00000|3.27670] "RPS" Vector__XXX
 SG_ Obj_05_AngleRateSTDV : 207|1@1+ (1,0) [0|1] "" Vector__XXX
 SG_ Obj_05_AngleRate : 208|12@1+ (0.002,-2.234) [-2.234|5.956] "RPS" Vector__XXX
 SG_ Obj_05_AngleRateV : 220|1@1+ (1,0) [0|1] "" Vector__XXX
 SG_ Obj_05_AngleRight : 221|14@1+ (0.00020,-1.571) [-1.57100|1.70560] "rad" Vector__XXX
 SG_ Obj_05_AngleRightV : 235|1@1+ (1,0) [0|1] "" Vector__XXX
 SG_ Obj_05_AngleRightSTD : 236|14@1+ (0.00010,0) [0.00000|1.63830] "rad" Vector__XXX
 SG_ Obj_05_AngleRightSTDV : 250|1@1+ (1,0) [0|1] "" Vector__XXX
 SG_ Obj_05_AngleLeft : 251|14@1+ (0.00020,-1.571) [-1.57100|1.70560] "rad" Vector__XXX
 SG_ Obj_05_AngleLeftV : 265|1@1+ (1,0) [0|1] "" Vector__XXX
 SG_ Obj_05_AngleLeftSTD : 266|14@1+ (0.00010,0) [0.00000|1.63830] "rad" Vector__XXX
 SG_ Obj_05_AngleLeftSTDV : 280|1@1+ (1,0) [0|1] "" Vector__XXX
 SG_ Obj_05_AngleSide : 281|14@1+ (0.00020,-1.571) [-1.57100|1.70560] "rad" Vector__XXX
 SG_ Obj_05_AngleSideV : 295|1@1+ (1,0) [0|1] "" Vector__XXX
 SG_ Obj_05_AngleSideSTD : 296|14@1+ (0.00010,0) [0.00000|1.63830] "rad" Vector__XXX
 SG_ Obj_05_AngleSideSTDV : 310|1@1+ (1,0) [0|1] "" Vector__XXX
 SG_ Obj_05_AngleBottomV : 311|1@1+ (1,0) [0|1] "" Vector__XXX
 SG_ Obj_05_AngleBottom : 312|14@1+ (0.00020,-1.571) [-1.57100|1.70560] "rad" Vector__XXX
 SG_ Obj_05_AngleBottomSTD : 326|14@1+ (0.00010,0) [0.00000|1.63830] "rad" Vector__XXX
 SG_ Obj_05_AngleBottomSTDV : 340|1@1+ (1,0) [0|1] "" Vector__XXX

BO_ 268 FVCM_Obj05_B: 64 FVCM
 SG_ OD_05_B_Head_CRC : 0|16@1+ (1,0) [0|65535] "" Vector__XXX
 SG_ OD_05_B_Head_ALIVE : 16|8@1+ (1,0) [0|255] "" Vector__XXX
 SG_ Obj_05_Id_B : 24|8@1+ (1,0) [0|255] "" Vector__XXX
 SG_ Obj_05_SyncCounter_B : 32|8@1+ (1,0) [0|255] "" Vector__XXX
 SG_ Obj_05_AbsLongVelocity : 40|12@1+ (0.05,-100) [-100.00|104.75] "m/s" Vector__XXX
 SG_ Obj_05_AbsLongVelocityV : 52|1@1+ (1,0) [0|1] "" Vector__XXX
 SG_ Obj_05_AbsLongVelocitySTD : 53|13@1+ (0.01,0) [0.00|81.91] "m/s" Vector__XXX
 SG_ Obj_05_AbsLongVelSTDV : 66|1@1+ (1,0) [0|1] "" Vector__XXX
 SG_ Obj_05_AbsLatVelocity : 67|11@1+ (0.05,-50) [-50.00|52.35] "m/s" Vector__XXX
 SG_ Obj_05_AbsLatVelocityV : 78|1@1+ (1,0) [0|1] "" Vector__XXX
 SG_ Obj_05_AbsLatVelocitySTD : 79|13@1+ (0.01,0) [0.00|81.91] "m/s" Vector__XXX
 SG_ Obj_05_AbsLatVelSTDV : 92|1@1+ (1,0) [0|1] "" Vector__XXX
 SG_ Obj_05_AbsLongAcc : 93|9@1+ (0.05,-10) [-10.00|15.55] "m/s²" Vector__XXX
 SG_ Obj_05_AbsLongAccV : 102|1@1+ (1,0) [0|1] "" Vector__XXX
 SG_ Obj_05_AbsLongAccSTD : 103|10@1+ (0.01,0) [0.00|10.23] "m/s²" Vector__XXX
 SG_ Obj_05_AbsLongAccSTDV : 113|1@1+ (1,0) [0|1] "" Vector__XXX
 SG_ Obj_05_AbsLatAcc : 114|9@1+ (0.05,-10) [-10.00|15.55] "m/s²" Vector__XXX
 SG_ Obj_05_AbsLatAccV : 123|1@1+ (1,0) [0|1] "" Vector__XXX
 SG_ Obj_05_AbsLatAccSTD : 124|10@1+ (0.01,0) [0.00|10.23] "m/s²" Vector__XXX
 SG_ Obj_05_AbsLatAccSTDV : 134|1@1+ (1,0) [0|1] "" Vector__XXX
 SG_ Obj_05_AbsAcceleration : 135|9@1+ (0.05,-12.7) [-12.70|12.85] "m/s²" Vector__XXX
 SG_ Obj_05_AbsAccelerationV : 144|1@1+ (1,0) [0|1] "" Vector__XXX
 SG_ Obj_05_AbsAccSTD : 145|10@1+ (0.01,0) [0.00|10.23] "m/s²" Vector__XXX
 SG_ Obj_05_AbsAccSTDV : 155|1@1+ (1,0) [0|1] "" Vector__XXX
 SG_ Obj_05_InvTTC : 156|11@1+ (0.01,-8) [-8.00|12.47] "1/s" Vector__XXX
 SG_ Obj_05_InvTTCV : 167|1@1+ (1,0) [0|1] "" Vector__XXX
 SG_ Obj_05_InvTTCSTD : 168|12@1+ (0.001,0) [0.000|4.095] "1/s" Vector__XXX
 SG_ Obj_05_InvTTCSTDV : 180|1@1+ (1,0) [0|1] "" Vector__XXX
 SG_ Obj_05_RelativeLongAcc : 181|10@1+ (0.05,-20) [-20.00|31.15] "m/s²" Vector__XXX
 SG_ Obj_05_RelativeLongAccV : 191|1@1+ (1,0) [0|1] "" Vector__XXX
 SG_ Obj_05_RelativeLongAccSTD : 192|10@1+ (0.01,0) [0.00|10.23] "m/s²" Vector__XXX
 SG_ Obj_05_RelLongAccSTDV : 202|1@1+ (1,0) [0|1] "" Vector__XXX
 SG_ Obj_05_LongtRltvSpd : 203|13@1+ (0.05,-120) [-120.00|289.55] "m/s" Vector__XXX
 SG_ Obj_05_LongtRltvSpdV : 216|1@1+ (1,0) [0|1] "" Vector__XXX
 SG_ Obj_05_LongtRltvSpdSTD : 217|14@1+ (0.01,0) [0.00|163.83] "m/s" Vector__XXX
 SG_ Obj_05_LongtRltvSpdSTDV : 231|1@1+ (1,0) [0|1] "" Vector__XXX
 SG_ Obj_05_RelativeLatVelocity : 232|11@1+ (0.05,-50) [-50.00|52.35] "m/s" Vector__XXX
 SG_ Obj_05_RelativeLatVelocityV : 243|1@1+ (1,0) [0|1] "" Vector__XXX
 SG_ Obj_05_RelativeLatVelocitySTD : 244|13@1+ (0.01,0) [0.00|81.91] "m/s" Vector__XXX
 SG_ Obj_05_RelLatVelSTDV : 257|1@1+ (1,0) [0|1] "" Vector__XXX
 SG_ Obj_05_LongtRltvDist : 258|14@1+ (0.05,-200) [-200.00|619.15] "m" Vector__XXX
 SG_ Obj_05_LongDistanceV : 272|1@1+ (1,0) [0|1] "" Vector__XXX
 SG_ Obj_05_LongDistanceSTD : 273|15@1+ (0.01,0) [0.00|327.67] "m" Vector__XXX
 SG_ Obj_05_LongDistanceSTDV : 288|1@1+ (1,0) [0|1] "" Vector__XXX
 SG_ Obj_05_LatRltvDist : 289|12@1+ (0.05,-100) [-100.00|104.75] "m" Vector__XXX
 SG_ Obj_05_LatDistanceV : 301|1@1+ (1,0) [0|1] "" Vector__XXX
 SG_ Obj_05_LatDistanceSTD : 302|14@1+ (0.01,0) [0.00|163.83] "m" Vector__XXX
 SG_ Obj_05_LatDistanceSTDV : 316|1@1+ (1,0) [0|1] "" Vector__XXX
 SG_ Obj_05_AbsoluteSpeed : 317|12@1+ (0.05,-65) [-65.00|139.75] "m/s" Vector__XXX
 SG_ Obj_05_AbsoluteSpeedV : 329|1@1+ (1,0) [0|1] "" Vector__XXX
 SG_ Obj_05_AbsoluteSpeedSTD : 330|13@1+ (0.01,0) [0.00|81.91] "m/s" Vector__XXX
 SG_ Obj_05_AbsoluteSpeedSTDV : 343|1@1+ (1,0) [0|1] "" Vector__XXX

BO_ 269 FVCM_Obj06_A: 64 FVCM
 SG_ OD_06_A_Head_CRC : 0|16@1+ (1,0) [0|65535] "" Vector__XXX
 SG_ OD_06_A_Head_ALIVE : 16|8@1+ (1,0) [0|255] "" Vector__XXX
 SG_ Obj_06_Id_A : 24|8@1+ (1,0) [0|255] "" Vector__XXX
 SG_ Obj_06_SyncCounter_A : 32|8@1+ (1,0) [0|255] "" Vector__XXX
 SG_ Obj_06_ExistPrblty : 40|8@1+ (0.01,0) [0.00|2.55] "" Vector__XXX
 SG_ Obj_06_MotionCategory : 48|4@1+ (1,0) [0|15] "" Vector__XXX
 SG_ Obj_06_Age : 52|11@1+ (1,0) [0|2047] "" Vector__XXX
 SG_ Obj_06_MeasSts : 63|3@1+ (1,0) [0|7] "" Vector__XXX
 SG_ Obj_06_Typ : 66|4@1+ (1,0) [0|15] "" Vector__XXX
 SG_ Obj_06_ClassProbability : 70|7@1+ (0.01,0) [0.00|1.27] "" Vector__XXX
 SG_ Obj_06_MotionSts : 77|3@1+ (1,0) [0|7] "" Vector__XXX
 SG_ Obj_06_MotionOrientation : 80|4@1+ (1,0) [0|15] "" Vector__XXX
 SG_ Obj_06_BrakeLight : 84|1@1+ (1,0) [0|1] "" Vector__XXX
 SG_ Obj_06_TurnIndicatorRight : 85|1@1+ (1,0) [0|1] "" Vector__XXX
 SG_ Obj_06_TurnIndicatorLeft : 86|1@1+ (1,0) [0|1] "" Vector__XXX
 SG_ Obj_06_LightIndicatorValidity : 87|1@1+ (1,0) [0|1] "" Vector__XXX
 SG_ Obj_06_LaneAssignment : 88|3@1+ (1,0) [0|7] "" Vector__XXX
 SG_ Obj_06_LaneAssignmentV : 91|1@1+ (1,0) [0|1] "" Vector__XXX
 SG_ Obj_06_Width : 92|9@1+ (0.01,0.4) [0.40|5.51] "m" Vector__XXX
 SG_ Obj_06_WidthV : 101|1@1+ (1,0) [0|1] "" Vector__XXX
 SG_ Obj_06_WidthSTD : 102|11@1+ (0.001,0) [0.000|2.047] "m" Vector__XXX
 SG_ Obj_06_WidthSTDV : 113|1@1+ (1,0) [0|1] "" Vector__XXX
 SG_ Obj_06_Length : 114|9@1+ (0.05,1.2) [1.20|26.75] "m" Vector__XXX
 SG_ Obj_06_LengthV : 123|1@1+ (1,0) [0|1] "" Vector__XXX
 SG_ Obj_06_LengthSTD : 124|10@1+ (0.01,0) [0.00|10.23] "m" Vector__XXX
 SG_ Obj_06_LengthSTDV : 134|1@1+ (1,0) [0|1] "" Vector__XXX
 SG_ Obj_06_RadarID : 135|8@1+ (1,0) [0|255] "" Vector__XXX
 SG_ Obj_06_Height : 143|9@1+ (0.01,0) [0.00|5.11] "m" Vector__XXX
 SG_ Obj_06_HeightV : 152|1@1+ (1,0) [0|1] "" Vector__XXX
 SG_ Obj_06_HeightSTD : 153|11@1+ (0.001,0) [0.000|2.047] "m" Vector__XXX
 SG_ Obj_06_HeightSTDV : 164|1@1+ (1,0) [0|1] "" Vector__XXX
 SG_ Obj_06_Heading : 165|10@1+ (0.01,-3.14) [-3.14|7.09] "rad" Vector__XXX
 SG_ Obj_06_HeadingV : 175|1@1+ (1,0) [0|1] "" Vector__XXX
 SG_ Obj_06_HeadingSTD : 176|15@1+ (0.00010,0) [0.00000|3.27670] "rad" Vector__XXX
 SG_ Obj_06_HeadingSTDV : 191|1@1+ (1,0) [0|1] "" Vector__XXX
 SG_ Obj_06_AngleRateSTD : 192|15@1+ (0.00010,0) [0.00000|3.27670] "RPS" Vector__XXX
 SG_ Obj_06_AngleRateSTDV : 207|1@1+ (1,0) [0|1] "" Vector__XXX
 SG_ Obj_06_AngleRate : 208|12@1+ (0.002,-2.234) [-2.234|5.956] "RPS" Vector__XXX
 SG_ Obj_06_AngleRateV : 220|1@1+ (1,0) [0|1] "" Vector__XXX
 SG_ Obj_06_AngleRight : 221|14@1+ (0.00020,-1.571) [-1.57100|1.70560] "rad" Vector__XXX
 SG_ Obj_06_AngleRightV : 235|1@1+ (1,0) [0|1] "" Vector__XXX
 SG_ Obj_06_AngleRightSTD : 236|14@1+ (0.00010,0) [0.00000|1.63830] "rad" Vector__XXX
 SG_ Obj_06_AngleRightSTDV : 250|1@1+ (1,0) [0|1] "" Vector__XXX
 SG_ Obj_06_AngleLeft : 251|14@1+ (0.00020,-1.571) [-1.57100|1.70560] "rad" Vector__XXX
 SG_ Obj_06_AngleLeftV : 265|1@1+ (1,0) [0|1] "" Vector__XXX
 SG_ Obj_06_AngleLeftSTD : 266|14@1+ (0.00010,0) [0.00000|1.63830] "rad" Vector__XXX
 SG_ Obj_06_AngleLeftSTDV : 280|1@1+ (1,0) [0|1] "" Vector__XXX
 SG_ Obj_06_AngleSide : 281|14@1+ (0.00020,-1.571) [-1.57100|1.70560] "rad" Vector__XXX
 SG_ Obj_06_AngleSideV : 295|1@1+ (1,0) [0|1] "" Vector__XXX
 SG_ Obj_06_AngleSideSTD : 296|14@1+ (0.00010,0) [0.00000|1.63830] "rad" Vector__XXX
 SG_ Obj_06_AngleSideSTDV : 310|1@1+ (1,0) [0|1] "" Vector__XXX
 SG_ Obj_06_AngleBottomV : 311|1@1+ (1,0) [0|1] "" Vector__XXX
 SG_ Obj_06_AngleBottom : 312|14@1+ (0.00020,-1.571) [-1.57100|1.70560] "rad" Vector__XXX
 SG_ Obj_06_AngleBottomSTD : 326|14@1+ (0.00010,0) [0.00000|1.63830] "rad" Vector__XXX
 SG_ Obj_06_AngleBottomSTDV : 340|1@1+ (1,0) [0|1] "" Vector__XXX

BO_ 270 FVCM_Obj06_B: 64 FVCM
 SG_ OD_06_B_Head_CRC : 0|16@1+ (1,0) [0|65535] "" Vector__XXX
 SG_ OD_06_B_Head_ALIVE : 16|8@1+ (1,0) [0|255] "" Vector__XXX
 SG_ Obj_06_Id_B : 24|8@1+ (1,0) [0|255] "" Vector__XXX
 SG_ Obj_06_SyncCounter_B : 32|8@1+ (1,0) [0|255] "" Vector__XXX
 SG_ Obj_06_AbsLongVelocity : 40|12@1+ (0.05,-100) [-100.00|104.75] "m/s" Vector__XXX
 SG_ Obj_06_AbsLongVelocityV : 52|1@1+ (1,0) [0|1] "" Vector__XXX
 SG_ Obj_06_AbsLongVelocitySTD : 53|13@1+ (0.01,0) [0.00|81.91] "m/s" Vector__XXX
 SG_ Obj_06_AbsLongVelSTDV : 66|1@1+ (1,0) [0|1] "" Vector__XXX
 SG_ Obj_06_AbsLatVelocity : 67|11@1+ (0.05,-50) [-50.00|52.35] "m/s" Vector__XXX
 SG_ Obj_06_AbsLatVelocityV : 78|1@1+ (1,0) [0|1] "" Vector__XXX
 SG_ Obj_06_AbsLatVelocitySTD : 79|13@1+ (0.01,0) [0.00|81.91] "m/s" Vector__XXX
 SG_ Obj_06_AbsLatVelSTDV : 92|1@1+ (1,0) [0|1] "" Vector__XXX
 SG_ Obj_06_AbsLongAcc : 93|9@1+ (0.05,-10) [-10.00|15.55] "m/s²" Vector__XXX
 SG_ Obj_06_AbsLongAccV : 102|1@1+ (1,0) [0|1] "" Vector__XXX
 SG_ Obj_06_AbsLongAccSTD : 103|10@1+ (0.01,0) [0.00|10.23] "m/s²" Vector__XXX
 SG_ Obj_06_AbsLongAccSTDV : 113|1@1+ (1,0) [0|1] "" Vector__XXX
 SG_ Obj_06_AbsLatAcc : 114|9@1+ (0.05,-10) [-10.00|15.55] "m/s²" Vector__XXX
 SG_ Obj_06_AbsLatAccV : 123|1@1+ (1,0) [0|1] "" Vector__XXX
 SG_ Obj_06_AbsLatAccSTD : 124|10@1+ (0.01,0) [0.00|10.23] "m/s²" Vector__XXX
 SG_ Obj_06_AbsLatAccSTDV : 134|1@1+ (1,0) [0|1] "" Vector__XXX
 SG_ Obj_06_AbsAcceleration : 135|9@1+ (0.05,-12.7) [-12.70|12.85] "m/s²" Vector__XXX
 SG_ Obj_06_AbsAccelerationV : 144|1@1+ (1,0) [0|1] "" Vector__XXX
 SG_ Obj_06_AbsAccSTD : 145|10@1+ (0.01,0) [0.00|10.23] "m/s²" Vector__XXX
 SG_ Obj_06_AbsAccSTDV : 155|1@1+ (1,0) [0|1] "" Vector__XXX
 SG_ Obj_06_InvTTC : 156|11@1+ (0.01,-8) [-8.00|12.47] "1/s" Vector__XXX
 SG_ Obj_06_InvTTCV : 167|1@1+ (1,0) [0|1] "" Vector__XXX
 SG_ Obj_06_InvTTCSTD : 168|12@1+ (0.001,0) [0.000|4.095] "1/s" Vector__XXX
 SG_ Obj_06_InvTTCSTDV : 180|1@1+ (1,0) [0|1] "" Vector__XXX
 SG_ Obj_06_RelativeLongAcc : 181|10@1+ (0.05,-20) [-20.00|31.15] "m/s²" Vector__XXX
 SG_ Obj_06_RelativeLongAccV : 191|1@1+ (1,0) [0|1] "" Vector__XXX
 SG_ Obj_06_RelativeLongAccSTD : 192|10@1+ (0.01,0) [0.00|10.23] "m/s²" Vector__XXX
 SG_ Obj_06_RelLongAccSTDV : 202|1@1+ (1,0) [0|1] "" Vector__XXX
 SG_ Obj_06_LongtRltvSpd : 203|13@1+ (0.05,-120) [-120.00|289.55] "m/s" Vector__XXX
 SG_ Obj_06_LongtRltvSpdV : 216|1@1+ (1,0) [0|1] "" Vector__XXX
 SG_ Obj_06_LongtRltvSpdSTD : 217|14@1+ (0.01,0) [0.00|163.83] "m/s" Vector__XXX
 SG_ Obj_06_LongtRltvSpdSTDV : 231|1@1+ (1,0) [0|1] "" Vector__XXX
 SG_ Obj_06_RelativeLatVelocity : 232|11@1+ (0.05,-50) [-50.00|52.35] "m/s" Vector__XXX
 SG_ Obj_06_RelativeLatVelocityV : 243|1@1+ (1,0) [0|1] "" Vector__XXX
 SG_ Obj_06_RelativeLatVelocitySTD : 244|13@1+ (0.01,0) [0.00|81.91] "m/s" Vector__XXX
 SG_ Obj_06_RelLatVelSTDV : 257|1@1+ (1,0) [0|1] "" Vector__XXX
 SG_ Obj_06_LongtRltvDist : 258|14@1+ (0.05,-200) [-200.00|619.15] "m" Vector__XXX
 SG_ Obj_06_LongDistanceV : 272|1@1+ (1,0) [0|1] "" Vector__XXX
 SG_ Obj_06_LongDistanceSTD : 273|15@1+ (0.01,0) [0.00|327.67] "m" Vector__XXX
 SG_ Obj_06_LongDistanceSTDV : 288|1@1+ (1,0) [0|1] "" Vector__XXX
 SG_ Obj_06_LatRltvDist : 289|12@1+ (0.05,-100) [-100.00|104.75] "m" Vector__XXX
 SG_ Obj_06_LatDistanceV : 301|1@1+ (1,0) [0|1] "" Vector__XXX
 SG_ Obj_06_LatDistanceSTD : 302|14@1+ (0.01,0) [0.00|163.83] "m" Vector__XXX
 SG_ Obj_06_LatDistanceSTDV : 316|1@1+ (1,0) [0|1] "" Vector__XXX
 SG_ Obj_06_AbsoluteSpeed : 317|12@1+ (0.05,-65) [-65.00|139.75] "m/s" Vector__XXX
 SG_ Obj_06_AbsoluteSpeedV : 329|1@1+ (1,0) [0|1] "" Vector__XXX
 SG_ Obj_06_AbsoluteSpeedSTD : 330|13@1+ (0.01,0) [0.00|81.91] "m/s" Vector__XXX
 SG_ Obj_06_AbsoluteSpeedSTDV : 343|1@1+ (1,0) [0|1] "" Vector__XXX

BO_ 271 FVCM_Obj07_A: 64 FVCM
 SG_ OD_07_A_Head_CRC : 0|16@1+ (1,0) [0|65535] "" Vector__XXX
 SG_ OD_07_A_Head_ALIVE : 16|8@1+ (1,0) [0|255] "" Vector__XXX
 SG_ Obj_07_Id_A : 24|8@1+ (1,0) [0|255] "" Vector__XXX
 SG_ Obj_07_SyncCounter_A : 32|8@1+ (1,0) [0|255] "" Vector__XXX
 SG_ Obj_07_ExistPrblty : 40|8@1+ (0.01,0) [0.00|2.55] "" Vector__XXX
 SG_ Obj_07_MotionCategory : 48|4@1+ (1,0) [0|15] "" Vector__XXX
 SG_ Obj_07_Age : 52|11@1+ (1,0) [0|2047] "" Vector__XXX
 SG_ Obj_07_MeasSts : 63|3@1+ (1,0) [0|7] "" Vector__XXX
 SG_ Obj_07_Typ : 66|4@1+ (1,0) [0|15] "" Vector__XXX
 SG_ Obj_07_ClassProbability : 70|7@1+ (0.01,0) [0.00|1.27] "" Vector__XXX
 SG_ Obj_07_MotionSts : 77|3@1+ (1,0) [0|7] "" Vector__XXX
 SG_ Obj_07_MotionOrientation : 80|4@1+ (1,0) [0|15] "" Vector__XXX
 SG_ Obj_07_BrakeLight : 84|1@1+ (1,0) [0|1] "" Vector__XXX
 SG_ Obj_07_TurnIndicatorRight : 85|1@1+ (1,0) [0|1] "" Vector__XXX
 SG_ Obj_07_TurnIndicatorLeft : 86|1@1+ (1,0) [0|1] "" Vector__XXX
 SG_ Obj_07_LightIndicatorValidity : 87|1@1+ (1,0) [0|1] "" Vector__XXX
 SG_ Obj_07_LaneAssignment : 88|3@1+ (1,0) [0|7] "" Vector__XXX
 SG_ Obj_07_LaneAssignmentV : 91|1@1+ (1,0) [0|1] "" Vector__XXX
 SG_ Obj_07_Width : 92|9@1+ (0.01,0.4) [0.40|5.51] "m" Vector__XXX
 SG_ Obj_07_WidthV : 101|1@1+ (1,0) [0|1] "" Vector__XXX
 SG_ Obj_07_WidthSTD : 102|11@1+ (0.001,0) [0.000|2.047] "m" Vector__XXX
 SG_ Obj_07_WidthSTDV : 113|1@1+ (1,0) [0|1] "" Vector__XXX
 SG_ Obj_07_Length : 114|9@1+ (0.05,1.2) [1.20|26.75] "m" Vector__XXX
 SG_ Obj_07_LengthV : 123|1@1+ (1,0) [0|1] "" Vector__XXX
 SG_ Obj_07_LengthSTD : 124|10@1+ (0.01,0) [0.00|10.23] "m" Vector__XXX
 SG_ Obj_07_LengthSTDV : 134|1@1+ (1,0) [0|1] "" Vector__XXX
 SG_ Obj_07_RadarID : 135|8@1+ (1,0) [0|255] "" Vector__XXX
 SG_ Obj_07_Height : 143|9@1+ (0.01,0) [0.00|5.11] "m" Vector__XXX
 SG_ Obj_07_HeightV : 152|1@1+ (1,0) [0|1] "" Vector__XXX
 SG_ Obj_07_HeightSTD : 153|11@1+ (0.001,0) [0.000|2.047] "m" Vector__XXX
 SG_ Obj_07_HeightSTDV : 164|1@1+ (1,0) [0|1] "" Vector__XXX
 SG_ Obj_07_Heading : 165|10@1+ (0.01,-3.14) [-3.14|7.09] "rad" Vector__XXX
 SG_ Obj_07_HeadingV : 175|1@1+ (1,0) [0|1] "" Vector__XXX
 SG_ Obj_07_HeadingSTD : 176|15@1+ (0.00010,0) [0.00000|3.27670] "rad" Vector__XXX
 SG_ Obj_07_HeadingSTDV : 191|1@1+ (1,0) [0|1] "" Vector__XXX
 SG_ Obj_07_AngleRateSTD : 192|15@1+ (0.00010,0) [0.00000|3.27670] "RPS" Vector__XXX
 SG_ Obj_07_AngleRateSTDV : 207|1@1+ (1,0) [0|1] "" Vector__XXX
 SG_ Obj_07_AngleRate : 208|12@1+ (0.002,-2.234) [-2.234|5.956] "RPS" Vector__XXX
 SG_ Obj_07_AngleRateV : 220|1@1+ (1,0) [0|1] "" Vector__XXX
 SG_ Obj_07_AngleRight : 221|14@1+ (0.00020,-1.571) [-1.57100|1.70560] "rad" Vector__XXX
 SG_ Obj_07_AngleRightV : 235|1@1+ (1,0) [0|1] "" Vector__XXX
 SG_ Obj_07_AngleRightSTD : 236|14@1+ (0.00010,0) [0.00000|1.63830] "rad" Vector__XXX
 SG_ Obj_07_AngleRightSTDV : 250|1@1+ (1,0) [0|1] "" Vector__XXX
 SG_ Obj_07_AngleLeft : 251|14@1+ (0.00020,-1.571) [-1.57100|1.70560] "rad" Vector__XXX
 SG_ Obj_07_AngleLeftV : 265|1@1+ (1,0) [0|1] "" Vector__XXX
 SG_ Obj_07_AngleLeftSTD : 266|14@1+ (0.00010,0) [0.00000|1.63830] "rad" Vector__XXX
 SG_ Obj_07_AngleLeftSTDV : 280|1@1+ (1,0) [0|1] "" Vector__XXX
 SG_ Obj_07_AngleSide : 281|14@1+ (0.00020,-1.571) [-1.57100|1.70560] "rad" Vector__XXX
 SG_ Obj_07_AngleSideV : 295|1@1+ (1,0) [0|1] "" Vector__XXX
 SG_ Obj_07_AngleSideSTD : 296|14@1+ (0.00010,0) [0.00000|1.63830] "rad" Vector__XXX
 SG_ Obj_07_AngleSideSTDV : 310|1@1+ (1,0) [0|1] "" Vector__XXX
 SG_ Obj_07_AngleBottomV : 311|1@1+ (1,0) [0|1] "" Vector__XXX
 SG_ Obj_07_AngleBottom : 312|14@1+ (0.00020,-1.571) [-1.57100|1.70560] "rad" Vector__XXX
 SG_ Obj_07_AngleBottomSTD : 326|14@1+ (0.00010,0) [0.00000|1.63830] "rad" Vector__XXX
 SG_ Obj_07_AngleBottomSTDV : 340|1@1+ (1,0) [0|1] "" Vector__XXX

BO_ 272 FVCM_Obj07_B: 64 FVCM
 SG_ OD_07_B_Head_CRC : 0|16@1+ (1,0) [0|65535] "" Vector__XXX
 SG_ OD_07_B_Head_ALIVE : 16|8@1+ (1,0) [0|255] "" Vector__XXX
 SG_ Obj_07_Id_B : 24|8@1+ (1,0) [0|255] "" Vector__XXX
 SG_ Obj_07_SyncCounter_B : 32|8@1+ (1,0) [0|255] "" Vector__XXX
 SG_ Obj_07_AbsLongVelocity : 40|12@1+ (0.05,-100) [-100.00|104.75] "m/s" Vector__XXX
 SG_ Obj_07_AbsLongVelocityV : 52|1@1+ (1,0) [0|1] "" Vector__XXX
 SG_ Obj_07_AbsLongVelocitySTD : 53|13@1+ (0.01,0) [0.00|81.91] "m/s" Vector__XXX
 SG_ Obj_07_AbsLongVelSTDV : 66|1@1+ (1,0) [0|1] "" Vector__XXX
 SG_ Obj_07_AbsLatVelocity : 67|11@1+ (0.05,-50) [-50.00|52.35] "m/s" Vector__XXX
 SG_ Obj_07_AbsLatVelocityV : 78|1@1+ (1,0) [0|1] "" Vector__XXX
 SG_ Obj_07_AbsLatVelocitySTD : 79|13@1+ (0.01,0) [0.00|81.91] "m/s" Vector__XXX
 SG_ Obj_07_AbsLatVelSTDV : 92|1@1+ (1,0) [0|1] "" Vector__XXX
 SG_ Obj_07_AbsLongAcc : 93|9@1+ (0.05,-10) [-10.00|15.55] "m/s²" Vector__XXX
 SG_ Obj_07_AbsLongAccV : 102|1@1+ (1,0) [0|1] "" Vector__XXX
 SG_ Obj_07_AbsLongAccSTD : 103|10@1+ (0.01,0) [0.00|10.23] "m/s²" Vector__XXX
 SG_ Obj_07_AbsLongAccSTDV : 113|1@1+ (1,0) [0|1] "" Vector__XXX
 SG_ Obj_07_AbsLatAcc : 114|9@1+ (0.05,-10) [-10.00|15.55] "m/s²" Vector__XXX
 SG_ Obj_07_AbsLatAccV : 123|1@1+ (1,0) [0|1] "" Vector__XXX
 SG_ Obj_07_AbsLatAccSTD : 124|10@1+ (0.01,0) [0.00|10.23] "m/s²" Vector__XXX
 SG_ Obj_07_AbsLatAccSTDV : 134|1@1+ (1,0) [0|1] "" Vector__XXX
 SG_ Obj_07_AbsAcceleration : 135|9@1+ (0.05,-12.7) [-12.70|12.85] "m/s²" Vector__XXX
 SG_ Obj_07_AbsAccelerationV : 144|1@1+ (1,0) [0|1] "" Vector__XXX
 SG_ Obj_07_AbsAccSTD : 145|10@1+ (0.01,0) [0.00|10.23] "m/s²" Vector__XXX
 SG_ Obj_07_AbsAccSTDV : 155|1@1+ (1,0) [0|1] "" Vector__XXX
 SG_ Obj_07_InvTTC : 156|11@1+ (0.01,-8) [-8.00|12.47] "1/s" Vector__XXX
 SG_ Obj_07_InvTTCV : 167|1@1+ (1,0) [0|1] "" Vector__XXX
 SG_ Obj_07_InvTTCSTD : 168|12@1+ (0.001,0) [0.000|4.095] "1/s" Vector__XXX
 SG_ Obj_07_InvTTCSTDV : 180|1@1+ (1,0) [0|1] "" Vector__XXX
 SG_ Obj_07_RelativeLongAcc : 181|10@1+ (0.05,-20) [-20.00|31.15] "m/s²" Vector__XXX
 SG_ Obj_07_RelativeLongAccV : 191|1@1+ (1,0) [0|1] "" Vector__XXX
 SG_ Obj_07_RelativeLongAccSTD : 192|10@1+ (0.01,0) [0.00|10.23] "m/s²" Vector__XXX
 SG_ Obj_07_RelLongAccSTDV : 202|1@1+ (1,0) [0|1] "" Vector__XXX
 SG_ Obj_07_LongtRltvSpd : 203|13@1+ (0.05,-120) [-120.00|289.55] "m/s" Vector__XXX
 SG_ Obj_07_LongtRltvSpdV : 216|1@1+ (1,0) [0|1] "" Vector__XXX
 SG_ Obj_07_LongtRltvSpdSTD : 217|14@1+ (0.01,0) [0.00|163.83] "m/s" Vector__XXX
 SG_ Obj_07_LongtRltvSpdSTDV : 231|1@1+ (1,0) [0|1] "" Vector__XXX
 SG_ Obj_07_RelativeLatVelocity : 232|11@1+ (0.05,-50) [-50.00|52.35] "m/s" Vector__XXX
 SG_ Obj_07_RelativeLatVelocityV : 243|1@1+ (1,0) [0|1] "" Vector__XXX
 SG_ Obj_07_RelativeLatVelocitySTD : 244|13@1+ (0.01,0) [0.00|81.91] "m/s" Vector__XXX
 SG_ Obj_07_RelLatVelSTDV : 257|1@1+ (1,0) [0|1] "" Vector__XXX
 SG_ Obj_07_LongtRltvDist : 258|14@1+ (0.05,-200) [-200.00|619.15] "m" Vector__XXX
 SG_ Obj_07_LongDistanceV : 272|1@1+ (1,0) [0|1] "" Vector__XXX
 SG_ Obj_07_LongDistanceSTD : 273|15@1+ (0.01,0) [0.00|327.67] "m" Vector__XXX
 SG_ Obj_07_LongDistanceSTDV : 288|1@1+ (1,0) [0|1] "" Vector__XXX
 SG_ Obj_07_LatRltvDist : 289|12@1+ (0.05,-100) [-100.00|104.75] "m" Vector__XXX
 SG_ Obj_07_LatDistanceV : 301|1@1+ (1,0) [0|1] "" Vector__XXX
 SG_ Obj_07_LatDistanceSTD : 302|14@1+ (0.01,0) [0.00|163.83] "m" Vector__XXX
 SG_ Obj_07_LatDistanceSTDV : 316|1@1+ (1,0) [0|1] "" Vector__XXX
 SG_ Obj_07_AbsoluteSpeed : 317|12@1+ (0.05,-65) [-65.00|139.75] "m/s" Vector__XXX
 SG_ Obj_07_AbsoluteSpeedV : 329|1@1+ (1,0) [0|1] "" Vector__XXX
 SG_ Obj_07_AbsoluteSpeedSTD : 330|13@1+ (0.01,0) [0.00|81.91] "m/s" Vector__XXX
 SG_ Obj_07_AbsoluteSpeedSTDV : 343|1@1+ (1,0) [0|1] "" Vector__XXX

BO_ 273 FVCM_Obj08_A: 64 FVCM
 SG_ OD_08_A_Head_CRC : 0|16@1+ (1,0) [0|65535] "" Vector__XXX
 SG_ OD_08_A_Head_ALIVE : 16|8@1+ (1,0) [0|255] "" Vector__XXX
 SG_ Obj_08_Id_A : 24|8@1+ (1,0) [0|255] "" Vector__XXX
 SG_ Obj_08_SyncCounter_A : 32|8@1+ (1,0) [0|255] "" Vector__XXX
 SG_ Obj_08_ExistPrblty : 40|8@1+ (0.01,0) [0.00|2.55] "" Vector__XXX
 SG_ Obj_08_MotionCategory : 48|4@1+ (1,0) [0|15] "" Vector__XXX
 SG_ Obj_08_Age : 52|11@1+ (1,0) [0|2047] "" Vector__XXX
 SG_ Obj_08_MeasSts : 63|3@1+ (1,0) [0|7] "" Vector__XXX
 SG_ Obj_08_Typ : 66|4@1+ (1,0) [0|15] "" Vector__XXX
 SG_ Obj_08_ClassProbability : 70|7@1+ (0.01,0) [0.00|1.27] "" Vector__XXX
 SG_ Obj_08_MotionSts : 77|3@1+ (1,0) [0|7] "" Vector__XXX
 SG_ Obj_08_MotionOrientation : 80|4@1+ (1,0) [0|15] "" Vector__XXX
 SG_ Obj_08_BrakeLight : 84|1@1+ (1,0) [0|1] "" Vector__XXX
 SG_ Obj_08_TurnIndicatorRight : 85|1@1+ (1,0) [0|1] "" Vector__XXX
 SG_ Obj_08_TurnIndicatorLeft : 86|1@1+ (1,0) [0|1] "" Vector__XXX
 SG_ Obj_08_LightIndicatorValidity : 87|1@1+ (1,0) [0|1] "" Vector__XXX
 SG_ Obj_08_LaneAssignment : 88|3@1+ (1,0) [0|7] "" Vector__XXX
 SG_ Obj_08_LaneAssignmentV : 91|1@1+ (1,0) [0|1] "" Vector__XXX
 SG_ Obj_08_Width : 92|9@1+ (0.01,0.4) [0.40|5.51] "m" Vector__XXX
 SG_ Obj_08_WidthV : 101|1@1+ (1,0) [0|1] "" Vector__XXX
 SG_ Obj_08_WidthSTD : 102|11@1+ (0.001,0) [0.000|2.047] "m" Vector__XXX
 SG_ Obj_08_WidthSTDV : 113|1@1+ (1,0) [0|1] "" Vector__XXX
 SG_ Obj_08_Length : 114|9@1+ (0.05,1.2) [1.20|26.75] "m" Vector__XXX
 SG_ Obj_08_LengthV : 123|1@1+ (1,0) [0|1] "" Vector__XXX
 SG_ Obj_08_LengthSTD : 124|10@1+ (0.01,0) [0.00|10.23] "m" Vector__XXX
 SG_ Obj_08_LengthSTDV : 134|1@1+ (1,0) [0|1] "" Vector__XXX
 SG_ Obj_08_RadarID : 135|8@1+ (1,0) [0|255] "" Vector__XXX
 SG_ Obj_08_Height : 143|9@1+ (0.01,0) [0.00|5.11] "m" Vector__XXX
 SG_ Obj_08_HeightV : 152|1@1+ (1,0) [0|1] "" Vector__XXX
 SG_ Obj_08_HeightSTD : 153|11@1+ (0.001,0) [0.000|2.047] "m" Vector__XXX
 SG_ Obj_08_HeightSTDV : 164|1@1+ (1,0) [0|1] "" Vector__XXX
 SG_ Obj_08_Heading : 165|10@1+ (0.01,-3.14) [-3.14|7.09] "rad" Vector__XXX
 SG_ Obj_08_HeadingV : 175|1@1+ (1,0) [0|1] "" Vector__XXX
 SG_ Obj_08_HeadingSTD : 176|15@1+ (0.00010,0) [0.00000|3.27670] "rad" Vector__XXX
 SG_ Obj_08_HeadingSTDV : 191|1@1+ (1,0) [0|1] "" Vector__XXX
 SG_ Obj_08_AngleRateSTD : 192|15@1+ (0.00010,0) [0.00000|3.27670] "RPS" Vector__XXX
 SG_ Obj_08_AngleRateSTDV : 207|1@1+ (1,0) [0|1] "" Vector__XXX
 SG_ Obj_08_AngleRate : 208|12@1+ (0.002,-2.234) [-2.234|5.956] "RPS" Vector__XXX
 SG_ Obj_08_AngleRateV : 220|1@1+ (1,0) [0|1] "" Vector__XXX
 SG_ Obj_08_AngleRight : 221|14@1+ (0.00020,-1.571) [-1.57100|1.70560] "rad" Vector__XXX
 SG_ Obj_08_AngleRightV : 235|1@1+ (1,0) [0|1] "" Vector__XXX
 SG_ Obj_08_AngleRightSTD : 236|14@1+ (0.00010,0) [0.00000|1.63830] "rad" Vector__XXX
 SG_ Obj_08_AngleRightSTDV : 250|1@1+ (1,0) [0|1] "" Vector__XXX
 SG_ Obj_08_AngleLeft : 251|14@1+ (0.00020,-1.571) [-1.57100|1.70560] "rad" Vector__XXX
 SG_ Obj_08_AngleLeftV : 265|1@1+ (1,0) [0|1] "" Vector__XXX
 SG_ Obj_08_AngleLeftSTD : 266|14@1+ (0.00010,0) [0.00000|1.63830] "rad" Vector__XXX
 SG_ Obj_08_AngleLeftSTDV : 280|1@1+ (1,0) [0|1] "" Vector__XXX
 SG_ Obj_08_AngleSide : 281|14@1+ (0.00020,-1.571) [-1.57100|1.70560] "rad" Vector__XXX
 SG_ Obj_08_AngleSideV : 295|1@1+ (1,0) [0|1] "" Vector__XXX
 SG_ Obj_08_AngleSideSTD : 296|14@1+ (0.00010,0) [0.00000|1.63830] "rad" Vector__XXX
 SG_ Obj_08_AngleSideSTDV : 310|1@1+ (1,0) [0|1] "" Vector__XXX
 SG_ Obj_08_AngleBottomV : 311|1@1+ (1,0) [0|1] "" Vector__XXX
 SG_ Obj_08_AngleBottom : 312|14@1+ (0.00020,-1.571) [-1.57100|1.70560] "rad" Vector__XXX
 SG_ Obj_08_AngleBottomSTD : 326|14@1+ (0.00010,0) [0.00000|1.63830] "rad" Vector__XXX
 SG_ Obj_08_AngleBottomSTDV : 340|1@1+ (1,0) [0|1] "" Vector__XXX

BO_ 274 FVCM_Obj08_B: 64 FVCM
 SG_ OD_08_B_Head_CRC : 0|16@1+ (1,0) [0|65535] "" Vector__XXX
 SG_ OD_08_B_Head_ALIVE : 16|8@1+ (1,0) [0|255] "" Vector__XXX
 SG_ Obj_08_Id_B : 24|8@1+ (1,0) [0|255] "" Vector__XXX
 SG_ Obj_08_SyncCounter_B : 32|8@1+ (1,0) [0|255] "" Vector__XXX
 SG_ Obj_08_AbsLongVelocity : 40|12@1+ (0.05,-100) [-100.00|104.75] "m/s" Vector__XXX
 SG_ Obj_08_AbsLongVelocityV : 52|1@1+ (1,0) [0|1] "" Vector__XXX
 SG_ Obj_08_AbsLongVelocitySTD : 53|13@1+ (0.01,0) [0.00|81.91] "m/s" Vector__XXX
 SG_ Obj_08_AbsLongVelSTDV : 66|1@1+ (1,0) [0|1] "" Vector__XXX
 SG_ Obj_08_AbsLatVelocity : 67|11@1+ (0.05,-50) [-50.00|52.35] "m/s" Vector__XXX
 SG_ Obj_08_AbsLatVelocityV : 78|1@1+ (1,0) [0|1] "" Vector__XXX
 SG_ Obj_08_AbsLatVelocitySTD : 79|13@1+ (0.01,0) [0.00|81.91] "m/s" Vector__XXX
 SG_ Obj_08_AbsLatVelSTDV : 92|1@1+ (1,0) [0|1] "" Vector__XXX
 SG_ Obj_08_AbsLongAcc : 93|9@1+ (0.05,-10) [-10.00|15.55] "m/s²" Vector__XXX
 SG_ Obj_08_AbsLongAccV : 102|1@1+ (1,0) [0|1] "" Vector__XXX
 SG_ Obj_08_AbsLongAccSTD : 103|10@1+ (0.01,0) [0.00|10.23] "m/s²" Vector__XXX
 SG_ Obj_08_AbsLongAccSTDV : 113|1@1+ (1,0) [0|1] "" Vector__XXX
 SG_ Obj_08_AbsLatAcc : 114|9@1+ (0.05,-10) [-10.00|15.55] "m/s²" Vector__XXX
 SG_ Obj_08_AbsLatAccV : 123|1@1+ (1,0) [0|1] "" Vector__XXX
 SG_ Obj_08_AbsLatAccSTD : 124|10@1+ (0.01,0) [0.00|10.23] "m/s²" Vector__XXX
 SG_ Obj_08_AbsLatAccSTDV : 134|1@1+ (1,0) [0|1] "" Vector__XXX
 SG_ Obj_08_AbsAcceleration : 135|9@1+ (0.05,-12.7) [-12.70|12.85] "m/s²" Vector__XXX
 SG_ Obj_08_AbsAccelerationV : 144|1@1+ (1,0) [0|1] "" Vector__XXX
 SG_ Obj_08_AbsAccSTD : 145|10@1+ (0.01,0) [0.00|10.23] "m/s²" Vector__XXX
 SG_ Obj_08_AbsAccSTDV : 155|1@1+ (1,0) [0|1] "" Vector__XXX
 SG_ Obj_08_InvTTC : 156|11@1+ (0.01,-8) [-8.00|12.47] "1/s" Vector__XXX
 SG_ Obj_08_InvTTCV : 167|1@1+ (1,0) [0|1] "" Vector__XXX
 SG_ Obj_08_InvTTCSTD : 168|12@1+ (0.001,0) [0.000|4.095] "1/s" Vector__XXX
 SG_ Obj_08_InvTTCSTDV : 180|1@1+ (1,0) [0|1] "" Vector__XXX
 SG_ Obj_08_RelativeLongAcc : 181|10@1+ (0.05,-20) [-20.00|31.15] "m/s²" Vector__XXX
 SG_ Obj_08_RelativeLongAccV : 191|1@1+ (1,0) [0|1] "" Vector__XXX
 SG_ Obj_08_RelativeLongAccSTD : 192|10@1+ (0.01,0) [0.00|10.23] "m/s²" Vector__XXX
 SG_ Obj_08_RelLongAccSTDV : 202|1@1+ (1,0) [0|1] "" Vector__XXX
 SG_ Obj_08_LongtRltvSpd : 203|13@1+ (0.05,-120) [-120.00|289.55] "m/s" Vector__XXX
 SG_ Obj_08_LongtRltvSpdV : 216|1@1+ (1,0) [0|1] "" Vector__XXX
 SG_ Obj_08_LongtRltvSpdSTD : 217|14@1+ (0.01,0) [0.00|163.83] "m/s" Vector__XXX
 SG_ Obj_08_LongtRltvSpdSTDV : 231|1@1+ (1,0) [0|1] "" Vector__XXX
 SG_ Obj_08_RelativeLatVelocity : 232|11@1+ (0.05,-50) [-50.00|52.35] "m/s" Vector__XXX
 SG_ Obj_08_RelativeLatVelocityV : 243|1@1+ (1,0) [0|1] "" Vector__XXX
 SG_ Obj_08_RelativeLatVelocitySTD : 244|13@1+ (0.01,0) [0.00|81.91] "m/s" Vector__XXX
 SG_ Obj_08_RelLatVelSTDV : 257|1@1+ (1,0) [0|1] "" Vector__XXX
 SG_ Obj_08_LongtRltvDist : 258|14@1+ (0.05,-200) [-200.00|619.15] "m" Vector__XXX
 SG_ Obj_08_LongDistanceV : 272|1@1+ (1,0) [0|1] "" Vector__XXX
 SG_ Obj_08_LongDistanceSTD : 273|15@1+ (0.01,0) [0.00|327.67] "m" Vector__XXX
 SG_ Obj_08_LongDistanceSTDV : 288|1@1+ (1,0) [0|1] "" Vector__XXX
 SG_ Obj_08_LatRltvDist : 289|12@1+ (0.05,-100) [-100.00|104.75] "m" Vector__XXX
 SG_ Obj_08_LatDistanceV : 301|1@1+ (1,0) [0|1] "" Vector__XXX
 SG_ Obj_08_LatDistanceSTD : 302|14@1+ (0.01,0) [0.00|163.83] "m" Vector__XXX
 SG_ Obj_08_LatDistanceSTDV : 316|1@1+ (1,0) [0|1] "" Vector__XXX
 SG_ Obj_08_AbsoluteSpeed : 317|12@1+ (0.05,-65) [-65.00|139.75] "m/s" Vector__XXX
 SG_ Obj_08_AbsoluteSpeedV : 329|1@1+ (1,0) [0|1] "" Vector__XXX
 SG_ Obj_08_AbsoluteSpeedSTD : 330|13@1+ (0.01,0) [0.00|81.91] "m/s" Vector__XXX
 SG_ Obj_08_AbsoluteSpeedSTDV : 343|1@1+ (1,0) [0|1] "" Vector__XXX

BO_ 275 FVCM_Obj09_A: 64 FVCM
 SG_ OD_09_A_Head_CRC : 0|16@1+ (1,0) [0|65535] "" Vector__XXX
 SG_ OD_09_A_Head_ALIVE : 16|8@1+ (1,0) [0|255] "" Vector__XXX
 SG_ Obj_09_Id_A : 24|8@1+ (1,0) [0|255] "" Vector__XXX
 SG_ Obj_09_SyncCounter_A : 32|8@1+ (1,0) [0|255] "" Vector__XXX
 SG_ Obj_09_ExistPrblty : 40|8@1+ (0.01,0) [0.00|2.55] "" Vector__XXX
 SG_ Obj_09_MotionCategory : 48|4@1+ (1,0) [0|15] "" Vector__XXX
 SG_ Obj_09_Age : 52|11@1+ (1,0) [0|2047] "" Vector__XXX
 SG_ Obj_09_MeasSts : 63|3@1+ (1,0) [0|7] "" Vector__XXX
 SG_ Obj_09_Typ : 66|4@1+ (1,0) [0|15] "" Vector__XXX
 SG_ Obj_09_ClassProbability : 70|7@1+ (0.01,0) [0.00|1.27] "" Vector__XXX
 SG_ Obj_09_MotionSts : 77|3@1+ (1,0) [0|7] "" Vector__XXX
 SG_ Obj_09_MotionOrientation : 80|4@1+ (1,0) [0|15] "" Vector__XXX
 SG_ Obj_09_BrakeLight : 84|1@1+ (1,0) [0|1] "" Vector__XXX
 SG_ Obj_09_TurnIndicatorRight : 85|1@1+ (1,0) [0|1] "" Vector__XXX
 SG_ Obj_09_TurnIndicatorLeft : 86|1@1+ (1,0) [0|1] "" Vector__XXX
 SG_ Obj_09_LightIndicatorValidity : 87|1@1+ (1,0) [0|1] "" Vector__XXX
 SG_ Obj_09_LaneAssignment : 88|3@1+ (1,0) [0|7] "" Vector__XXX
 SG_ Obj_09_LaneAssignmentV : 91|1@1+ (1,0) [0|1] "" Vector__XXX
 SG_ Obj_09_Width : 92|9@1+ (0.01,0.4) [0.40|5.51] "m" Vector__XXX
 SG_ Obj_09_WidthV : 101|1@1+ (1,0) [0|1] "" Vector__XXX
 SG_ Obj_09_WidthSTD : 102|11@1+ (0.001,0) [0.000|2.047] "m" Vector__XXX
 SG_ Obj_09_WidthSTDV : 113|1@1+ (1,0) [0|1] "" Vector__XXX
 SG_ Obj_09_Length : 114|9@1+ (0.05,1.2) [1.20|26.75] "m" Vector__XXX
 SG_ Obj_09_LengthV : 123|1@1+ (1,0) [0|1] "" Vector__XXX
 SG_ Obj_09_LengthSTD : 124|10@1+ (0.01,0) [0.00|10.23] "m" Vector__XXX
 SG_ Obj_09_LengthSTDV : 134|1@1+ (1,0) [0|1] "" Vector__XXX
 SG_ Obj_09_RadarID : 135|8@1+ (1,0) [0|255] "" Vector__XXX
 SG_ Obj_09_Height : 143|9@1+ (0.01,0) [0.00|5.11] "m" Vector__XXX
 SG_ Obj_09_HeightV : 152|1@1+ (1,0) [0|1] "" Vector__XXX
 SG_ Obj_09_HeightSTD : 153|11@1+ (0.001,0) [0.000|2.047] "m" Vector__XXX
 SG_ Obj_09_HeightSTDV : 164|1@1+ (1,0) [0|1] "" Vector__XXX
 SG_ Obj_09_Heading : 165|10@1+ (0.01,-3.14) [-3.14|7.09] "rad" Vector__XXX
 SG_ Obj_09_HeadingV : 175|1@1+ (1,0) [0|1] "" Vector__XXX
 SG_ Obj_09_HeadingSTD : 176|15@1+ (0.00010,0) [0.00000|3.27670] "rad" Vector__XXX
 SG_ Obj_09_HeadingSTDV : 191|1@1+ (1,0) [0|1] "" Vector__XXX
 SG_ Obj_09_AngleRateSTD : 192|15@1+ (0.00010,0) [0.00000|3.27670] "RPS" Vector__XXX
 SG_ Obj_09_AngleRateSTDV : 207|1@1+ (1,0) [0|1] "" Vector__XXX
 SG_ Obj_09_AngleRate : 208|12@1+ (0.002,-2.234) [-2.234|5.956] "RPS" Vector__XXX
 SG_ Obj_09_AngleRateV : 220|1@1+ (1,0) [0|1] "" Vector__XXX
 SG_ Obj_09_AngleRight : 221|14@1+ (0.00020,-1.571) [-1.57100|1.70560] "rad" Vector__XXX
 SG_ Obj_09_AngleRightV : 235|1@1+ (1,0) [0|1] "" Vector__XXX
 SG_ Obj_09_AngleRightSTD : 236|14@1+ (0.00010,0) [0.00000|1.63830] "rad" Vector__XXX
 SG_ Obj_09_AngleRightSTDV : 250|1@1+ (1,0) [0|1] "" Vector__XXX
 SG_ Obj_09_AngleLeft : 251|14@1+ (0.00020,-1.571) [-1.57100|1.70560] "rad" Vector__XXX
 SG_ Obj_09_AngleLeftV : 265|1@1+ (1,0) [0|1] "" Vector__XXX
 SG_ Obj_09_AngleLeftSTD : 266|14@1+ (0.00010,0) [0.00000|1.63830] "rad" Vector__XXX
 SG_ Obj_09_AngleLeftSTDV : 280|1@1+ (1,0) [0|1] "" Vector__XXX
 SG_ Obj_09_AngleSide : 281|14@1+ (0.00020,-1.571) [-1.57100|1.70560] "rad" Vector__XXX
 SG_ Obj_09_AngleSideV : 295|1@1+ (1,0) [0|1] "" Vector__XXX
 SG_ Obj_09_AngleSideSTD : 296|14@1+ (0.00010,0) [0.00000|1.63830] "rad" Vector__XXX
 SG_ Obj_09_AngleSideSTDV : 310|1@1+ (1,0) [0|1] "" Vector__XXX
 SG_ Obj_09_AngleBottomV : 311|1@1+ (1,0) [0|1] "" Vector__XXX
 SG_ Obj_09_AngleBottom : 312|14@1+ (0.00020,-1.571) [-1.57100|1.70560] "rad" Vector__XXX
 SG_ Obj_09_AngleBottomSTD : 326|14@1+ (0.00010,0) [0.00000|1.63830] "rad" Vector__XXX
 SG_ Obj_09_AngleBottomSTDV : 340|1@1+ (1,0) [0|1] "" Vector__XXX

BO_ 276 FVCM_Obj09_B: 64 FVCM
 SG_ OD_09_B_Head_CRC : 0|16@1+ (1,0) [0|65535] "" Vector__XXX
 SG_ OD_09_B_Head_ALIVE : 16|8@1+ (1,0) [0|255] "" Vector__XXX
 SG_ Obj_09_Id_B : 24|8@1+ (1,0) [0|255] "" Vector__XXX
 SG_ Obj_09_SyncCounter_B : 32|8@1+ (1,0) [0|255] "" Vector__XXX
 SG_ Obj_09_AbsLongVelocity : 40|12@1+ (0.05,-100) [-100.00|104.75] "m/s" Vector__XXX
 SG_ Obj_09_AbsLongVelocityV : 52|1@1+ (1,0) [0|1] "" Vector__XXX
 SG_ Obj_09_AbsLongVelocitySTD : 53|13@1+ (0.01,0) [0.00|81.91] "m/s" Vector__XXX
 SG_ Obj_09_AbsLongVelSTDV : 66|1@1+ (1,0) [0|1] "" Vector__XXX
 SG_ Obj_09_AbsLatVelocity : 67|11@1+ (0.05,-50) [-50.00|52.35] "m/s" Vector__XXX
 SG_ Obj_09_AbsLatVelocityV : 78|1@1+ (1,0) [0|1] "" Vector__XXX
 SG_ Obj_09_AbsLatVelocitySTD : 79|13@1+ (0.01,0) [0.00|81.91] "m/s" Vector__XXX
 SG_ Obj_09_AbsLatVelSTDV : 92|1@1+ (1,0) [0|1] "" Vector__XXX
 SG_ Obj_09_AbsLongAcc : 93|9@1+ (0.05,-10) [-10.00|15.55] "m/s²" Vector__XXX
 SG_ Obj_09_AbsLongAccV : 102|1@1+ (1,0) [0|1] "" Vector__XXX
 SG_ Obj_09_AbsLongAccSTD : 103|10@1+ (0.01,0) [0.00|10.23] "m/s²" Vector__XXX
 SG_ Obj_09_AbsLongAccSTDV : 113|1@1+ (1,0) [0|1] "" Vector__XXX
 SG_ Obj_09_AbsLatAcc : 114|9@1+ (0.05,-10) [-10.00|15.55] "m/s²" Vector__XXX
 SG_ Obj_09_AbsLatAccV : 123|1@1+ (1,0) [0|1] "" Vector__XXX
 SG_ Obj_09_AbsLatAccSTD : 124|10@1+ (0.01,0) [0.00|10.23] "m/s²" Vector__XXX
 SG_ Obj_09_AbsLatAccSTDV : 134|1@1+ (1,0) [0|1] "" Vector__XXX
 SG_ Obj_09_AbsAcceleration : 135|9@1+ (0.05,-12.7) [-12.70|12.85] "m/s²" Vector__XXX
 SG_ Obj_09_AbsAccelerationV : 144|1@1+ (1,0) [0|1] "" Vector__XXX
 SG_ Obj_09_AbsAccSTD : 145|10@1+ (0.01,0) [0.00|10.23] "m/s²" Vector__XXX
 SG_ Obj_09_AbsAccSTDV : 155|1@1+ (1,0) [0|1] "" Vector__XXX
 SG_ Obj_09_InvTTC : 156|11@1+ (0.01,-8) [-8.00|12.47] "1/s" Vector__XXX
 SG_ Obj_09_InvTTCV : 167|1@1+ (1,0) [0|1] "" Vector__XXX
 SG_ Obj_09_InvTTCSTD : 168|12@1+ (0.001,0) [0.000|4.095] "1/s" Vector__XXX
 SG_ Obj_09_InvTTCSTDV : 180|1@1+ (1,0) [0|1] "" Vector__XXX
 SG_ Obj_09_RelativeLongAcc : 181|10@1+ (0.05,-20) [-20.00|31.15] "m/s²" Vector__XXX
 SG_ Obj_09_RelativeLongAccV : 191|1@1+ (1,0) [0|1] "" Vector__XXX
 SG_ Obj_09_RelativeLongAccSTD : 192|10@1+ (0.01,0) [0.00|10.23] "m/s²" Vector__XXX
 SG_ Obj_09_RelLongAccSTDV : 202|1@1+ (1,0) [0|1] "" Vector__XXX
 SG_ Obj_09_LongtRltvSpd : 203|13@1+ (0.05,-120) [-120.00|289.55] "m/s" Vector__XXX
 SG_ Obj_09_LongtRltvSpdV : 216|1@1+ (1,0) [0|1] "" Vector__XXX
 SG_ Obj_09_LongtRltvSpdSTD : 217|14@1+ (0.01,0) [0.00|163.83] "m/s" Vector__XXX
 SG_ Obj_09_LongtRltvSpdSTDV : 231|1@1+ (1,0) [0|1] "" Vector__XXX
 SG_ Obj_09_RelativeLatVelocity : 232|11@1+ (0.05,-50) [-50.00|52.35] "m/s" Vector__XXX
 SG_ Obj_09_RelativeLatVelocityV : 243|1@1+ (1,0) [0|1] "" Vector__XXX
 SG_ Obj_09_RelativeLatVelocitySTD : 244|13@1+ (0.01,0) [0.00|81.91] "m/s" Vector__XXX
 SG_ Obj_09_RelLatVelSTDV : 257|1@1+ (1,0) [0|1] "" Vector__XXX
 SG_ Obj_09_LongtRltvDist : 258|14@1+ (0.05,-200) [-200.00|619.15] "m" Vector__XXX
 SG_ Obj_09_LongDistanceV : 272|1@1+ (1,0) [0|1] "" Vector__XXX
 SG_ Obj_09_LongDistanceSTD : 273|15@1+ (0.01,0) [0.00|327.67] "m" Vector__XXX
 SG_ Obj_09_LongDistanceSTDV : 288|1@1+ (1,0) [0|1] "" Vector__XXX
 SG_ Obj_09_LatRltvDist : 289|12@1+ (0.05,-100) [-100.00|104.75] "m" Vector__XXX
 SG_ Obj_09_LatDistanceV : 301|1@1+ (1,0) [0|1] "" Vector__XXX
 SG_ Obj_09_LatDistanceSTD : 302|14@1+ (0.01,0) [0.00|163.83] "m" Vector__XXX
 SG_ Obj_09_LatDistanceSTDV : 316|1@1+ (1,0) [0|1] "" Vector__XXX
 SG_ Obj_09_AbsoluteSpeed : 317|12@1+ (0.05,-65) [-65.00|139.75] "m/s" Vector__XXX
 SG_ Obj_09_AbsoluteSpeedV : 329|1@1+ (1,0) [0|1] "" Vector__XXX
 SG_ Obj_09_AbsoluteSpeedSTD : 330|13@1+ (0.01,0) [0.00|81.91] "m/s" Vector__XXX
 SG_ Obj_09_AbsoluteSpeedSTDV : 343|1@1+ (1,0) [0|1] "" Vector__XXX

BO_ 277 FVCM_Obj10_A: 64 FVCM
 SG_ OD_10_A_Head_CRC : 0|16@1+ (1,0) [0|65535] "" Vector__XXX
 SG_ OD_10_A_Head_ALIVE : 16|8@1+ (1,0) [0|255] "" Vector__XXX
 SG_ Obj_10_Id_A : 24|8@1+ (1,0) [0|255] "" Vector__XXX
 SG_ Obj_10_SyncCounter_A : 32|8@1+ (1,0) [0|255] "" Vector__XXX
 SG_ Obj_10_ExistPrblty : 40|8@1+ (0.01,0) [0.00|2.55] "" Vector__XXX
 SG_ Obj_10_MotionCategory : 48|4@1+ (1,0) [0|15] "" Vector__XXX
 SG_ Obj_10_Age : 52|11@1+ (1,0) [0|2047] "" Vector__XXX
 SG_ Obj_10_MeasSts : 63|3@1+ (1,0) [0|7] "" Vector__XXX
 SG_ Obj_10_Typ : 66|4@1+ (1,0) [0|15] "" Vector__XXX
 SG_ Obj_10_ClassProbability : 70|7@1+ (0.01,0) [0.00|1.27] "" Vector__XXX
 SG_ Obj_10_MotionSts : 77|3@1+ (1,0) [0|7] "" Vector__XXX
 SG_ Obj_10_MotionOrientation : 80|4@1+ (1,0) [0|15] "" Vector__XXX
 SG_ Obj_10_BrakeLight : 84|1@1+ (1,0) [0|1] "" Vector__XXX
 SG_ Obj_10_TurnIndicatorRight : 85|1@1+ (1,0) [0|1] "" Vector__XXX
 SG_ Obj_10_TurnIndicatorLeft : 86|1@1+ (1,0) [0|1] "" Vector__XXX
 SG_ Obj_10_LightIndicatorValidity : 87|1@1+ (1,0) [0|1] "" Vector__XXX
 SG_ Obj_10_LaneAssignment : 88|3@1+ (1,0) [0|7] "" Vector__XXX
 SG_ Obj_10_LaneAssignmentV : 91|1@1+ (1,0) [0|1] "" Vector__XXX
 SG_ Obj_10_Width : 92|9@1+ (0.01,0.4) [0.40|5.51] "m" Vector__XXX
 SG_ Obj_10_WidthV : 101|1@1+ (1,0) [0|1] "" Vector__XXX
 SG_ Obj_10_WidthSTD : 102|11@1+ (0.001,0) [0.000|2.047] "m" Vector__XXX
 SG_ Obj_10_WidthSTDV : 113|1@1+ (1,0) [0|1] "" Vector__XXX
 SG_ Obj_10_Length : 114|9@1+ (0.05,1.2) [1.20|26.75] "m" Vector__XXX
 SG_ Obj_10_LengthV : 123|1@1+ (1,0) [0|1] "" Vector__XXX
 SG_ Obj_10_LengthSTD : 124|10@1+ (0.01,0) [0.00|10.23] "m" Vector__XXX
 SG_ Obj_10_LengthSTDV : 134|1@1+ (1,0) [0|1] "" Vector__XXX
 SG_ Obj_10_RadarID : 135|8@1+ (1,0) [0|255] "" Vector__XXX
 SG_ Obj_10_Height : 143|9@1+ (0.01,0) [0.00|5.11] "m" Vector__XXX
 SG_ Obj_10_HeightV : 152|1@1+ (1,0) [0|1] "" Vector__XXX
 SG_ Obj_10_HeightSTD : 153|11@1+ (0.001,0) [0.000|2.047] "m" Vector__XXX
 SG_ Obj_10_HeightSTDV : 164|1@1+ (1,0) [0|1] "" Vector__XXX
 SG_ Obj_10_Heading : 165|10@1+ (0.01,-3.14) [-3.14|7.09] "rad" Vector__XXX
 SG_ Obj_10_HeadingV : 175|1@1+ (1,0) [0|1] "" Vector__XXX
 SG_ Obj_10_HeadingSTD : 176|15@1+ (0.00010,0) [0.00000|3.27670] "rad" Vector__XXX
 SG_ Obj_10_HeadingSTDV : 191|1@1+ (1,0) [0|1] "" Vector__XXX
 SG_ Obj_10_AngleRateSTD : 192|15@1+ (0.00010,0) [0.00000|3.27670] "RPS" Vector__XXX
 SG_ Obj_10_AngleRateSTDV : 207|1@1+ (1,0) [0|1] "" Vector__XXX
 SG_ Obj_10_AngleRate : 208|12@1+ (0.002,-2.234) [-2.234|5.956] "RPS" Vector__XXX
 SG_ Obj_10_AngleRateV : 220|1@1+ (1,0) [0|1] "" Vector__XXX
 SG_ Obj_10_AngleRight : 221|14@1+ (0.00020,-1.571) [-1.57100|1.70560] "rad" Vector__XXX
 SG_ Obj_10_AngleRightV : 235|1@1+ (1,0) [0|1] "" Vector__XXX
 SG_ Obj_10_AngleRightSTD : 236|14@1+ (0.00010,0) [0.00000|1.63830] "rad" Vector__XXX
 SG_ Obj_10_AngleRightSTDV : 250|1@1+ (1,0) [0|1] "" Vector__XXX
 SG_ Obj_10_AngleLeft : 251|14@1+ (0.00020,-1.571) [-1.57100|1.70560] "rad" Vector__XXX
 SG_ Obj_10_AngleLeftV : 265|1@1+ (1,0) [0|1] "" Vector__XXX
 SG_ Obj_10_AngleLeftSTD : 266|14@1+ (0.00010,0) [0.00000|1.63830] "rad" Vector__XXX
 SG_ Obj_10_AngleLeftSTDV : 280|1@1+ (1,0) [0|1] "" Vector__XXX
 SG_ Obj_10_AngleSide : 281|14@1+ (0.00020,-1.571) [-1.57100|1.70560] "rad" Vector__XXX
 SG_ Obj_10_AngleSideV : 295|1@1+ (1,0) [0|1] "" Vector__XXX
 SG_ Obj_10_AngleSideSTD : 296|14@1+ (0.00010,0) [0.00000|1.63830] "rad" Vector__XXX
 SG_ Obj_10_AngleSideSTDV : 310|1@1+ (1,0) [0|1] "" Vector__XXX
 SG_ Obj_10_AngleBottomV : 311|1@1+ (1,0) [0|1] "" Vector__XXX
 SG_ Obj_10_AngleBottom : 312|14@1+ (0.00020,-1.571) [-1.57100|1.70560] "rad" Vector__XXX
 SG_ Obj_10_AngleBottomSTD : 326|14@1+ (0.00010,0) [0.00000|1.63830] "rad" Vector__XXX
 SG_ Obj_10_AngleBottomSTDV : 340|1@1+ (1,0) [0|1] "" Vector__XXX

BO_ 278 FVCM_Obj10_B: 64 FVCM
 SG_ OD_10_B_Head_CRC : 0|16@1+ (1,0) [0|65535] "" Vector__XXX
 SG_ OD_10_B_Head_ALIVE : 16|8@1+ (1,0) [0|255] "" Vector__XXX
 SG_ Obj_10_Id_B : 24|8@1+ (1,0) [0|255] "" Vector__XXX
 SG_ Obj_10_SyncCounter_B : 32|8@1+ (1,0) [0|255] "" Vector__XXX
 SG_ Obj_10_AbsLongVelocity : 40|12@1+ (0.05,-100) [-100.00|104.75] "m/s" Vector__XXX
 SG_ Obj_10_AbsLongVelocityV : 52|1@1+ (1,0) [0|1] "" Vector__XXX
 SG_ Obj_10_AbsLongVelocitySTD : 53|13@1+ (0.01,0) [0.00|81.91] "m/s" Vector__XXX
 SG_ Obj_10_AbsLongVelSTDV : 66|1@1+ (1,0) [0|1] "" Vector__XXX
 SG_ Obj_10_AbsLatVelocity : 67|11@1+ (0.05,-50) [-50.00|52.35] "m/s" Vector__XXX
 SG_ Obj_10_AbsLatVelocityV : 78|1@1+ (1,0) [0|1] "" Vector__XXX
 SG_ Obj_10_AbsLatVelocitySTD : 79|13@1+ (0.01,0) [0.00|81.91] "m/s" Vector__XXX
 SG_ Obj_10_AbsLatVelSTDV : 92|1@1+ (1,0) [0|1] "" Vector__XXX
 SG_ Obj_10_AbsLongAcc : 93|9@1+ (0.05,-10) [-10.00|15.55] "m/s²" Vector__XXX
 SG_ Obj_10_AbsLongAccV : 102|1@1+ (1,0) [0|1] "" Vector__XXX
 SG_ Obj_10_AbsLongAccSTD : 103|10@1+ (0.01,0) [0.00|10.23] "m/s²" Vector__XXX
 SG_ Obj_10_AbsLongAccSTDV : 113|1@1+ (1,0) [0|1] "" Vector__XXX
 SG_ Obj_10_AbsLatAcc : 114|9@1+ (0.05,-10) [-10.00|15.55] "m/s²" Vector__XXX
 SG_ Obj_10_AbsLatAccV : 123|1@1+ (1,0) [0|1] "" Vector__XXX
 SG_ Obj_10_AbsLatAccSTD : 124|10@1+ (0.01,0) [0.00|10.23] "m/s²" Vector__XXX
 SG_ Obj_10_AbsLatAccSTDV : 134|1@1+ (1,0) [0|1] "" Vector__XXX
 SG_ Obj_10_AbsAcceleration : 135|9@1+ (0.05,-12.7) [-12.70|12.85] "m/s²" Vector__XXX
 SG_ Obj_10_AbsAccelerationV : 144|1@1+ (1,0) [0|1] "" Vector__XXX
 SG_ Obj_10_AbsAccSTD : 145|10@1+ (0.01,0) [0.00|10.23] "m/s²" Vector__XXX
 SG_ Obj_10_AbsAccSTDV : 155|1@1+ (1,0) [0|1] "" Vector__XXX
 SG_ Obj_10_InvTTC : 156|11@1+ (0.01,-8) [-8.00|12.47] "1/s" Vector__XXX
 SG_ Obj_10_InvTTCV : 167|1@1+ (1,0) [0|1] "" Vector__XXX
 SG_ Obj_10_InvTTCSTD : 168|12@1+ (0.001,0) [0.000|4.095] "1/s" Vector__XXX
 SG_ Obj_10_InvTTCSTDV : 180|1@1+ (1,0) [0|1] "" Vector__XXX
 SG_ Obj_10_RelativeLongAcc : 181|10@1+ (0.05,-20) [-20.00|31.15] "m/s²" Vector__XXX
 SG_ Obj_10_RelativeLongAccV : 191|1@1+ (1,0) [0|1] "" Vector__XXX
 SG_ Obj_10_RelativeLongAccSTD : 192|10@1+ (0.01,0) [0.00|10.23] "m/s²" Vector__XXX
 SG_ Obj_10_RelLongAccSTDV : 202|1@1+ (1,0) [0|1] "" Vector__XXX
 SG_ Obj_10_LongtRltvSpd : 203|13@1+ (0.05,-120) [-120.00|289.55] "m/s" Vector__XXX
 SG_ Obj_10_LongtRltvSpdV : 216|1@1+ (1,0) [0|1] "" Vector__XXX
 SG_ Obj_10_LongtRltvSpdSTD : 217|14@1+ (0.01,0) [0.00|163.83] "m/s" Vector__XXX
 SG_ Obj_10_LongtRltvSpdSTDV : 231|1@1+ (1,0) [0|1] "" Vector__XXX
 SG_ Obj_10_RelativeLatVelocity : 232|11@1+ (0.05,-50) [-50.00|52.35] "m/s" Vector__XXX
 SG_ Obj_10_RelativeLatVelocityV : 243|1@1+ (1,0) [0|1] "" Vector__XXX
 SG_ Obj_10_RelativeLatVelocitySTD : 244|13@1+ (0.01,0) [0.00|81.91] "m/s" Vector__XXX
 SG_ Obj_10_RelLatVelSTDV : 257|1@1+ (1,0) [0|1] "" Vector__XXX
 SG_ Obj_10_LongtRltvDist : 258|14@1+ (0.05,-200) [-200.00|619.15] "m" Vector__XXX
 SG_ Obj_10_LongDistanceV : 272|1@1+ (1,0) [0|1] "" Vector__XXX
 SG_ Obj_10_LongDistanceSTD : 273|15@1+ (0.01,0) [0.00|327.67] "m" Vector__XXX
 SG_ Obj_10_LongDistanceSTDV : 288|1@1+ (1,0) [0|1] "" Vector__XXX
 SG_ Obj_10_LatRltvDist : 289|12@1+ (0.05,-100) [-100.00|104.75] "m" Vector__XXX
 SG_ Obj_10_LatDistanceV : 301|1@1+ (1,0) [0|1] "" Vector__XXX
 SG_ Obj_10_LatDistanceSTD : 302|14@1+ (0.01,0) [0.00|163.83] "m" Vector__XXX
 SG_ Obj_10_LatDistanceSTDV : 316|1@1+ (1,0) [0|1] "" Vector__XXX
 SG_ Obj_10_AbsoluteSpeed : 317|12@1+ (0.05,-65) [-65.00|139.75] "m/s" Vector__XXX
 SG_ Obj_10_AbsoluteSpeedV : 329|1@1+ (1,0) [0|1] "" Vector__XXX
 SG_ Obj_10_AbsoluteSpeedSTD : 330|13@1+ (0.01,0) [0.00|81.91] "m/s" Vector__XXX
 SG_ Obj_10_AbsoluteSpeedSTDV : 343|1@1+ (1,0) [0|1] "" Vector__XXX

BO_ 279 FVCM_Obj11_A: 64 FVCM
 SG_ OD_11_A_Head_CRC : 0|16@1+ (1,0) [0|65535] "" Vector__XXX
 SG_ OD_11_A_Head_ALIVE : 16|8@1+ (1,0) [0|255] "" Vector__XXX
 SG_ Obj_11_Id_A : 24|8@1+ (1,0) [0|255] "" Vector__XXX
 SG_ Obj_11_SyncCounter_A : 32|8@1+ (1,0) [0|255] "" Vector__XXX
 SG_ Obj_11_ExistPrblty : 40|8@1+ (0.01,0) [0.00|2.55] "" Vector__XXX
 SG_ Obj_11_MotionCategory : 48|4@1+ (1,0) [0|15] "" Vector__XXX
 SG_ Obj_11_Age : 52|11@1+ (1,0) [0|2047] "" Vector__XXX
 SG_ Obj_11_MeasSts : 63|3@1+ (1,0) [0|7] "" Vector__XXX
 SG_ Obj_11_Typ : 66|4@1+ (1,0) [0|15] "" Vector__XXX
 SG_ Obj_11_ClassProbability : 70|7@1+ (0.01,0) [0.00|1.27] "" Vector__XXX
 SG_ Obj_11_MotionSts : 77|3@1+ (1,0) [0|7] "" Vector__XXX
 SG_ Obj_11_MotionOrientation : 80|4@1+ (1,0) [0|15] "" Vector__XXX
 SG_ Obj_11_BrakeLight : 84|1@1+ (1,0) [0|1] "" Vector__XXX
 SG_ Obj_11_TurnIndicatorRight : 85|1@1+ (1,0) [0|1] "" Vector__XXX
 SG_ Obj_11_TurnIndicatorLeft : 86|1@1+ (1,0) [0|1] "" Vector__XXX
 SG_ Obj_11_LightIndicatorValidity : 87|1@1+ (1,0) [0|1] "" Vector__XXX
 SG_ Obj_11_LaneAssignment : 88|3@1+ (1,0) [0|7] "" Vector__XXX
 SG_ Obj_11_LaneAssignmentV : 91|1@1+ (1,0) [0|1] "" Vector__XXX
 SG_ Obj_11_Width : 92|9@1+ (0.01,0.4) [0.40|5.51] "m" Vector__XXX
 SG_ Obj_11_WidthV : 101|1@1+ (1,0) [0|1] "" Vector__XXX
 SG_ Obj_11_WidthSTD : 102|11@1+ (0.001,0) [0.000|2.047] "m" Vector__XXX
 SG_ Obj_11_WidthSTDV : 113|1@1+ (1,0) [0|1] "" Vector__XXX
 SG_ Obj_11_Length : 114|9@1+ (0.05,1.2) [1.20|26.75] "m" Vector__XXX
 SG_ Obj_11_LengthV : 123|1@1+ (1,0) [0|1] "" Vector__XXX
 SG_ Obj_11_LengthSTD : 124|10@1+ (0.01,0) [0.00|10.23] "m" Vector__XXX
 SG_ Obj_11_LengthSTDV : 134|1@1+ (1,0) [0|1] "" Vector__XXX
 SG_ Obj_11_RadarID : 135|8@1+ (1,0) [0|255] "" Vector__XXX
 SG_ Obj_11_Height : 143|9@1+ (0.01,0) [0.00|5.11] "m" Vector__XXX
 SG_ Obj_11_HeightV : 152|1@1+ (1,0) [0|1] "" Vector__XXX
 SG_ Obj_11_HeightSTD : 153|11@1+ (0.001,0) [0.000|2.047] "m" Vector__XXX
 SG_ Obj_11_HeightSTDV : 164|1@1+ (1,0) [0|1] "" Vector__XXX
 SG_ Obj_11_Heading : 165|10@1+ (0.01,-3.14) [-3.14|7.09] "rad" Vector__XXX
 SG_ Obj_11_HeadingV : 175|1@1+ (1,0) [0|1] "" Vector__XXX
 SG_ Obj_11_HeadingSTD : 176|15@1+ (0.00010,0) [0.00000|3.27670] "rad" Vector__XXX
 SG_ Obj_11_HeadingSTDV : 191|1@1+ (1,0) [0|1] "" Vector__XXX
 SG_ Obj_11_AngleRateSTD : 192|15@1+ (0.00010,0) [0.00000|3.27670] "RPS" Vector__XXX
 SG_ Obj_11_AngleRateSTDV : 207|1@1+ (1,0) [0|1] "" Vector__XXX
 SG_ Obj_11_AngleRate : 208|12@1+ (0.002,-2.234) [-2.234|5.956] "RPS" Vector__XXX
 SG_ Obj_11_AngleRateV : 220|1@1+ (1,0) [0|1] "" Vector__XXX
 SG_ Obj_11_AngleRight : 221|14@1+ (0.00020,-1.571) [-1.57100|1.70560] "rad" Vector__XXX
 SG_ Obj_11_AngleRightV : 235|1@1+ (1,0) [0|1] "" Vector__XXX
 SG_ Obj_11_AngleRightSTD : 236|14@1+ (0.00010,0) [0.00000|1.63830] "rad" Vector__XXX
 SG_ Obj_11_AngleRightSTDV : 250|1@1+ (1,0) [0|1] "" Vector__XXX
 SG_ Obj_11_AngleLeft : 251|14@1+ (0.00020,-1.571) [-1.57100|1.70560] "rad" Vector__XXX
 SG_ Obj_11_AngleLeftV : 265|1@1+ (1,0) [0|1] "" Vector__XXX
 SG_ Obj_11_AngleLeftSTD : 266|14@1+ (0.00010,0) [0.00000|1.63830] "rad" Vector__XXX
 SG_ Obj_11_AngleLeftSTDV : 280|1@1+ (1,0) [0|1] "" Vector__XXX
 SG_ Obj_11_AngleSide : 281|14@1+ (0.00020,-1.571) [-1.57100|1.70560] "rad" Vector__XXX
 SG_ Obj_11_AngleSideV : 295|1@1+ (1,0) [0|1] "" Vector__XXX
 SG_ Obj_11_AngleSideSTD : 296|14@1+ (0.00010,0) [0.00000|1.63830] "rad" Vector__XXX
 SG_ Obj_11_AngleSideSTDV : 310|1@1+ (1,0) [0|1] "" Vector__XXX
 SG_ Obj_11_AngleBottomV : 311|1@1+ (1,0) [0|1] "" Vector__XXX
 SG_ Obj_11_AngleBottom : 312|14@1+ (0.00020,-1.571) [-1.57100|1.70560] "rad" Vector__XXX
 SG_ Obj_11_AngleBottomSTD : 326|14@1+ (0.00010,0) [0.00000|1.63830] "rad" Vector__XXX
 SG_ Obj_11_AngleBottomSTDV : 340|1@1+ (1,0) [0|1] "" Vector__XXX

BO_ 280 FVCM_Obj11_B: 64 FVCM
 SG_ OD_11_B_Head_CRC : 0|16@1+ (1,0) [0|65535] "" Vector__XXX
 SG_ OD_11_B_Head_ALIVE : 16|8@1+ (1,0) [0|255] "" Vector__XXX
 SG_ Obj_11_Id_B : 24|8@1+ (1,0) [0|255] "" Vector__XXX
 SG_ Obj_11_SyncCounter_B : 32|8@1+ (1,0) [0|255] "" Vector__XXX
 SG_ Obj_11_AbsLongVelocity : 40|12@1+ (0.05,-100) [-100.00|104.75] "m/s" Vector__XXX
 SG_ Obj_11_AbsLongVelocityV : 52|1@1+ (1,0) [0|1] "" Vector__XXX
 SG_ Obj_11_AbsLongVelocitySTD : 53|13@1+ (0.01,0) [0.00|81.91] "m/s" Vector__XXX
 SG_ Obj_11_AbsLongVelSTDV : 66|1@1+ (1,0) [0|1] "" Vector__XXX
 SG_ Obj_11_AbsLatVelocity : 67|11@1+ (0.05,-50) [-50.00|52.35] "m/s" Vector__XXX
 SG_ Obj_11_AbsLatVelocityV : 78|1@1+ (1,0) [0|1] "" Vector__XXX
 SG_ Obj_11_AbsLatVelocitySTD : 79|13@1+ (0.01,0) [0.00|81.91] "m/s" Vector__XXX
 SG_ Obj_11_AbsLatVelSTDV : 92|1@1+ (1,0) [0|1] "" Vector__XXX
 SG_ Obj_11_AbsLongAcc : 93|9@1+ (0.05,-10) [-10.00|15.55] "m/s²" Vector__XXX
 SG_ Obj_11_AbsLongAccV : 102|1@1+ (1,0) [0|1] "" Vector__XXX
 SG_ Obj_11_AbsLongAccSTD : 103|10@1+ (0.01,0) [0.00|10.23] "m/s²" Vector__XXX
 SG_ Obj_11_AbsLongAccSTDV : 113|1@1+ (1,0) [0|1] "" Vector__XXX
 SG_ Obj_11_AbsLatAcc : 114|9@1+ (0.05,-10) [-10.00|15.55] "m/s²" Vector__XXX
 SG_ Obj_11_AbsLatAccV : 123|1@1+ (1,0) [0|1] "" Vector__XXX
 SG_ Obj_11_AbsLatAccSTD : 124|10@1+ (0.01,0) [0.00|10.23] "m/s²" Vector__XXX
 SG_ Obj_11_AbsLatAccSTDV : 134|1@1+ (1,0) [0|1] "" Vector__XXX
 SG_ Obj_11_AbsAcceleration : 135|9@1+ (0.05,-12.7) [-12.70|12.85] "m/s²" Vector__XXX
 SG_ Obj_11_AbsAccelerationV : 144|1@1+ (1,0) [0|1] "" Vector__XXX
 SG_ Obj_11_AbsAccSTD : 145|10@1+ (0.01,0) [0.00|10.23] "m/s²" Vector__XXX
 SG_ Obj_11_AbsAccSTDV : 155|1@1+ (1,0) [0|1] "" Vector__XXX
 SG_ Obj_11_InvTTC : 156|11@1+ (0.01,-8) [-8.00|12.47] "1/s" Vector__XXX
 SG_ Obj_11_InvTTCV : 167|1@1+ (1,0) [0|1] "" Vector__XXX
 SG_ Obj_11_InvTTCSTD : 168|12@1+ (0.001,0) [0.000|4.095] "1/s" Vector__XXX
 SG_ Obj_11_InvTTCSTDV : 180|1@1+ (1,0) [0|1] "" Vector__XXX
 SG_ Obj_11_RelativeLongAcc : 181|10@1+ (0.05,-20) [-20.00|31.15] "m/s²" Vector__XXX
 SG_ Obj_11_RelativeLongAccV : 191|1@1+ (1,0) [0|1] "" Vector__XXX
 SG_ Obj_11_RelativeLongAccSTD : 192|10@1+ (0.01,0) [0.00|10.23] "m/s²" Vector__XXX
 SG_ Obj_11_RelLongAccSTDV : 202|1@1+ (1,0) [0|1] "" Vector__XXX
 SG_ Obj_11_LongtRltvSpd : 203|13@1+ (0.05,-120) [-120.00|289.55] "m/s" Vector__XXX
 SG_ Obj_11_LongtRltvSpdV : 216|1@1+ (1,0) [0|1] "" Vector__XXX
 SG_ Obj_11_LongtRltvSpdSTD : 217|14@1+ (0.01,0) [0.00|163.83] "m/s" Vector__XXX
 SG_ Obj_11_LongtRltvSpdSTDV : 231|1@1+ (1,0) [0|1] "" Vector__XXX
 SG_ Obj_11_RelativeLatVelocity : 232|11@1+ (0.05,-50) [-50.00|52.35] "m/s" Vector__XXX
 SG_ Obj_11_RelativeLatVelocityV : 243|1@1+ (1,0) [0|1] "" Vector__XXX
 SG_ Obj_11_RelativeLatVelocitySTD : 244|13@1+ (0.01,0) [0.00|81.91] "m/s" Vector__XXX
 SG_ Obj_11_RelLatVelSTDV : 257|1@1+ (1,0) [0|1] "" Vector__XXX
 SG_ Obj_11_LongtRltvDist : 258|14@1+ (0.05,-200) [-200.00|619.15] "m" Vector__XXX
 SG_ Obj_11_LongDistanceV : 272|1@1+ (1,0) [0|1] "" Vector__XXX
 SG_ Obj_11_LongDistanceSTD : 273|15@1+ (0.01,0) [0.00|327.67] "m" Vector__XXX
 SG_ Obj_11_LongDistanceSTDV : 288|1@1+ (1,0) [0|1] "" Vector__XXX
 SG_ Obj_11_LatRltvDist : 289|12@1+ (0.05,-100) [-100.00|104.75] "m" Vector__XXX
 SG_ Obj_11_LatDistanceV : 301|1@1+ (1,0) [0|1] "" Vector__XXX
 SG_ Obj_11_LatDistanceSTD : 302|14@1+ (0.01,0) [0.00|163.83] "m" Vector__XXX
 SG_ Obj_11_LatDistanceSTDV : 316|1@1+ (1,0) [0|1] "" Vector__XXX
 SG_ Obj_11_AbsoluteSpeed : 317|12@1+ (0.05,-65) [-65.00|139.75] "m/s" Vector__XXX
 SG_ Obj_11_AbsoluteSpeedV : 329|1@1+ (1,0) [0|1] "" Vector__XXX
 SG_ Obj_11_AbsoluteSpeedSTD : 330|13@1+ (0.01,0) [0.00|81.91] "m/s" Vector__XXX
 SG_ Obj_11_AbsoluteSpeedSTDV : 343|1@1+ (1,0) [0|1] "" Vector__XXX

BO_ 281 FVCM_Obj12_A: 64 FVCM
 SG_ OD_12_A_Head_CRC : 0|16@1+ (1,0) [0|65535] "" Vector__XXX
 SG_ OD_12_A_Head_ALIVE : 16|8@1+ (1,0) [0|255] "" Vector__XXX
 SG_ Obj_12_Id_A : 24|8@1+ (1,0) [0|255] "" Vector__XXX
 SG_ Obj_12_SyncCounter_A : 32|8@1+ (1,0) [0|255] "" Vector__XXX
 SG_ Obj_12_ExistPrblty : 40|8@1+ (0.01,0) [0.00|2.55] "" Vector__XXX
 SG_ Obj_12_MotionCategory : 48|4@1+ (1,0) [0|15] "" Vector__XXX
 SG_ Obj_12_Age : 52|11@1+ (1,0) [0|2047] "" Vector__XXX
 SG_ Obj_12_MeasSts : 63|3@1+ (1,0) [0|7] "" Vector__XXX
 SG_ Obj_12_Typ : 66|4@1+ (1,0) [0|15] "" Vector__XXX
 SG_ Obj_12_ClassProbability : 70|7@1+ (0.01,0) [0.00|1.27] "" Vector__XXX
 SG_ Obj_12_MotionSts : 77|3@1+ (1,0) [0|7] "" Vector__XXX
 SG_ Obj_12_MotionOrientation : 80|4@1+ (1,0) [0|15] "" Vector__XXX
 SG_ Obj_12_BrakeLight : 84|1@1+ (1,0) [0|1] "" Vector__XXX
 SG_ Obj_12_TurnIndicatorRight : 85|1@1+ (1,0) [0|1] "" Vector__XXX
 SG_ Obj_12_TurnIndicatorLeft : 86|1@1+ (1,0) [0|1] "" Vector__XXX
 SG_ Obj_12_LightIndicatorValidity : 87|1@1+ (1,0) [0|1] "" Vector__XXX
 SG_ Obj_12_LaneAssignment : 88|3@1+ (1,0) [0|7] "" Vector__XXX
 SG_ Obj_12_LaneAssignmentV : 91|1@1+ (1,0) [0|1] "" Vector__XXX
 SG_ Obj_12_Width : 92|9@1+ (0.01,0.4) [0.40|5.51] "m" Vector__XXX
 SG_ Obj_12_WidthV : 101|1@1+ (1,0) [0|1] "" Vector__XXX
 SG_ Obj_12_WidthSTD : 102|11@1+ (0.001,0) [0.000|2.047] "m" Vector__XXX
 SG_ Obj_12_WidthSTDV : 113|1@1+ (1,0) [0|1] "" Vector__XXX
 SG_ Obj_12_Length : 114|9@1+ (0.05,1.2) [1.20|26.75] "m" Vector__XXX
 SG_ Obj_12_LengthV : 123|1@1+ (1,0) [0|1] "" Vector__XXX
 SG_ Obj_12_LengthSTD : 124|10@1+ (0.01,0) [0.00|10.23] "m" Vector__XXX
 SG_ Obj_12_LengthSTDV : 134|1@1+ (1,0) [0|1] "" Vector__XXX
 SG_ Obj_12_RadarID : 135|8@1+ (1,0) [0|255] "" Vector__XXX
 SG_ Obj_12_Height : 143|9@1+ (0.01,0) [0.00|5.11] "m" Vector__XXX
 SG_ Obj_12_HeightV : 152|1@1+ (1,0) [0|1] "" Vector__XXX
 SG_ Obj_12_HeightSTD : 153|11@1+ (0.001,0) [0.000|2.047] "m" Vector__XXX
 SG_ Obj_12_HeightSTDV : 164|1@1+ (1,0) [0|1] "" Vector__XXX
 SG_ Obj_12_Heading : 165|10@1+ (0.01,-3.14) [-3.14|7.09] "rad" Vector__XXX
 SG_ Obj_12_HeadingV : 175|1@1+ (1,0) [0|1] "" Vector__XXX
 SG_ Obj_12_HeadingSTD : 176|15@1+ (0.00010,0) [0.00000|3.27670] "rad" Vector__XXX
 SG_ Obj_12_HeadingSTDV : 191|1@1+ (1,0) [0|1] "" Vector__XXX
 SG_ Obj_12_AngleRateSTD : 192|15@1+ (0.00010,0) [0.00000|3.27670] "RPS" Vector__XXX
 SG_ Obj_12_AngleRateSTDV : 207|1@1+ (1,0) [0|1] "" Vector__XXX
 SG_ Obj_12_AngleRate : 208|12@1+ (0.002,-2.234) [-2.234|5.956] "RPS" Vector__XXX
 SG_ Obj_12_AngleRateV : 220|1@1+ (1,0) [0|1] "" Vector__XXX
 SG_ Obj_12_AngleRight : 221|14@1+ (0.00020,-1.571) [-1.57100|1.70560] "rad" Vector__XXX
 SG_ Obj_12_AngleRightV : 235|1@1+ (1,0) [0|1] "" Vector__XXX
 SG_ Obj_12_AngleRightSTD : 236|14@1+ (0.00010,0) [0.00000|1.63830] "rad" Vector__XXX
 SG_ Obj_12_AngleRightSTDV : 250|1@1+ (1,0) [0|1] "" Vector__XXX
 SG_ Obj_12_AngleLeft : 251|14@1+ (0.00020,-1.571) [-1.57100|1.70560] "rad" Vector__XXX
 SG_ Obj_12_AngleLeftV : 265|1@1+ (1,0) [0|1] "" Vector__XXX
 SG_ Obj_12_AngleLeftSTD : 266|14@1+ (0.00010,0) [0.00000|1.63830] "rad" Vector__XXX
 SG_ Obj_12_AngleLeftSTDV : 280|1@1+ (1,0) [0|1] "" Vector__XXX
 SG_ Obj_12_AngleSide : 281|14@1+ (0.00020,-1.571) [-1.57100|1.70560] "rad" Vector__XXX
 SG_ Obj_12_AngleSideV : 295|1@1+ (1,0) [0|1] "" Vector__XXX
 SG_ Obj_12_AngleSideSTD : 296|14@1+ (0.00010,0) [0.00000|1.63830] "rad" Vector__XXX
 SG_ Obj_12_AngleSideSTDV : 310|1@1+ (1,0) [0|1] "" Vector__XXX
 SG_ Obj_12_AngleBottomV : 311|1@1+ (1,0) [0|1] "" Vector__XXX
 SG_ Obj_12_AngleBottom : 312|14@1+ (0.00020,-1.571) [-1.57100|1.70560] "rad" Vector__XXX
 SG_ Obj_12_AngleBottomSTD : 326|14@1+ (0.00010,0) [0.00000|1.63830] "rad" Vector__XXX
 SG_ Obj_12_AngleBottomSTDV : 340|1@1+ (1,0) [0|1] "" Vector__XXX

BO_ 282 FVCM_Obj12_B: 64 FVCM
 SG_ OD_12_B_Head_CRC : 0|16@1+ (1,0) [0|65535] "" Vector__XXX
 SG_ OD_12_B_Head_ALIVE : 16|8@1+ (1,0) [0|255] "" Vector__XXX
 SG_ Obj_12_Id_B : 24|8@1+ (1,0) [0|255] "" Vector__XXX
 SG_ Obj_12_SyncCounter_B : 32|8@1+ (1,0) [0|255] "" Vector__XXX
 SG_ Obj_12_AbsLongVelocity : 40|12@1+ (0.05,-100) [-100.00|104.75] "m/s" Vector__XXX
 SG_ Obj_12_AbsLongVelocityV : 52|1@1+ (1,0) [0|1] "" Vector__XXX
 SG_ Obj_12_AbsLongVelocitySTD : 53|13@1+ (0.01,0) [0.00|81.91] "m/s" Vector__XXX
 SG_ Obj_12_AbsLongVelSTDV : 66|1@1+ (1,0) [0|1] "" Vector__XXX
 SG_ Obj_12_AbsLatVelocity : 67|11@1+ (0.05,-50) [-50.00|52.35] "m/s" Vector__XXX
 SG_ Obj_12_AbsLatVelocityV : 78|1@1+ (1,0) [0|1] "" Vector__XXX
 SG_ Obj_12_AbsLatVelocitySTD : 79|13@1+ (0.01,0) [0.00|81.91] "m/s" Vector__XXX
 SG_ Obj_12_AbsLatVelSTDV : 92|1@1+ (1,0) [0|1] "" Vector__XXX
 SG_ Obj_12_AbsLongAcc : 93|9@1+ (0.05,-10) [-10.00|15.55] "m/s²" Vector__XXX
 SG_ Obj_12_AbsLongAccV : 102|1@1+ (1,0) [0|1] "" Vector__XXX
 SG_ Obj_12_AbsLongAccSTD : 103|10@1+ (0.01,0) [0.00|10.23] "m/s²" Vector__XXX
 SG_ Obj_12_AbsLongAccSTDV : 113|1@1+ (1,0) [0|1] "" Vector__XXX
 SG_ Obj_12_AbsLatAcc : 114|9@1+ (0.05,-10) [-10.00|15.55] "m/s²" Vector__XXX
 SG_ Obj_12_AbsLatAccV : 123|1@1+ (1,0) [0|1] "" Vector__XXX
 SG_ Obj_12_AbsLatAccSTD : 124|10@1+ (0.01,0) [0.00|10.23] "m/s²" Vector__XXX
 SG_ Obj_12_AbsLatAccSTDV : 134|1@1+ (1,0) [0|1] "" Vector__XXX
 SG_ Obj_12_AbsAcceleration : 135|9@1+ (0.05,-12.7) [-12.70|12.85] "m/s²" Vector__XXX
 SG_ Obj_12_AbsAccelerationV : 144|1@1+ (1,0) [0|1] "" Vector__XXX
 SG_ Obj_12_AbsAccSTD : 145|10@1+ (0.01,0) [0.00|10.23] "m/s²" Vector__XXX
 SG_ Obj_12_AbsAccSTDV : 155|1@1+ (1,0) [0|1] "" Vector__XXX
 SG_ Obj_12_InvTTC : 156|11@1+ (0.01,-8) [-8.00|12.47] "1/s" Vector__XXX
 SG_ Obj_12_InvTTCV : 167|1@1+ (1,0) [0|1] "" Vector__XXX
 SG_ Obj_12_InvTTCSTD : 168|12@1+ (0.001,0) [0.000|4.095] "1/s" Vector__XXX
 SG_ Obj_12_InvTTCSTDV : 180|1@1+ (1,0) [0|1] "" Vector__XXX
 SG_ Obj_12_RelativeLongAcc : 181|10@1+ (0.05,-20) [-20.00|31.15] "m/s²" Vector__XXX
 SG_ Obj_12_RelativeLongAccV : 191|1@1+ (1,0) [0|1] "" Vector__XXX
 SG_ Obj_12_RelativeLongAccSTD : 192|10@1+ (0.01,0) [0.00|10.23] "m/s²" Vector__XXX
 SG_ Obj_12_RelLongAccSTDV : 202|1@1+ (1,0) [0|1] "" Vector__XXX
 SG_ Obj_12_LongtRltvSpd : 203|13@1+ (0.05,-120) [-120.00|289.55] "m/s" Vector__XXX
 SG_ Obj_12_LongtRltvSpdV : 216|1@1+ (1,0) [0|1] "" Vector__XXX
 SG_ Obj_12_LongtRltvSpdSTD : 217|14@1+ (0.01,0) [0.00|163.83] "m/s" Vector__XXX
 SG_ Obj_12_LongtRltvSpdSTDV : 231|1@1+ (1,0) [0|1] "" Vector__XXX
 SG_ Obj_12_RelativeLatVelocity : 232|11@1+ (0.05,-50) [-50.00|52.35] "m/s" Vector__XXX
 SG_ Obj_12_RelativeLatVelocityV : 243|1@1+ (1,0) [0|1] "" Vector__XXX
 SG_ Obj_12_RelativeLatVelocitySTD : 244|13@1+ (0.01,0) [0.00|81.91] "m/s" Vector__XXX
 SG_ Obj_12_RelLatVelSTDV : 257|1@1+ (1,0) [0|1] "" Vector__XXX
 SG_ Obj_12_LongtRltvDist : 258|14@1+ (0.05,-200) [-200.00|619.15] "m" Vector__XXX
 SG_ Obj_12_LongDistanceV : 272|1@1+ (1,0) [0|1] "" Vector__XXX
 SG_ Obj_12_LongDistanceSTD : 273|15@1+ (0.01,0) [0.00|327.67] "m" Vector__XXX
 SG_ Obj_12_LongDistanceSTDV : 288|1@1+ (1,0) [0|1] "" Vector__XXX
 SG_ Obj_12_LatRltvDist : 289|12@1+ (0.05,-100) [-100.00|104.75] "m" Vector__XXX
 SG_ Obj_12_LatDistanceV : 301|1@1+ (1,0) [0|1] "" Vector__XXX
 SG_ Obj_12_LatDistanceSTD : 302|14@1+ (0.01,0) [0.00|163.83] "m" Vector__XXX
 SG_ Obj_12_LatDistanceSTDV : 316|1@1+ (1,0) [0|1] "" Vector__XXX
 SG_ Obj_12_AbsoluteSpeed : 317|12@1+ (0.05,-65) [-65.00|139.75] "m/s" Vector__XXX
 SG_ Obj_12_AbsoluteSpeedV : 329|1@1+ (1,0) [0|1] "" Vector__XXX
 SG_ Obj_12_AbsoluteSpeedSTD : 330|13@1+ (0.01,0) [0.00|81.91] "m/s" Vector__XXX
 SG_ Obj_12_AbsoluteSpeedSTDV : 343|1@1+ (1,0) [0|1] "" Vector__XXX

BO_ 283 FVCM_Obj13_A: 64 FVCM
 SG_ OD_13_A_Head_CRC : 0|16@1+ (1,0) [0|65535] "" Vector__XXX
 SG_ OD_13_A_Head_ALIVE : 16|8@1+ (1,0) [0|255] "" Vector__XXX
 SG_ Obj_13_Id_A : 24|8@1+ (1,0) [0|255] "" Vector__XXX
 SG_ Obj_13_SyncCounter_A : 32|8@1+ (1,0) [0|255] "" Vector__XXX
 SG_ Obj_13_ExistPrblty : 40|8@1+ (0.01,0) [0.00|2.55] "" Vector__XXX
 SG_ Obj_13_MotionCategory : 48|4@1+ (1,0) [0|15] "" Vector__XXX
 SG_ Obj_13_Age : 52|11@1+ (1,0) [0|2047] "" Vector__XXX
 SG_ Obj_13_MeasSts : 63|3@1+ (1,0) [0|7] "" Vector__XXX
 SG_ Obj_13_Typ : 66|4@1+ (1,0) [0|15] "" Vector__XXX
 SG_ Obj_13_ClassProbability : 70|7@1+ (0.01,0) [0.00|1.27] "" Vector__XXX
 SG_ Obj_13_MotionSts : 77|3@1+ (1,0) [0|7] "" Vector__XXX
 SG_ Obj_13_MotionOrientation : 80|4@1+ (1,0) [0|15] "" Vector__XXX
 SG_ Obj_13_BrakeLight : 84|1@1+ (1,0) [0|1] "" Vector__XXX
 SG_ Obj_13_TurnIndicatorRight : 85|1@1+ (1,0) [0|1] "" Vector__XXX
 SG_ Obj_13_TurnIndicatorLeft : 86|1@1+ (1,0) [0|1] "" Vector__XXX
 SG_ Obj_13_LightIndicatorValidity : 87|1@1+ (1,0) [0|1] "" Vector__XXX
 SG_ Obj_13_LaneAssignment : 88|3@1+ (1,0) [0|7] "" Vector__XXX
 SG_ Obj_13_LaneAssignmentV : 91|1@1+ (1,0) [0|1] "" Vector__XXX
 SG_ Obj_13_Width : 92|9@1+ (0.01,0.4) [0.40|5.51] "m" Vector__XXX
 SG_ Obj_13_WidthV : 101|1@1+ (1,0) [0|1] "" Vector__XXX
 SG_ Obj_13_WidthSTD : 102|11@1+ (0.001,0) [0.000|2.047] "m" Vector__XXX
 SG_ Obj_13_WidthSTDV : 113|1@1+ (1,0) [0|1] "" Vector__XXX
 SG_ Obj_13_Length : 114|9@1+ (0.05,1.2) [1.20|26.75] "m" Vector__XXX
 SG_ Obj_13_LengthV : 123|1@1+ (1,0) [0|1] "" Vector__XXX
 SG_ Obj_13_LengthSTD : 124|10@1+ (0.01,0) [0.00|10.23] "m" Vector__XXX
 SG_ Obj_13_LengthSTDV : 134|1@1+ (1,0) [0|1] "" Vector__XXX
 SG_ Obj_13_RadarID : 135|8@1+ (1,0) [0|255] "" Vector__XXX
 SG_ Obj_13_Height : 143|9@1+ (0.01,0) [0.00|5.11] "m" Vector__XXX
 SG_ Obj_13_HeightV : 152|1@1+ (1,0) [0|1] "" Vector__XXX
 SG_ Obj_13_HeightSTD : 153|11@1+ (0.001,0) [0.000|2.047] "m" Vector__XXX
 SG_ Obj_13_HeightSTDV : 164|1@1+ (1,0) [0|1] "" Vector__XXX
 SG_ Obj_13_Heading : 165|10@1+ (0.01,-3.14) [-3.14|7.09] "rad" Vector__XXX
 SG_ Obj_13_HeadingV : 175|1@1+ (1,0) [0|1] "" Vector__XXX
 SG_ Obj_13_HeadingSTD : 176|15@1+ (0.00010,0) [0.00000|3.27670] "rad" Vector__XXX
 SG_ Obj_13_HeadingSTDV : 191|1@1+ (1,0) [0|1] "" Vector__XXX
 SG_ Obj_13_AngleRateSTD : 192|15@1+ (0.00010,0) [0.00000|3.27670] "RPS" Vector__XXX
 SG_ Obj_13_AngleRateSTDV : 207|1@1+ (1,0) [0|1] "" Vector__XXX
 SG_ Obj_13_AngleRate : 208|12@1+ (0.002,-2.234) [-2.234|5.956] "RPS" Vector__XXX
 SG_ Obj_13_AngleRateV : 220|1@1+ (1,0) [0|1] "" Vector__XXX
 SG_ Obj_13_AngleRight : 221|14@1+ (0.00020,-1.571) [-1.57100|1.70560] "rad" Vector__XXX
 SG_ Obj_13_AngleRightV : 235|1@1+ (1,0) [0|1] "" Vector__XXX
 SG_ Obj_13_AngleRightSTD : 236|14@1+ (0.00010,0) [0.00000|1.63830] "rad" Vector__XXX
 SG_ Obj_13_AngleRightSTDV : 250|1@1+ (1,0) [0|1] "" Vector__XXX
 SG_ Obj_13_AngleLeft : 251|14@1+ (0.00020,-1.571) [-1.57100|1.70560] "rad" Vector__XXX
 SG_ Obj_13_AngleLeftV : 265|1@1+ (1,0) [0|1] "" Vector__XXX
 SG_ Obj_13_AngleLeftSTD : 266|14@1+ (0.00010,0) [0.00000|1.63830] "rad" Vector__XXX
 SG_ Obj_13_AngleLeftSTDV : 280|1@1+ (1,0) [0|1] "" Vector__XXX
 SG_ Obj_13_AngleSide : 281|14@1+ (0.00020,-1.571) [-1.57100|1.70560] "rad" Vector__XXX
 SG_ Obj_13_AngleSideV : 295|1@1+ (1,0) [0|1] "" Vector__XXX
 SG_ Obj_13_AngleSideSTD : 296|14@1+ (0.00010,0) [0.00000|1.63830] "rad" Vector__XXX
 SG_ Obj_13_AngleSideSTDV : 310|1@1+ (1,0) [0|1] "" Vector__XXX
 SG_ Obj_13_AngleBottomV : 311|1@1+ (1,0) [0|1] "" Vector__XXX
 SG_ Obj_13_AngleBottom : 312|14@1+ (0.00020,-1.571) [-1.57100|1.70560] "rad" Vector__XXX
 SG_ Obj_13_AngleBottomSTD : 326|14@1+ (0.00010,0) [0.00000|1.63830] "rad" Vector__XXX
 SG_ Obj_13_AngleBottomSTDV : 340|1@1+ (1,0) [0|1] "" Vector__XXX

BO_ 284 FVCM_Obj13_B: 64 FVCM
 SG_ OD_13_B_Head_CRC : 0|16@1+ (1,0) [0|65535] "" Vector__XXX
 SG_ OD_13_B_Head_ALIVE : 16|8@1+ (1,0) [0|255] "" Vector__XXX
 SG_ Obj_13_Id_B : 24|8@1+ (1,0) [0|255] "" Vector__XXX
 SG_ Obj_13_SyncCounter_B : 32|8@1+ (1,0) [0|255] "" Vector__XXX
 SG_ Obj_13_AbsLongVelocity : 40|12@1+ (0.05,-100) [-100.00|104.75] "m/s" Vector__XXX
 SG_ Obj_13_AbsLongVelocityV : 52|1@1+ (1,0) [0|1] "" Vector__XXX
 SG_ Obj_13_AbsLongVelocitySTD : 53|13@1+ (0.01,0) [0.00|81.91] "m/s" Vector__XXX
 SG_ Obj_13_AbsLongVelSTDV : 66|1@1+ (1,0) [0|1] "" Vector__XXX
 SG_ Obj_13_AbsLatVelocity : 67|11@1+ (0.05,-50) [-50.00|52.35] "m/s" Vector__XXX
 SG_ Obj_13_AbsLatVelocityV : 78|1@1+ (1,0) [0|1] "" Vector__XXX
 SG_ Obj_13_AbsLatVelocitySTD : 79|13@1+ (0.01,0) [0.00|81.91] "m/s" Vector__XXX
 SG_ Obj_13_AbsLatVelSTDV : 92|1@1+ (1,0) [0|1] "" Vector__XXX
 SG_ Obj_13_AbsLongAcc : 93|9@1+ (0.05,-10) [-10.00|15.55] "m/s²" Vector__XXX
 SG_ Obj_13_AbsLongAccV : 102|1@1+ (1,0) [0|1] "" Vector__XXX
 SG_ Obj_13_AbsLongAccSTD : 103|10@1+ (0.01,0) [0.00|10.23] "m/s²" Vector__XXX
 SG_ Obj_13_AbsLongAccSTDV : 113|1@1+ (1,0) [0|1] "" Vector__XXX
 SG_ Obj_13_AbsLatAcc : 114|9@1+ (0.05,-10) [-10.00|15.55] "m/s²" Vector__XXX
 SG_ Obj_13_AbsLatAccV : 123|1@1+ (1,0) [0|1] "" Vector__XXX
 SG_ Obj_13_AbsLatAccSTD : 124|10@1+ (0.01,0) [0.00|10.23] "m/s²" Vector__XXX
 SG_ Obj_13_AbsLatAccSTDV : 134|1@1+ (1,0) [0|1] "" Vector__XXX
 SG_ Obj_13_AbsAcceleration : 135|9@1+ (0.05,-12.7) [-12.70|12.85] "m/s²" Vector__XXX
 SG_ Obj_13_AbsAccelerationV : 144|1@1+ (1,0) [0|1] "" Vector__XXX
 SG_ Obj_13_AbsAccSTD : 145|10@1+ (0.01,0) [0.00|10.23] "m/s²" Vector__XXX
 SG_ Obj_13_AbsAccSTDV : 155|1@1+ (1,0) [0|1] "" Vector__XXX
 SG_ Obj_13_InvTTC : 156|11@1+ (0.01,-8) [-8.00|12.47] "1/s" Vector__XXX
 SG_ Obj_13_InvTTCV : 167|1@1+ (1,0) [0|1] "" Vector__XXX
 SG_ Obj_13_InvTTCSTD : 168|12@1+ (0.001,0) [0.000|4.095] "1/s" Vector__XXX
 SG_ Obj_13_InvTTCSTDV : 180|1@1+ (1,0) [0|1] "" Vector__XXX
 SG_ Obj_13_RelativeLongAcc : 181|10@1+ (0.05,-20) [-20.00|31.15] "m/s²" Vector__XXX
 SG_ Obj_13_RelativeLongAccV : 191|1@1+ (1,0) [0|1] "" Vector__XXX
 SG_ Obj_13_RelativeLongAccSTD : 192|10@1+ (0.01,0) [0.00|10.23] "m/s²" Vector__XXX
 SG_ Obj_13_RelLongAccSTDV : 202|1@1+ (1,0) [0|1] "" Vector__XXX
 SG_ Obj_13_LongtRltvSpd : 203|13@1+ (0.05,-120) [-120.00|289.55] "m/s" Vector__XXX
 SG_ Obj_13_LongtRltvSpdV : 216|1@1+ (1,0) [0|1] "" Vector__XXX
 SG_ Obj_13_LongtRltvSpdSTD : 217|14@1+ (0.01,0) [0.00|163.83] "m/s" Vector__XXX
 SG_ Obj_13_LongtRltvSpdSTDV : 231|1@1+ (1,0) [0|1] "" Vector__XXX
 SG_ Obj_13_RelativeLatVelocity : 232|11@1+ (0.05,-50) [-50.00|52.35] "m/s" Vector__XXX
 SG_ Obj_13_RelativeLatVelocityV : 243|1@1+ (1,0) [0|1] "" Vector__XXX
 SG_ Obj_13_RelativeLatVelocitySTD : 244|13@1+ (0.01,0) [0.00|81.91] "m/s" Vector__XXX
 SG_ Obj_13_RelLatVelSTDV : 257|1@1+ (1,0) [0|1] "" Vector__XXX
 SG_ Obj_13_LongtRltvDist : 258|14@1+ (0.05,-200) [-200.00|619.15] "m" Vector__XXX
 SG_ Obj_13_LongDistanceV : 272|1@1+ (1,0) [0|1] "" Vector__XXX
 SG_ Obj_13_LongDistanceSTD : 273|15@1+ (0.01,0) [0.00|327.67] "m" Vector__XXX
 SG_ Obj_13_LongDistanceSTDV : 288|1@1+ (1,0) [0|1] "" Vector__XXX
 SG_ Obj_13_LatRltvDist : 289|12@1+ (0.05,-100) [-100.00|104.75] "m" Vector__XXX
 SG_ Obj_13_LatDistanceV : 301|1@1+ (1,0) [0|1] "" Vector__XXX
 SG_ Obj_13_LatDistanceSTD : 302|14@1+ (0.01,0) [0.00|163.83] "m" Vector__XXX
 SG_ Obj_13_LatDistanceSTDV : 316|1@1+ (1,0) [0|1] "" Vector__XXX
 SG_ Obj_13_AbsoluteSpeed : 317|12@1+ (0.05,-65) [-65.00|139.75] "m/s" Vector__XXX
 SG_ Obj_13_AbsoluteSpeedV : 329|1@1+ (1,0) [0|1] "" Vector__XXX
 SG_ Obj_13_AbsoluteSpeedSTD : 330|13@1+ (0.01,0) [0.00|81.91] "m/s" Vector__XXX
 SG_ Obj_13_AbsoluteSpeedSTDV : 343|1@1+ (1,0) [0|1] "" Vector__XXX

BO_ 285 FVCM_Obj14_A: 64 FVCM
 SG_ OD_14_A_Head_CRC : 0|16@1+ (1,0) [0|65535] "" Vector__XXX
 SG_ OD_14_A_Head_ALIVE : 16|8@1+ (1,0) [0|255] "" Vector__XXX
 SG_ Obj_14_Id_A : 24|8@1+ (1,0) [0|255] "" Vector__XXX
 SG_ Obj_14_SyncCounter_A : 32|8@1+ (1,0) [0|255] "" Vector__XXX
 SG_ Obj_14_ExistPrblty : 40|8@1+ (0.01,0) [0.00|2.55] "" Vector__XXX
 SG_ Obj_14_MotionCategory : 48|4@1+ (1,0) [0|15] "" Vector__XXX
 SG_ Obj_14_Age : 52|11@1+ (1,0) [0|2047] "" Vector__XXX
 SG_ Obj_14_MeasSts : 63|3@1+ (1,0) [0|7] "" Vector__XXX
 SG_ Obj_14_Typ : 66|4@1+ (1,0) [0|15] "" Vector__XXX
 SG_ Obj_14_ClassProbability : 70|7@1+ (0.01,0) [0.00|1.27] "" Vector__XXX
 SG_ Obj_14_MotionSts : 77|3@1+ (1,0) [0|7] "" Vector__XXX
 SG_ Obj_14_MotionOrientation : 80|4@1+ (1,0) [0|15] "" Vector__XXX
 SG_ Obj_14_BrakeLight : 84|1@1+ (1,0) [0|1] "" Vector__XXX
 SG_ Obj_14_TurnIndicatorRight : 85|1@1+ (1,0) [0|1] "" Vector__XXX
 SG_ Obj_14_TurnIndicatorLeft : 86|1@1+ (1,0) [0|1] "" Vector__XXX
 SG_ Obj_14_LightIndicatorValidity : 87|1@1+ (1,0) [0|1] "" Vector__XXX
 SG_ Obj_14_LaneAssignment : 88|3@1+ (1,0) [0|7] "" Vector__XXX
 SG_ Obj_14_LaneAssignmentV : 91|1@1+ (1,0) [0|1] "" Vector__XXX
 SG_ Obj_14_Width : 92|9@1+ (0.01,0.4) [0.40|5.51] "m" Vector__XXX
 SG_ Obj_14_WidthV : 101|1@1+ (1,0) [0|1] "" Vector__XXX
 SG_ Obj_14_WidthSTD : 102|11@1+ (0.001,0) [0.000|2.047] "m" Vector__XXX
 SG_ Obj_14_WidthSTDV : 113|1@1+ (1,0) [0|1] "" Vector__XXX
 SG_ Obj_14_Length : 114|9@1+ (0.05,1.2) [1.20|26.75] "m" Vector__XXX
 SG_ Obj_14_LengthV : 123|1@1+ (1,0) [0|1] "" Vector__XXX
 SG_ Obj_14_LengthSTD : 124|10@1+ (0.01,0) [0.00|10.23] "m" Vector__XXX
 SG_ Obj_14_LengthSTDV : 134|1@1+ (1,0) [0|1] "" Vector__XXX
 SG_ Obj_14_RadarID : 135|8@1+ (1,0) [0|255] "" Vector__XXX
 SG_ Obj_14_Height : 143|9@1+ (0.01,0) [0.00|5.11] "m" Vector__XXX
 SG_ Obj_14_HeightV : 152|1@1+ (1,0) [0|1] "" Vector__XXX
 SG_ Obj_14_HeightSTD : 153|11@1+ (0.001,0) [0.000|2.047] "m" Vector__XXX
 SG_ Obj_14_HeightSTDV : 164|1@1+ (1,0) [0|1] "" Vector__XXX
 SG_ Obj_14_Heading : 165|10@1+ (0.01,-3.14) [-3.14|7.09] "rad" Vector__XXX
 SG_ Obj_14_HeadingV : 175|1@1+ (1,0) [0|1] "" Vector__XXX
 SG_ Obj_14_HeadingSTD : 176|15@1+ (0.00010,0) [0.00000|3.27670] "rad" Vector__XXX
 SG_ Obj_14_HeadingSTDV : 191|1@1+ (1,0) [0|1] "" Vector__XXX
 SG_ Obj_14_AngleRateSTD : 192|15@1+ (0.00010,0) [0.00000|3.27670] "RPS" Vector__XXX
 SG_ Obj_14_AngleRateSTDV : 207|1@1+ (1,0) [0|1] "" Vector__XXX
 SG_ Obj_14_AngleRate : 208|12@1+ (0.002,-2.234) [-2.234|5.956] "RPS" Vector__XXX
 SG_ Obj_14_AngleRateV : 220|1@1+ (1,0) [0|1] "" Vector__XXX
 SG_ Obj_14_AngleRight : 221|14@1+ (0.00020,-1.571) [-1.57100|1.70560] "rad" Vector__XXX
 SG_ Obj_14_AngleRightV : 235|1@1+ (1,0) [0|1] "" Vector__XXX
 SG_ Obj_14_AngleRightSTD : 236|14@1+ (0.00010,0) [0.00000|1.63830] "rad" Vector__XXX
 SG_ Obj_14_AngleRightSTDV : 250|1@1+ (1,0) [0|1] "" Vector__XXX
 SG_ Obj_14_AngleLeft : 251|14@1+ (0.00020,-1.571) [-1.57100|1.70560] "rad" Vector__XXX
 SG_ Obj_14_AngleLeftV : 265|1@1+ (1,0) [0|1] "" Vector__XXX
 SG_ Obj_14_AngleLeftSTD : 266|14@1+ (0.00010,0) [0.00000|1.63830] "rad" Vector__XXX
 SG_ Obj_14_AngleLeftSTDV : 280|1@1+ (1,0) [0|1] "" Vector__XXX
 SG_ Obj_14_AngleSide : 281|14@1+ (0.00020,-1.571) [-1.57100|1.70560] "rad" Vector__XXX
 SG_ Obj_14_AngleSideV : 295|1@1+ (1,0) [0|1] "" Vector__XXX
 SG_ Obj_14_AngleSideSTD : 296|14@1+ (0.00010,0) [0.00000|1.63830] "rad" Vector__XXX
 SG_ Obj_14_AngleSideSTDV : 310|1@1+ (1,0) [0|1] "" Vector__XXX
 SG_ Obj_14_AngleBottomV : 311|1@1+ (1,0) [0|1] "" Vector__XXX
 SG_ Obj_14_AngleBottom : 312|14@1+ (0.00020,-1.571) [-1.57100|1.70560] "rad" Vector__XXX
 SG_ Obj_14_AngleBottomSTD : 326|14@1+ (0.00010,0) [0.00000|1.63830] "rad" Vector__XXX
 SG_ Obj_14_AngleBottomSTDV : 340|1@1+ (1,0) [0|1] "" Vector__XXX

BO_ 286 FVCM_Obj14_B: 64 FVCM
 SG_ OD_14_B_Head_CRC : 0|16@1+ (1,0) [0|65535] "" Vector__XXX
 SG_ OD_14_B_Head_ALIVE : 16|8@1+ (1,0) [0|255] "" Vector__XXX
 SG_ Obj_14_Id_B : 24|8@1+ (1,0) [0|255] "" Vector__XXX
 SG_ Obj_14_SyncCounter_B : 32|8@1+ (1,0) [0|255] "" Vector__XXX
 SG_ Obj_14_AbsLongVelocity : 40|12@1+ (0.05,-100) [-100.00|104.75] "m/s" Vector__XXX
 SG_ Obj_14_AbsLongVelocityV : 52|1@1+ (1,0) [0|1] "" Vector__XXX
 SG_ Obj_14_AbsLongVelocitySTD : 53|13@1+ (0.01,0) [0.00|81.91] "m/s" Vector__XXX
 SG_ Obj_14_AbsLongVelSTDV : 66|1@1+ (1,0) [0|1] "" Vector__XXX
 SG_ Obj_14_AbsLatVelocity : 67|11@1+ (0.05,-50) [-50.00|52.35] "m/s" Vector__XXX
 SG_ Obj_14_AbsLatVelocityV : 78|1@1+ (1,0) [0|1] "" Vector__XXX
 SG_ Obj_14_AbsLatVelocitySTD : 79|13@1+ (0.01,0) [0.00|81.91] "m/s" Vector__XXX
 SG_ Obj_14_AbsLatVelSTDV : 92|1@1+ (1,0) [0|1] "" Vector__XXX
 SG_ Obj_14_AbsLongAcc : 93|9@1+ (0.05,-10) [-10.00|15.55] "m/s²" Vector__XXX
 SG_ Obj_14_AbsLongAccV : 102|1@1+ (1,0) [0|1] "" Vector__XXX
 SG_ Obj_14_AbsLongAccSTD : 103|10@1+ (0.01,0) [0.00|10.23] "m/s²" Vector__XXX
 SG_ Obj_14_AbsLongAccSTDV : 113|1@1+ (1,0) [0|1] "" Vector__XXX
 SG_ Obj_14_AbsLatAcc : 114|9@1+ (0.05,-10) [-10.00|15.55] "m/s²" Vector__XXX
 SG_ Obj_14_AbsLatAccV : 123|1@1+ (1,0) [0|1] "" Vector__XXX
 SG_ Obj_14_AbsLatAccSTD : 124|10@1+ (0.01,0) [0.00|10.23] "m/s²" Vector__XXX
 SG_ Obj_14_AbsLatAccSTDV : 134|1@1+ (1,0) [0|1] "" Vector__XXX
 SG_ Obj_14_AbsAcceleration : 135|9@1+ (0.05,-12.7) [-12.70|12.85] "m/s²" Vector__XXX
 SG_ Obj_14_AbsAccelerationV : 144|1@1+ (1,0) [0|1] "" Vector__XXX
 SG_ Obj_14_AbsAccSTD : 145|10@1+ (0.01,0) [0.00|10.23] "m/s²" Vector__XXX
 SG_ Obj_14_AbsAccSTDV : 155|1@1+ (1,0) [0|1] "" Vector__XXX
 SG_ Obj_14_InvTTC : 156|11@1+ (0.01,-8) [-8.00|12.47] "1/s" Vector__XXX
 SG_ Obj_14_InvTTCV : 167|1@1+ (1,0) [0|1] "" Vector__XXX
 SG_ Obj_14_InvTTCSTD : 168|12@1+ (0.001,0) [0.000|4.095] "1/s" Vector__XXX
 SG_ Obj_14_InvTTCSTDV : 180|1@1+ (1,0) [0|1] "" Vector__XXX
 SG_ Obj_14_RelativeLongAcc : 181|10@1+ (0.05,-20) [-20.00|31.15] "m/s²" Vector__XXX
 SG_ Obj_14_RelativeLongAccV : 191|1@1+ (1,0) [0|1] "" Vector__XXX
 SG_ Obj_14_RelativeLongAccSTD : 192|10@1+ (0.01,0) [0.00|10.23] "m/s²" Vector__XXX
 SG_ Obj_14_RelLongAccSTDV : 202|1@1+ (1,0) [0|1] "" Vector__XXX
 SG_ Obj_14_LongtRltvSpd : 203|13@1+ (0.05,-120) [-120.00|289.55] "m/s" Vector__XXX
 SG_ Obj_14_LongtRltvSpdV : 216|1@1+ (1,0) [0|1] "" Vector__XXX
 SG_ Obj_14_LongtRltvSpdSTD : 217|14@1+ (0.01,0) [0.00|163.83] "m/s" Vector__XXX
 SG_ Obj_14_LongtRltvSpdSTDV : 231|1@1+ (1,0) [0|1] "" Vector__XXX
 SG_ Obj_14_RelativeLatVelocity : 232|11@1+ (0.05,-50) [-50.00|52.35] "m/s" Vector__XXX
 SG_ Obj_14_RelativeLatVelocityV : 243|1@1+ (1,0) [0|1] "" Vector__XXX
 SG_ Obj_14_RelativeLatVelocitySTD : 244|13@1+ (0.01,0) [0.00|81.91] "m/s" Vector__XXX
 SG_ Obj_14_RelLatVelSTDV : 257|1@1+ (1,0) [0|1] "" Vector__XXX
 SG_ Obj_14_LongtRltvDist : 258|14@1+ (0.05,-200) [-200.00|619.15] "m" Vector__XXX
 SG_ Obj_14_LongDistanceV : 272|1@1+ (1,0) [0|1] "" Vector__XXX
 SG_ Obj_14_LongDistanceSTD : 273|15@1+ (0.01,0) [0.00|327.67] "m" Vector__XXX
 SG_ Obj_14_LongDistanceSTDV : 288|1@1+ (1,0) [0|1] "" Vector__XXX
 SG_ Obj_14_LatRltvDist : 289|12@1+ (0.05,-100) [-100.00|104.75] "m" Vector__XXX
 SG_ Obj_14_LatDistanceV : 301|1@1+ (1,0) [0|1] "" Vector__XXX
 SG_ Obj_14_LatDistanceSTD : 302|14@1+ (0.01,0) [0.00|163.83] "m" Vector__XXX
 SG_ Obj_14_LatDistanceSTDV : 316|1@1+ (1,0) [0|1] "" Vector__XXX
 SG_ Obj_14_AbsoluteSpeed : 317|12@1+ (0.05,-65) [-65.00|139.75] "m/s" Vector__XXX
 SG_ Obj_14_AbsoluteSpeedV : 329|1@1+ (1,0) [0|1] "" Vector__XXX
 SG_ Obj_14_AbsoluteSpeedSTD : 330|13@1+ (0.01,0) [0.00|81.91] "m/s" Vector__XXX
 SG_ Obj_14_AbsoluteSpeedSTDV : 343|1@1+ (1,0) [0|1] "" Vector__XXX

BO_ 287 FVCM_Obj15_A: 64 FVCM
 SG_ OD_15_A_Head_CRC : 0|16@1+ (1,0) [0|65535] "" Vector__XXX
 SG_ OD_15_A_Head_ALIVE : 16|8@1+ (1,0) [0|255] "" Vector__XXX
 SG_ Obj_15_Id_A : 24|8@1+ (1,0) [0|255] "" Vector__XXX
 SG_ Obj_15_SyncCounter_A : 32|8@1+ (1,0) [0|255] "" Vector__XXX
 SG_ Obj_15_ExistPrblty : 40|8@1+ (0.01,0) [0.00|2.55] "" Vector__XXX
 SG_ Obj_15_MotionCategory : 48|4@1+ (1,0) [0|15] "" Vector__XXX
 SG_ Obj_15_Age : 52|11@1+ (1,0) [0|2047] "" Vector__XXX
 SG_ Obj_15_MeasSts : 63|3@1+ (1,0) [0|7] "" Vector__XXX
 SG_ Obj_15_Typ : 66|4@1+ (1,0) [0|15] "" Vector__XXX
 SG_ Obj_15_ClassProbability : 70|7@1+ (0.01,0) [0.00|1.27] "" Vector__XXX
 SG_ Obj_15_MotionSts : 77|3@1+ (1,0) [0|7] "" Vector__XXX
 SG_ Obj_15_MotionOrientation : 80|4@1+ (1,0) [0|15] "" Vector__XXX
 SG_ Obj_15_BrakeLight : 84|1@1+ (1,0) [0|1] "" Vector__XXX
 SG_ Obj_15_TurnIndicatorRight : 85|1@1+ (1,0) [0|1] "" Vector__XXX
 SG_ Obj_15_TurnIndicatorLeft : 86|1@1+ (1,0) [0|1] "" Vector__XXX
 SG_ Obj_15_LightIndicatorValidity : 87|1@1+ (1,0) [0|1] "" Vector__XXX
 SG_ Obj_15_LaneAssignment : 88|3@1+ (1,0) [0|7] "" Vector__XXX
 SG_ Obj_15_LaneAssignmentV : 91|1@1+ (1,0) [0|1] "" Vector__XXX
 SG_ Obj_15_Width : 92|9@1+ (0.01,0.4) [0.40|5.51] "m" Vector__XXX
 SG_ Obj_15_WidthV : 101|1@1+ (1,0) [0|1] "" Vector__XXX
 SG_ Obj_15_WidthSTD : 102|11@1+ (0.001,0) [0.000|2.047] "m" Vector__XXX
 SG_ Obj_15_WidthSTDV : 113|1@1+ (1,0) [0|1] "" Vector__XXX
 SG_ Obj_15_Length : 114|9@1+ (0.05,1.2) [1.20|26.75] "m" Vector__XXX
 SG_ Obj_15_LengthV : 123|1@1+ (1,0) [0|1] "" Vector__XXX
 SG_ Obj_15_LengthSTD : 124|10@1+ (0.01,0) [0.00|10.23] "m" Vector__XXX
 SG_ Obj_15_LengthSTDV : 134|1@1+ (1,0) [0|1] "" Vector__XXX
 SG_ Obj_15_RadarID : 135|8@1+ (1,0) [0|255] "" Vector__XXX
 SG_ Obj_15_Height : 143|9@1+ (0.01,0) [0.00|5.11] "m" Vector__XXX
 SG_ Obj_15_HeightV : 152|1@1+ (1,0) [0|1] "" Vector__XXX
 SG_ Obj_15_HeightSTD : 153|11@1+ (0.001,0) [0.000|2.047] "m" Vector__XXX
 SG_ Obj_15_HeightSTDV : 164|1@1+ (1,0) [0|1] "" Vector__XXX
 SG_ Obj_15_Heading : 165|10@1+ (0.01,-3.14) [-3.14|7.09] "rad" Vector__XXX
 SG_ Obj_15_HeadingV : 175|1@1+ (1,0) [0|1] "" Vector__XXX
 SG_ Obj_15_HeadingSTD : 176|15@1+ (0.00010,0) [0.00000|3.27670] "rad" Vector__XXX
 SG_ Obj_15_HeadingSTDV : 191|1@1+ (1,0) [0|1] "" Vector__XXX
 SG_ Obj_15_AngleRateSTD : 192|15@1+ (0.00010,0) [0.00000|3.27670] "RPS" Vector__XXX
 SG_ Obj_15_AngleRateSTDV : 207|1@1+ (1,0) [0|1] "" Vector__XXX
 SG_ Obj_15_AngleRate : 208|12@1+ (0.002,-2.234) [-2.234|5.956] "RPS" Vector__XXX
 SG_ Obj_15_AngleRateV : 220|1@1+ (1,0) [0|1] "" Vector__XXX
 SG_ Obj_15_AngleRight : 221|14@1+ (0.00020,-1.571) [-1.57100|1.70560] "rad" Vector__XXX
 SG_ Obj_15_AngleRightV : 235|1@1+ (1,0) [0|1] "" Vector__XXX
 SG_ Obj_15_AngleRightSTD : 236|14@1+ (0.00010,0) [0.00000|1.63830] "rad" Vector__XXX
 SG_ Obj_15_AngleRightSTDV : 250|1@1+ (1,0) [0|1] "" Vector__XXX
 SG_ Obj_15_AngleLeft : 251|14@1+ (0.00020,-1.571) [-1.57100|1.70560] "rad" Vector__XXX
 SG_ Obj_15_AngleLeftV : 265|1@1+ (1,0) [0|1] "" Vector__XXX
 SG_ Obj_15_AngleLeftSTD : 266|14@1+ (0.00010,0) [0.00000|1.63830] "rad" Vector__XXX
 SG_ Obj_15_AngleLeftSTDV : 280|1@1+ (1,0) [0|1] "" Vector__XXX
 SG_ Obj_15_AngleSide : 281|14@1+ (0.00020,-1.571) [-1.57100|1.70560] "rad" Vector__XXX
 SG_ Obj_15_AngleSideV : 295|1@1+ (1,0) [0|1] "" Vector__XXX
 SG_ Obj_15_AngleSideSTD : 296|14@1+ (0.00010,0) [0.00000|1.63830] "rad" Vector__XXX
 SG_ Obj_15_AngleSideSTDV : 310|1@1+ (1,0) [0|1] "" Vector__XXX
 SG_ Obj_15_AngleBottomV : 311|1@1+ (1,0) [0|1] "" Vector__XXX
 SG_ Obj_15_AngleBottom : 312|14@1+ (0.00020,-1.571) [-1.57100|1.70560] "rad" Vector__XXX
 SG_ Obj_15_AngleBottomSTD : 326|14@1+ (0.00010,0) [0.00000|1.63830] "rad" Vector__XXX
 SG_ Obj_15_AngleBottomSTDV : 340|1@1+ (1,0) [0|1] "" Vector__XXX

BO_ 288 FVCM_Obj15_B: 64 FVCM
 SG_ OD_15_B_Head_CRC : 0|16@1+ (1,0) [0|65535] "" Vector__XXX
 SG_ OD_15_B_Head_ALIVE : 16|8@1+ (1,0) [0|255] "" Vector__XXX
 SG_ Obj_15_Id_B : 24|8@1+ (1,0) [0|255] "" Vector__XXX
 SG_ Obj_15_SyncCounter_B : 32|8@1+ (1,0) [0|255] "" Vector__XXX
 SG_ Obj_15_AbsLongVelocity : 40|12@1+ (0.05,-100) [-100.00|104.75] "m/s" Vector__XXX
 SG_ Obj_15_AbsLongVelocityV : 52|1@1+ (1,0) [0|1] "" Vector__XXX
 SG_ Obj_15_AbsLongVelocitySTD : 53|13@1+ (0.01,0) [0.00|81.91] "m/s" Vector__XXX
 SG_ Obj_15_AbsLongVelSTDV : 66|1@1+ (1,0) [0|1] "" Vector__XXX
 SG_ Obj_15_AbsLatVelocity : 67|11@1+ (0.05,-50) [-50.00|52.35] "m/s" Vector__XXX
 SG_ Obj_15_AbsLatVelocityV : 78|1@1+ (1,0) [0|1] "" Vector__XXX
 SG_ Obj_15_AbsLatVelocitySTD : 79|13@1+ (0.01,0) [0.00|81.91] "m/s" Vector__XXX
 SG_ Obj_15_AbsLatVelSTDV : 92|1@1+ (1,0) [0|1] "" Vector__XXX
 SG_ Obj_15_AbsLongAcc : 93|9@1+ (0.05,-10) [-10.00|15.55] "m/s²" Vector__XXX
 SG_ Obj_15_AbsLongAccV : 102|1@1+ (1,0) [0|1] "" Vector__XXX
 SG_ Obj_15_AbsLongAccSTD : 103|10@1+ (0.01,0) [0.00|10.23] "m/s²" Vector__XXX
 SG_ Obj_15_AbsLongAccSTDV : 113|1@1+ (1,0) [0|1] "" Vector__XXX
 SG_ Obj_15_AbsLatAcc : 114|9@1+ (0.05,-10) [-10.00|15.55] "m/s²" Vector__XXX
 SG_ Obj_15_AbsLatAccV : 123|1@1+ (1,0) [0|1] "" Vector__XXX
 SG_ Obj_15_AbsLatAccSTD : 124|10@1+ (0.01,0) [0.00|10.23] "m/s²" Vector__XXX
 SG_ Obj_15_AbsLatAccSTDV : 134|1@1+ (1,0) [0|1] "" Vector__XXX
 SG_ Obj_15_AbsAcceleration : 135|9@1+ (0.05,-12.7) [-12.70|12.85] "m/s²" Vector__XXX
 SG_ Obj_15_AbsAccelerationV : 144|1@1+ (1,0) [0|1] "" Vector__XXX
 SG_ Obj_15_AbsAccSTD : 145|10@1+ (0.01,0) [0.00|10.23] "m/s²" Vector__XXX
 SG_ Obj_15_AbsAccSTDV : 155|1@1+ (1,0) [0|1] "" Vector__XXX
 SG_ Obj_15_InvTTC : 156|11@1+ (0.01,-8) [-8.00|12.47] "1/s" Vector__XXX
 SG_ Obj_15_InvTTCV : 167|1@1+ (1,0) [0|1] "" Vector__XXX
 SG_ Obj_15_InvTTCSTD : 168|12@1+ (0.001,0) [0.000|4.095] "1/s" Vector__XXX
 SG_ Obj_15_InvTTCSTDV : 180|1@1+ (1,0) [0|1] "" Vector__XXX
 SG_ Obj_15_RelativeLongAcc : 181|10@1+ (0.05,-20) [-20.00|31.15] "m/s²" Vector__XXX
 SG_ Obj_15_RelativeLongAccV : 191|1@1+ (1,0) [0|1] "" Vector__XXX
 SG_ Obj_15_RelativeLongAccSTD : 192|10@1+ (0.01,0) [0.00|10.23] "m/s²" Vector__XXX
 SG_ Obj_15_RelLongAccSTDV : 202|1@1+ (1,0) [0|1] "" Vector__XXX
 SG_ Obj_15_LongtRltvSpd : 203|13@1+ (0.05,-120) [-120.00|289.55] "m/s" Vector__XXX
 SG_ Obj_15_LongtRltvSpdV : 216|1@1+ (1,0) [0|1] "" Vector__XXX
 SG_ Obj_15_LongtRltvSpdSTD : 217|14@1+ (0.01,0) [0.00|163.83] "m/s" Vector__XXX
 SG_ Obj_15_LongtRltvSpdSTDV : 231|1@1+ (1,0) [0|1] "" Vector__XXX
 SG_ Obj_15_RelativeLatVelocity : 232|11@1+ (0.05,-50) [-50.00|52.35] "m/s" Vector__XXX
 SG_ Obj_15_RelativeLatVelocityV : 243|1@1+ (1,0) [0|1] "" Vector__XXX
 SG_ Obj_15_RelativeLatVelocitySTD : 244|13@1+ (0.01,0) [0.00|81.91] "m/s" Vector__XXX
 SG_ Obj_15_RelLatVelSTDV : 257|1@1+ (1,0) [0|1] "" Vector__XXX
 SG_ Obj_15_LongtRltvDist : 258|14@1+ (0.05,-200) [-200.00|619.15] "m" Vector__XXX
 SG_ Obj_15_LongDistanceV : 272|1@1+ (1,0) [0|1] "" Vector__XXX
 SG_ Obj_15_LongDistanceSTD : 273|15@1+ (0.01,0) [0.00|327.67] "m" Vector__XXX
 SG_ Obj_15_LongDistanceSTDV : 288|1@1+ (1,0) [0|1] "" Vector__XXX
 SG_ Obj_15_LatRltvDist : 289|12@1+ (0.05,-100) [-100.00|104.75] "m" Vector__XXX
 SG_ Obj_15_LatDistanceV : 301|1@1+ (1,0) [0|1] "" Vector__XXX
 SG_ Obj_15_LatDistanceSTD : 302|14@1+ (0.01,0) [0.00|163.83] "m" Vector__XXX
 SG_ Obj_15_LatDistanceSTDV : 316|1@1+ (1,0) [0|1] "" Vector__XXX
 SG_ Obj_15_AbsoluteSpeed : 317|12@1+ (0.05,-65) [-65.00|139.75] "m/s" Vector__XXX
 SG_ Obj_15_AbsoluteSpeedV : 329|1@1+ (1,0) [0|1] "" Vector__XXX
 SG_ Obj_15_AbsoluteSpeedSTD : 330|13@1+ (0.01,0) [0.00|81.91] "m/s" Vector__XXX
 SG_ Obj_15_AbsoluteSpeedSTDV : 343|1@1+ (1,0) [0|1] "" Vector__XXX

BO_ 289 FVCM_Obj16_A: 64 FVCM
 SG_ OD_16_A_Head_CRC : 0|16@1+ (1,0) [0|65535] "" Vector__XXX
 SG_ OD_16_A_Head_ALIVE : 16|8@1+ (1,0) [0|255] "" Vector__XXX
 SG_ Obj_16_Id_A : 24|8@1+ (1,0) [0|255] "" Vector__XXX
 SG_ Obj_16_SyncCounter_A : 32|8@1+ (1,0) [0|255] "" Vector__XXX
 SG_ Obj_16_ExistPrblty : 40|8@1+ (0.01,0) [0.00|2.55] "" Vector__XXX
 SG_ Obj_16_MotionCategory : 48|4@1+ (1,0) [0|15] "" Vector__XXX
 SG_ Obj_16_Age : 52|11@1+ (1,0) [0|2047] "" Vector__XXX
 SG_ Obj_16_MeasSts : 63|3@1+ (1,0) [0|7] "" Vector__XXX
 SG_ Obj_16_Typ : 66|4@1+ (1,0) [0|15] "" Vector__XXX
 SG_ Obj_16_ClassProbability : 70|7@1+ (0.01,0) [0.00|1.27] "" Vector__XXX
 SG_ Obj_16_MotionSts : 77|3@1+ (1,0) [0|7] "" Vector__XXX
 SG_ Obj_16_MotionOrientation : 80|4@1+ (1,0) [0|15] "" Vector__XXX
 SG_ Obj_16_BrakeLight : 84|1@1+ (1,0) [0|1] "" Vector__XXX
 SG_ Obj_16_TurnIndicatorRight : 85|1@1+ (1,0) [0|1] "" Vector__XXX
 SG_ Obj_16_TurnIndicatorLeft : 86|1@1+ (1,0) [0|1] "" Vector__XXX
 SG_ Obj_16_LightIndicatorValidity : 87|1@1+ (1,0) [0|1] "" Vector__XXX
 SG_ Obj_16_LaneAssignment : 88|3@1+ (1,0) [0|7] "" Vector__XXX
 SG_ Obj_16_LaneAssignmentV : 91|1@1+ (1,0) [0|1] "" Vector__XXX
 SG_ Obj_16_Width : 92|9@1+ (0.01,0.4) [0.40|5.51] "m" Vector__XXX
 SG_ Obj_16_WidthV : 101|1@1+ (1,0) [0|1] "" Vector__XXX
 SG_ Obj_16_WidthSTD : 102|11@1+ (0.001,0) [0.000|2.047] "m" Vector__XXX
 SG_ Obj_16_WidthSTDV : 113|1@1+ (1,0) [0|1] "" Vector__XXX
 SG_ Obj_16_Length : 114|9@1+ (0.05,1.2) [1.20|26.75] "m" Vector__XXX
 SG_ Obj_16_LengthV : 123|1@1+ (1,0) [0|1] "" Vector__XXX
 SG_ Obj_16_LengthSTD : 124|10@1+ (0.01,0) [0.00|10.23] "m" Vector__XXX
 SG_ Obj_16_LengthSTDV : 134|1@1+ (1,0) [0|1] "" Vector__XXX
 SG_ Obj_16_RadarID : 135|8@1+ (1,0) [0|255] "" Vector__XXX
 SG_ Obj_16_Height : 143|9@1+ (0.01,0) [0.00|5.11] "m" Vector__XXX
 SG_ Obj_16_HeightV : 152|1@1+ (1,0) [0|1] "" Vector__XXX
 SG_ Obj_16_HeightSTD : 153|11@1+ (0.001,0) [0.000|2.047] "m" Vector__XXX
 SG_ Obj_16_HeightSTDV : 164|1@1+ (1,0) [0|1] "" Vector__XXX
 SG_ Obj_16_Heading : 165|10@1+ (0.01,-3.14) [-3.14|7.09] "rad" Vector__XXX
 SG_ Obj_16_HeadingV : 175|1@1+ (1,0) [0|1] "" Vector__XXX
 SG_ Obj_16_HeadingSTD : 176|15@1+ (0.00010,0) [0.00000|3.27670] "rad" Vector__XXX
 SG_ Obj_16_HeadingSTDV : 191|1@1+ (1,0) [0|1] "" Vector__XXX
 SG_ Obj_16_AngleRateSTD : 192|15@1+ (0.00010,0) [0.00000|3.27670] "RPS" Vector__XXX
 SG_ Obj_16_AngleRateSTDV : 207|1@1+ (1,0) [0|1] "" Vector__XXX
 SG_ Obj_16_AngleRate : 208|12@1+ (0.002,-2.234) [-2.234|5.956] "RPS" Vector__XXX
 SG_ Obj_16_AngleRateV : 220|1@1+ (1,0) [0|1] "" Vector__XXX
 SG_ Obj_16_AngleRight : 221|14@1+ (0.00020,-1.571) [-1.57100|1.70560] "rad" Vector__XXX
 SG_ Obj_16_AngleRightV : 235|1@1+ (1,0) [0|1] "" Vector__XXX
 SG_ Obj_16_AngleRightSTD : 236|14@1+ (0.00010,0) [0.00000|1.63830] "rad" Vector__XXX
 SG_ Obj_16_AngleRightSTDV : 250|1@1+ (1,0) [0|1] "" Vector__XXX
 SG_ Obj_16_AngleLeft : 251|14@1+ (0.00020,-1.571) [-1.57100|1.70560] "rad" Vector__XXX
 SG_ Obj_16_AngleLeftV : 265|1@1+ (1,0) [0|1] "" Vector__XXX
 SG_ Obj_16_AngleLeftSTD : 266|14@1+ (0.00010,0) [0.00000|1.63830] "rad" Vector__XXX
 SG_ Obj_16_AngleLeftSTDV : 280|1@1+ (1,0) [0|1] "" Vector__XXX
 SG_ Obj_16_AngleSide : 281|14@1+ (0.00020,-1.571) [-1.57100|1.70560] "rad" Vector__XXX
 SG_ Obj_16_AngleSideV : 295|1@1+ (1,0) [0|1] "" Vector__XXX
 SG_ Obj_16_AngleSideSTD : 296|14@1+ (0.00010,0) [0.00000|1.63830] "rad" Vector__XXX
 SG_ Obj_16_AngleSideSTDV : 310|1@1+ (1,0) [0|1] "" Vector__XXX
 SG_ Obj_16_AngleBottomV : 311|1@1+ (1,0) [0|1] "" Vector__XXX
 SG_ Obj_16_AngleBottom : 312|14@1+ (0.00020,-1.571) [-1.57100|1.70560] "rad" Vector__XXX
 SG_ Obj_16_AngleBottomSTD : 326|14@1+ (0.00010,0) [0.00000|1.63830] "rad" Vector__XXX
 SG_ Obj_16_AngleBottomSTDV : 340|1@1+ (1,0) [0|1] "" Vector__XXX

BO_ 290 FVCM_Obj16_B: 64 FVCM
 SG_ OD_16_B_Head_CRC : 0|16@1+ (1,0) [0|65535] "" Vector__XXX
 SG_ OD_16_B_Head_ALIVE : 16|8@1+ (1,0) [0|255] "" Vector__XXX
 SG_ Obj_16_Id_B : 24|8@1+ (1,0) [0|255] "" Vector__XXX
 SG_ Obj_16_SyncCounter_B : 32|8@1+ (1,0) [0|255] "" Vector__XXX
 SG_ Obj_16_AbsLongVelocity : 40|12@1+ (0.05,-100) [-100.00|104.75] "m/s" Vector__XXX
 SG_ Obj_16_AbsLongVelocityV : 52|1@1+ (1,0) [0|1] "" Vector__XXX
 SG_ Obj_16_AbsLongVelocitySTD : 53|13@1+ (0.01,0) [0.00|81.91] "m/s" Vector__XXX
 SG_ Obj_16_AbsLongVelSTDV : 66|1@1+ (1,0) [0|1] "" Vector__XXX
 SG_ Obj_16_AbsLatVelocity : 67|11@1+ (0.05,-50) [-50.00|52.35] "m/s" Vector__XXX
 SG_ Obj_16_AbsLatVelocityV : 78|1@1+ (1,0) [0|1] "" Vector__XXX
 SG_ Obj_16_AbsLatVelocitySTD : 79|13@1+ (0.01,0) [0.00|81.91] "m/s" Vector__XXX
 SG_ Obj_16_AbsLatVelSTDV : 92|1@1+ (1,0) [0|1] "" Vector__XXX
 SG_ Obj_16_AbsLongAcc : 93|9@1+ (0.05,-10) [-10.00|15.55] "m/s²" Vector__XXX
 SG_ Obj_16_AbsLongAccV : 102|1@1+ (1,0) [0|1] "" Vector__XXX
 SG_ Obj_16_AbsLongAccSTD : 103|10@1+ (0.01,0) [0.00|10.23] "m/s²" Vector__XXX
 SG_ Obj_16_AbsLongAccSTDV : 113|1@1+ (1,0) [0|1] "" Vector__XXX
 SG_ Obj_16_AbsLatAcc : 114|9@1+ (0.05,-10) [-10.00|15.55] "m/s²" Vector__XXX
 SG_ Obj_16_AbsLatAccV : 123|1@1+ (1,0) [0|1] "" Vector__XXX
 SG_ Obj_16_AbsLatAccSTD : 124|10@1+ (0.01,0) [0.00|10.23] "m/s²" Vector__XXX
 SG_ Obj_16_AbsLatAccSTDV : 134|1@1+ (1,0) [0|1] "" Vector__XXX
 SG_ Obj_16_AbsAcceleration : 135|9@1+ (0.05,-12.7) [-12.70|12.85] "m/s²" Vector__XXX
 SG_ Obj_16_AbsAccelerationV : 144|1@1+ (1,0) [0|1] "" Vector__XXX
 SG_ Obj_16_AbsAccSTD : 145|10@1+ (0.01,0) [0.00|10.23] "m/s²" Vector__XXX
 SG_ Obj_16_AbsAccSTDV : 155|1@1+ (1,0) [0|1] "" Vector__XXX
 SG_ Obj_16_InvTTC : 156|11@1+ (0.01,-8) [-8.00|12.47] "1/s" Vector__XXX
 SG_ Obj_16_InvTTCV : 167|1@1+ (1,0) [0|1] "" Vector__XXX
 SG_ Obj_16_InvTTCSTD : 168|12@1+ (0.001,0) [0.000|4.095] "1/s" Vector__XXX
 SG_ Obj_16_InvTTCSTDV : 180|1@1+ (1,0) [0|1] "" Vector__XXX
 SG_ Obj_16_RelativeLongAcc : 181|10@1+ (0.05,-20) [-20.00|31.15] "m/s²" Vector__XXX
 SG_ Obj_16_RelativeLongAccV : 191|1@1+ (1,0) [0|1] "" Vector__XXX
 SG_ Obj_16_RelativeLongAccSTD : 192|10@1+ (0.01,0) [0.00|10.23] "m/s²" Vector__XXX
 SG_ Obj_16_RelLongAccSTDV : 202|1@1+ (1,0) [0|1] "" Vector__XXX
 SG_ Obj_16_LongtRltvSpd : 203|13@1+ (0.05,-120) [-120.00|289.55] "m/s" Vector__XXX
 SG_ Obj_16_LongtRltvSpdV : 216|1@1+ (1,0) [0|1] "" Vector__XXX
 SG_ Obj_16_LongtRltvSpdSTD : 217|14@1+ (0.01,0) [0.00|163.83] "m/s" Vector__XXX
 SG_ Obj_16_LongtRltvSpdSTDV : 231|1@1+ (1,0) [0|1] "" Vector__XXX
 SG_ Obj_16_RelativeLatVelocity : 232|11@1+ (0.05,-50) [-50.00|52.35] "m/s" Vector__XXX
 SG_ Obj_16_RelativeLatVelocityV : 243|1@1+ (1,0) [0|1] "" Vector__XXX
 SG_ Obj_16_RelativeLatVelocitySTD : 244|13@1+ (0.01,0) [0.00|81.91] "m/s" Vector__XXX
 SG_ Obj_16_RelLatVelSTDV : 257|1@1+ (1,0) [0|1] "" Vector__XXX
 SG_ Obj_16_LongtRltvDist : 258|14@1+ (0.05,-200) [-200.00|619.15] "m" Vector__XXX
 SG_ Obj_16_LongDistanceV : 272|1@1+ (1,0) [0|1] "" Vector__XXX
 SG_ Obj_16_LongDistanceSTD : 273|15@1+ (0.01,0) [0.00|327.67] "m" Vector__XXX
 SG_ Obj_16_LongDistanceSTDV : 288|1@1+ (1,0) [0|1] "" Vector__XXX
 SG_ Obj_16_LatRltvDist : 289|12@1+ (0.05,-100) [-100.00|104.75] "m" Vector__XXX
 SG_ Obj_16_LatDistanceV : 301|1@1+ (1,0) [0|1] "" Vector__XXX
 SG_ Obj_16_LatDistanceSTD : 302|14@1+ (0.01,0) [0.00|163.83] "m" Vector__XXX
 SG_ Obj_16_LatDistanceSTDV : 316|1@1+ (1,0) [0|1] "" Vector__XXX
 SG_ Obj_16_AbsoluteSpeed : 317|12@1+ (0.05,-65) [-65.00|139.75] "m/s" Vector__XXX
 SG_ Obj_16_AbsoluteSpeedV : 329|1@1+ (1,0) [0|1] "" Vector__XXX
 SG_ Obj_16_AbsoluteSpeedSTD : 330|13@1+ (0.01,0) [0.00|81.91] "m/s" Vector__XXX
 SG_ Obj_16_AbsoluteSpeedSTDV : 343|1@1+ (1,0) [0|1] "" Vector__XXX

BO_ 291 FVCM_Obj17_A: 64 FVCM
 SG_ OD_17_A_Head_CRC : 0|16@1+ (1,0) [0|65535] "" Vector__XXX
 SG_ OD_17_A_Head_ALIVE : 16|8@1+ (1,0) [0|255] "" Vector__XXX
 SG_ Obj_17_Id_A : 24|8@1+ (1,0) [0|255] "" Vector__XXX
 SG_ Obj_17_SyncCounter_A : 32|8@1+ (1,0) [0|255] "" Vector__XXX
 SG_ Obj_17_ExistPrblty : 40|8@1+ (0.01,0) [0.00|2.55] "" Vector__XXX
 SG_ Obj_17_MotionCategory : 48|4@1+ (1,0) [0|15] "" Vector__XXX
 SG_ Obj_17_Age : 52|11@1+ (1,0) [0|2047] "" Vector__XXX
 SG_ Obj_17_MeasSts : 63|3@1+ (1,0) [0|7] "" Vector__XXX
 SG_ Obj_17_Typ : 66|4@1+ (1,0) [0|15] "" Vector__XXX
 SG_ Obj_17_ClassProbability : 70|7@1+ (0.01,0) [0.00|1.27] "" Vector__XXX
 SG_ Obj_17_MotionSts : 77|3@1+ (1,0) [0|7] "" Vector__XXX
 SG_ Obj_17_MotionOrientation : 80|4@1+ (1,0) [0|15] "" Vector__XXX
 SG_ Obj_17_BrakeLight : 84|1@1+ (1,0) [0|1] "" Vector__XXX
 SG_ Obj_17_TurnIndicatorRight : 85|1@1+ (1,0) [0|1] "" Vector__XXX
 SG_ Obj_17_TurnIndicatorLeft : 86|1@1+ (1,0) [0|1] "" Vector__XXX
 SG_ Obj_17_LightIndicatorValidity : 87|1@1+ (1,0) [0|1] "" Vector__XXX
 SG_ Obj_17_LaneAssignment : 88|3@1+ (1,0) [0|7] "" Vector__XXX
 SG_ Obj_17_LaneAssignmentV : 91|1@1+ (1,0) [0|1] "" Vector__XXX
 SG_ Obj_17_Width : 92|9@1+ (0.01,0.4) [0.40|5.51] "m" Vector__XXX
 SG_ Obj_17_WidthV : 101|1@1+ (1,0) [0|1] "" Vector__XXX
 SG_ Obj_17_WidthSTD : 102|11@1+ (0.001,0) [0.000|2.047] "m" Vector__XXX
 SG_ Obj_17_WidthSTDV : 113|1@1+ (1,0) [0|1] "" Vector__XXX
 SG_ Obj_17_Length : 114|9@1+ (0.05,1.2) [1.20|26.75] "m" Vector__XXX
 SG_ Obj_17_LengthV : 123|1@1+ (1,0) [0|1] "" Vector__XXX
 SG_ Obj_17_LengthSTD : 124|10@1+ (0.01,0) [0.00|10.23] "m" Vector__XXX
 SG_ Obj_17_LengthSTDV : 134|1@1+ (1,0) [0|1] "" Vector__XXX
 SG_ Obj_17_RadarID : 135|8@1+ (1,0) [0|255] "" Vector__XXX
 SG_ Obj_17_Height : 143|9@1+ (0.01,0) [0.00|5.11] "m" Vector__XXX
 SG_ Obj_17_HeightV : 152|1@1+ (1,0) [0|1] "" Vector__XXX
 SG_ Obj_17_HeightSTD : 153|11@1+ (0.001,0) [0.000|2.047] "m" Vector__XXX
 SG_ Obj_17_HeightSTDV : 164|1@1+ (1,0) [0|1] "" Vector__XXX
 SG_ Obj_17_Heading : 165|10@1+ (0.01,-3.14) [-3.14|7.09] "rad" Vector__XXX
 SG_ Obj_17_HeadingV : 175|1@1+ (1,0) [0|1] "" Vector__XXX
 SG_ Obj_17_HeadingSTD : 176|15@1+ (0.00010,0) [0.00000|3.27670] "rad" Vector__XXX
 SG_ Obj_17_HeadingSTDV : 191|1@1+ (1,0) [0|1] "" Vector__XXX
 SG_ Obj_17_AngleRateSTD : 192|15@1+ (0.00010,0) [0.00000|3.27670] "RPS" Vector__XXX
 SG_ Obj_17_AngleRateSTDV : 207|1@1+ (1,0) [0|1] "" Vector__XXX
 SG_ Obj_17_AngleRate : 208|12@1+ (0.002,-2.234) [-2.234|5.956] "RPS" Vector__XXX
 SG_ Obj_17_AngleRateV : 220|1@1+ (1,0) [0|1] "" Vector__XXX
 SG_ Obj_17_AngleRight : 221|14@1+ (0.00020,-1.571) [-1.57100|1.70560] "rad" Vector__XXX
 SG_ Obj_17_AngleRightV : 235|1@1+ (1,0) [0|1] "" Vector__XXX
 SG_ Obj_17_AngleRightSTD : 236|14@1+ (0.00010,0) [0.00000|1.63830] "rad" Vector__XXX
 SG_ Obj_17_AngleRightSTDV : 250|1@1+ (1,0) [0|1] "" Vector__XXX
 SG_ Obj_17_AngleLeft : 251|14@1+ (0.00020,-1.571) [-1.57100|1.70560] "rad" Vector__XXX
 SG_ Obj_17_AngleLeftV : 265|1@1+ (1,0) [0|1] "" Vector__XXX
 SG_ Obj_17_AngleLeftSTD : 266|14@1+ (0.00010,0) [0.00000|1.63830] "rad" Vector__XXX
 SG_ Obj_17_AngleLeftSTDV : 280|1@1+ (1,0) [0|1] "" Vector__XXX
 SG_ Obj_17_AngleSide : 281|14@1+ (0.00020,-1.571) [-1.57100|1.70560] "rad" Vector__XXX
 SG_ Obj_17_AngleSideV : 295|1@1+ (1,0) [0|1] "" Vector__XXX
 SG_ Obj_17_AngleSideSTD : 296|14@1+ (0.00010,0) [0.00000|1.63830] "rad" Vector__XXX
 SG_ Obj_17_AngleSideSTDV : 310|1@1+ (1,0) [0|1] "" Vector__XXX
 SG_ Obj_17_AngleBottomV : 311|1@1+ (1,0) [0|1] "" Vector__XXX
 SG_ Obj_17_AngleBottom : 312|14@1+ (0.00020,-1.571) [-1.57100|1.70560] "rad" Vector__XXX
 SG_ Obj_17_AngleBottomSTD : 326|14@1+ (0.00010,0) [0.00000|1.63830] "rad" Vector__XXX
 SG_ Obj_17_AngleBottomSTDV : 340|1@1+ (1,0) [0|1] "" Vector__XXX

BO_ 292 FVCM_Obj17_B: 64 FVCM
 SG_ OD_17_B_Head_CRC : 0|16@1+ (1,0) [0|65535] "" Vector__XXX
 SG_ OD_17_B_Head_ALIVE : 16|8@1+ (1,0) [0|255] "" Vector__XXX
 SG_ Obj_17_Id_B : 24|8@1+ (1,0) [0|255] "" Vector__XXX
 SG_ Obj_17_SyncCounter_B : 32|8@1+ (1,0) [0|255] "" Vector__XXX
 SG_ Obj_17_AbsLongVelocity : 40|12@1+ (0.05,-100) [-100.00|104.75] "m/s" Vector__XXX
 SG_ Obj_17_AbsLongVelocityV : 52|1@1+ (1,0) [0|1] "" Vector__XXX
 SG_ Obj_17_AbsLongVelocitySTD : 53|13@1+ (0.01,0) [0.00|81.91] "m/s" Vector__XXX
 SG_ Obj_17_AbsLongVelSTDV : 66|1@1+ (1,0) [0|1] "" Vector__XXX
 SG_ Obj_17_AbsLatVelocity : 67|11@1+ (0.05,-50) [-50.00|52.35] "m/s" Vector__XXX
 SG_ Obj_17_AbsLatVelocityV : 78|1@1+ (1,0) [0|1] "" Vector__XXX
 SG_ Obj_17_AbsLatVelocitySTD : 79|13@1+ (0.01,0) [0.00|81.91] "m/s" Vector__XXX
 SG_ Obj_17_AbsLatVelSTDV : 92|1@1+ (1,0) [0|1] "" Vector__XXX
 SG_ Obj_17_AbsLongAcc : 93|9@1+ (0.05,-10) [-10.00|15.55] "m/s²" Vector__XXX
 SG_ Obj_17_AbsLongAccV : 102|1@1+ (1,0) [0|1] "" Vector__XXX
 SG_ Obj_17_AbsLongAccSTD : 103|10@1+ (0.01,0) [0.00|10.23] "m/s²" Vector__XXX
 SG_ Obj_17_AbsLongAccSTDV : 113|1@1+ (1,0) [0|1] "" Vector__XXX
 SG_ Obj_17_AbsLatAcc : 114|9@1+ (0.05,-10) [-10.00|15.55] "m/s²" Vector__XXX
 SG_ Obj_17_AbsLatAccV : 123|1@1+ (1,0) [0|1] "" Vector__XXX
 SG_ Obj_17_AbsLatAccSTD : 124|10@1+ (0.01,0) [0.00|10.23] "m/s²" Vector__XXX
 SG_ Obj_17_AbsLatAccSTDV : 134|1@1+ (1,0) [0|1] "" Vector__XXX
 SG_ Obj_17_AbsAcceleration : 135|9@1+ (0.05,-12.7) [-12.70|12.85] "m/s²" Vector__XXX
 SG_ Obj_17_AbsAccelerationV : 144|1@1+ (1,0) [0|1] "" Vector__XXX
 SG_ Obj_17_AbsAccSTD : 145|10@1+ (0.01,0) [0.00|10.23] "m/s²" Vector__XXX
 SG_ Obj_17_AbsAccSTDV : 155|1@1+ (1,0) [0|1] "" Vector__XXX
 SG_ Obj_17_InvTTC : 156|11@1+ (0.01,-8) [-8.00|12.47] "1/s" Vector__XXX
 SG_ Obj_17_InvTTCV : 167|1@1+ (1,0) [0|1] "" Vector__XXX
 SG_ Obj_17_InvTTCSTD : 168|12@1+ (0.001,0) [0.000|4.095] "1/s" Vector__XXX
 SG_ Obj_17_InvTTCSTDV : 180|1@1+ (1,0) [0|1] "" Vector__XXX
 SG_ Obj_17_RelativeLongAcc : 181|10@1+ (0.05,-20) [-20.00|31.15] "m/s²" Vector__XXX
 SG_ Obj_17_RelativeLongAccV : 191|1@1+ (1,0) [0|1] "" Vector__XXX
 SG_ Obj_17_RelativeLongAccSTD : 192|10@1+ (0.01,0) [0.00|10.23] "m/s²" Vector__XXX
 SG_ Obj_17_RelLongAccSTDV : 202|1@1+ (1,0) [0|1] "" Vector__XXX
 SG_ Obj_17_LongtRltvSpd : 203|13@1+ (0.05,-120) [-120.00|289.55] "m/s" Vector__XXX
 SG_ Obj_17_LongtRltvSpdV : 216|1@1+ (1,0) [0|1] "" Vector__XXX
 SG_ Obj_17_LongtRltvSpdSTD : 217|14@1+ (0.01,0) [0.00|163.83] "m/s" Vector__XXX
 SG_ Obj_17_LongtRltvSpdSTDV : 231|1@1+ (1,0) [0|1] "" Vector__XXX
 SG_ Obj_17_RelativeLatVelocity : 232|11@1+ (0.05,-50) [-50.00|52.35] "m/s" Vector__XXX
 SG_ Obj_17_RelativeLatVelocityV : 243|1@1+ (1,0) [0|1] "" Vector__XXX
 SG_ Obj_17_RelativeLatVelocitySTD : 244|13@1+ (0.01,0) [0.00|81.91] "m/s" Vector__XXX
 SG_ Obj_17_RelLatVelSTDV : 257|1@1+ (1,0) [0|1] "" Vector__XXX
 SG_ Obj_17_LongtRltvDist : 258|14@1+ (0.05,-200) [-200.00|619.15] "m" Vector__XXX
 SG_ Obj_17_LongDistanceV : 272|1@1+ (1,0) [0|1] "" Vector__XXX
 SG_ Obj_17_LongDistanceSTD : 273|15@1+ (0.01,0) [0.00|327.67] "m" Vector__XXX
 SG_ Obj_17_LongDistanceSTDV : 288|1@1+ (1,0) [0|1] "" Vector__XXX
 SG_ Obj_17_LatRltvDist : 289|12@1+ (0.05,-100) [-100.00|104.75] "m" Vector__XXX
 SG_ Obj_17_LatDistanceV : 301|1@1+ (1,0) [0|1] "" Vector__XXX
 SG_ Obj_17_LatDistanceSTD : 302|14@1+ (0.01,0) [0.00|163.83] "m" Vector__XXX
 SG_ Obj_17_LatDistanceSTDV : 316|1@1+ (1,0) [0|1] "" Vector__XXX
 SG_ Obj_17_AbsoluteSpeed : 317|12@1+ (0.05,-65) [-65.00|139.75] "m/s" Vector__XXX
 SG_ Obj_17_AbsoluteSpeedV : 329|1@1+ (1,0) [0|1] "" Vector__XXX
 SG_ Obj_17_AbsoluteSpeedSTD : 330|13@1+ (0.01,0) [0.00|81.91] "m/s" Vector__XXX
 SG_ Obj_17_AbsoluteSpeedSTDV : 343|1@1+ (1,0) [0|1] "" Vector__XXX

BO_ 293 FVCM_Obj18_A: 64 FVCM
 SG_ OD_18_A_Head_CRC : 0|16@1+ (1,0) [0|65535] "" Vector__XXX
 SG_ OD_18_A_Head_ALIVE : 16|8@1+ (1,0) [0|255] "" Vector__XXX
 SG_ Obj_18_Id_A : 24|8@1+ (1,0) [0|255] "" Vector__XXX
 SG_ Obj_18_SyncCounter_A : 32|8@1+ (1,0) [0|255] "" Vector__XXX
 SG_ Obj_18_ExistPrblty : 40|8@1+ (0.01,0) [0.00|2.55] "" Vector__XXX
 SG_ Obj_18_MotionCategory : 48|4@1+ (1,0) [0|15] "" Vector__XXX
 SG_ Obj_18_Age : 52|11@1+ (1,0) [0|2047] "" Vector__XXX
 SG_ Obj_18_MeasSts : 63|3@1+ (1,0) [0|7] "" Vector__XXX
 SG_ Obj_18_Typ : 66|4@1+ (1,0) [0|15] "" Vector__XXX
 SG_ Obj_18_ClassProbability : 70|7@1+ (0.01,0) [0.00|1.27] "" Vector__XXX
 SG_ Obj_18_MotionSts : 77|3@1+ (1,0) [0|7] "" Vector__XXX
 SG_ Obj_18_MotionOrientation : 80|4@1+ (1,0) [0|15] "" Vector__XXX
 SG_ Obj_18_BrakeLight : 84|1@1+ (1,0) [0|1] "" Vector__XXX
 SG_ Obj_18_TurnIndicatorRight : 85|1@1+ (1,0) [0|1] "" Vector__XXX
 SG_ Obj_18_TurnIndicatorLeft : 86|1@1+ (1,0) [0|1] "" Vector__XXX
 SG_ Obj_18_LightIndicatorValidity : 87|1@1+ (1,0) [0|1] "" Vector__XXX
 SG_ Obj_18_LaneAssignment : 88|3@1+ (1,0) [0|7] "" Vector__XXX
 SG_ Obj_18_LaneAssignmentV : 91|1@1+ (1,0) [0|1] "" Vector__XXX
 SG_ Obj_18_Width : 92|9@1+ (0.01,0.4) [0.40|5.51] "m" Vector__XXX
 SG_ Obj_18_WidthV : 101|1@1+ (1,0) [0|1] "" Vector__XXX
 SG_ Obj_18_WidthSTD : 102|11@1+ (0.001,0) [0.000|2.047] "m" Vector__XXX
 SG_ Obj_18_WidthSTDV : 113|1@1+ (1,0) [0|1] "" Vector__XXX
 SG_ Obj_18_Length : 114|9@1+ (0.05,1.2) [1.20|26.75] "m" Vector__XXX
 SG_ Obj_18_LengthV : 123|1@1+ (1,0) [0|1] "" Vector__XXX
 SG_ Obj_18_LengthSTD : 124|10@1+ (0.01,0) [0.00|10.23] "m" Vector__XXX
 SG_ Obj_18_LengthSTDV : 134|1@1+ (1,0) [0|1] "" Vector__XXX
 SG_ Obj_18_RadarID : 135|8@1+ (1,0) [0|255] "" Vector__XXX
 SG_ Obj_18_Height : 143|9@1+ (0.01,0) [0.00|5.11] "m" Vector__XXX
 SG_ Obj_18_HeightV : 152|1@1+ (1,0) [0|1] "" Vector__XXX
 SG_ Obj_18_HeightSTD : 153|11@1+ (0.001,0) [0.000|2.047] "m" Vector__XXX
 SG_ Obj_18_HeightSTDV : 164|1@1+ (1,0) [0|1] "" Vector__XXX
 SG_ Obj_18_Heading : 165|10@1+ (0.01,-3.14) [-3.14|7.09] "rad" Vector__XXX
 SG_ Obj_18_HeadingV : 175|1@1+ (1,0) [0|1] "" Vector__XXX
 SG_ Obj_18_HeadingSTD : 176|15@1+ (0.00010,0) [0.00000|3.27670] "rad" Vector__XXX
 SG_ Obj_18_HeadingSTDV : 191|1@1+ (1,0) [0|1] "" Vector__XXX
 SG_ Obj_18_AngleRateSTD : 192|15@1+ (0.00010,0) [0.00000|3.27670] "RPS" Vector__XXX
 SG_ Obj_18_AngleRateSTDV : 207|1@1+ (1,0) [0|1] "" Vector__XXX
 SG_ Obj_18_AngleRate : 208|12@1+ (0.002,-2.234) [-2.234|5.956] "RPS" Vector__XXX
 SG_ Obj_18_AngleRateV : 220|1@1+ (1,0) [0|1] "" Vector__XXX
 SG_ Obj_18_AngleRight : 221|14@1+ (0.00020,-1.571) [-1.57100|1.70560] "rad" Vector__XXX
 SG_ Obj_18_AngleRightV : 235|1@1+ (1,0) [0|1] "" Vector__XXX
 SG_ Obj_18_AngleRightSTD : 236|14@1+ (0.00010,0) [0.00000|1.63830] "rad" Vector__XXX
 SG_ Obj_18_AngleRightSTDV : 250|1@1+ (1,0) [0|1] "" Vector__XXX
 SG_ Obj_18_AngleLeft : 251|14@1+ (0.00020,-1.571) [-1.57100|1.70560] "rad" Vector__XXX
 SG_ Obj_18_AngleLeftV : 265|1@1+ (1,0) [0|1] "" Vector__XXX
 SG_ Obj_18_AngleLeftSTD : 266|14@1+ (0.00010,0) [0.00000|1.63830] "rad" Vector__XXX
 SG_ Obj_18_AngleLeftSTDV : 280|1@1+ (1,0) [0|1] "" Vector__XXX
 SG_ Obj_18_AngleSide : 281|14@1+ (0.00020,-1.571) [-1.57100|1.70560] "rad" Vector__XXX
 SG_ Obj_18_AngleSideV : 295|1@1+ (1,0) [0|1] "" Vector__XXX
 SG_ Obj_18_AngleSideSTD : 296|14@1+ (0.00010,0) [0.00000|1.63830] "rad" Vector__XXX
 SG_ Obj_18_AngleSideSTDV : 310|1@1+ (1,0) [0|1] "" Vector__XXX
 SG_ Obj_18_AngleBottomV : 311|1@1+ (1,0) [0|1] "" Vector__XXX
 SG_ Obj_18_AngleBottom : 312|14@1+ (0.00020,-1.571) [-1.57100|1.70560] "rad" Vector__XXX
 SG_ Obj_18_AngleBottomSTD : 326|14@1+ (0.00010,0) [0.00000|1.63830] "rad" Vector__XXX
 SG_ Obj_18_AngleBottomSTDV : 340|1@1+ (1,0) [0|1] "" Vector__XXX

BO_ 294 FVCM_Obj18_B: 64 FVCM
 SG_ OD_18_B_Head_CRC : 0|16@1+ (1,0) [0|65535] "" Vector__XXX
 SG_ OD_18_B_Head_ALIVE : 16|8@1+ (1,0) [0|255] "" Vector__XXX
 SG_ Obj_18_Id_B : 24|8@1+ (1,0) [0|255] "" Vector__XXX
 SG_ Obj_18_SyncCounter_B : 32|8@1+ (1,0) [0|255] "" Vector__XXX
 SG_ Obj_18_AbsLongVelocity : 40|12@1+ (0.05,-100) [-100.00|104.75] "m/s" Vector__XXX
 SG_ Obj_18_AbsLongVelocityV : 52|1@1+ (1,0) [0|1] "" Vector__XXX
 SG_ Obj_18_AbsLongVelocitySTD : 53|13@1+ (0.01,0) [0.00|81.91] "m/s" Vector__XXX
 SG_ Obj_18_AbsLongVelSTDV : 66|1@1+ (1,0) [0|1] "" Vector__XXX
 SG_ Obj_18_AbsLatVelocity : 67|11@1+ (0.05,-50) [-50.00|52.35] "m/s" Vector__XXX
 SG_ Obj_18_AbsLatVelocityV : 78|1@1+ (1,0) [0|1] "" Vector__XXX
 SG_ Obj_18_AbsLatVelocitySTD : 79|13@1+ (0.01,0) [0.00|81.91] "m/s" Vector__XXX
 SG_ Obj_18_AbsLatVelSTDV : 92|1@1+ (1,0) [0|1] "" Vector__XXX
 SG_ Obj_18_AbsLongAcc : 93|9@1+ (0.05,-10) [-10.00|15.55] "m/s²" Vector__XXX
 SG_ Obj_18_AbsLongAccV : 102|1@1+ (1,0) [0|1] "" Vector__XXX
 SG_ Obj_18_AbsLongAccSTD : 103|10@1+ (0.01,0) [0.00|10.23] "m/s²" Vector__XXX
 SG_ Obj_18_AbsLongAccSTDV : 113|1@1+ (1,0) [0|1] "" Vector__XXX
 SG_ Obj_18_AbsLatAcc : 114|9@1+ (0.05,-10) [-10.00|15.55] "m/s²" Vector__XXX
 SG_ Obj_18_AbsLatAccV : 123|1@1+ (1,0) [0|1] "" Vector__XXX
 SG_ Obj_18_AbsLatAccSTD : 124|10@1+ (0.01,0) [0.00|10.23] "m/s²" Vector__XXX
 SG_ Obj_18_AbsLatAccSTDV : 134|1@1+ (1,0) [0|1] "" Vector__XXX
 SG_ Obj_18_AbsAcceleration : 135|9@1+ (0.05,-12.7) [-12.70|12.85] "m/s²" Vector__XXX
 SG_ Obj_18_AbsAccelerationV : 144|1@1+ (1,0) [0|1] "" Vector__XXX
 SG_ Obj_18_AbsAccSTD : 145|10@1+ (0.01,0) [0.00|10.23] "m/s²" Vector__XXX
 SG_ Obj_18_AbsAccSTDV : 155|1@1+ (1,0) [0|1] "" Vector__XXX
 SG_ Obj_18_InvTTC : 156|11@1+ (0.01,-8) [-8.00|12.47] "1/s" Vector__XXX
 SG_ Obj_18_InvTTCV : 167|1@1+ (1,0) [0|1] "" Vector__XXX
 SG_ Obj_18_InvTTCSTD : 168|12@1+ (0.001,0) [0.000|4.095] "1/s" Vector__XXX
 SG_ Obj_18_InvTTCSTDV : 180|1@1+ (1,0) [0|1] "" Vector__XXX
 SG_ Obj_18_RelativeLongAcc : 181|10@1+ (0.05,-20) [-20.00|31.15] "m/s²" Vector__XXX
 SG_ Obj_18_RelativeLongAccV : 191|1@1+ (1,0) [0|1] "" Vector__XXX
 SG_ Obj_18_RelativeLongAccSTD : 192|10@1+ (0.01,0) [0.00|10.23] "m/s²" Vector__XXX
 SG_ Obj_18_RelLongAccSTDV : 202|1@1+ (1,0) [0|1] "" Vector__XXX
 SG_ Obj_18_LongtRltvSpd : 203|13@1+ (0.05,-120) [-120.00|289.55] "m/s" Vector__XXX
 SG_ Obj_18_LongtRltvSpdV : 216|1@1+ (1,0) [0|1] "" Vector__XXX
 SG_ Obj_18_LongtRltvSpdSTD : 217|14@1+ (0.01,0) [0.00|163.83] "m/s" Vector__XXX
 SG_ Obj_18_LongtRltvSpdSTDV : 231|1@1+ (1,0) [0|1] "" Vector__XXX
 SG_ Obj_18_RelativeLatVelocity : 232|11@1+ (0.05,-50) [-50.00|52.35] "m/s" Vector__XXX
 SG_ Obj_18_RelativeLatVelocityV : 243|1@1+ (1,0) [0|1] "" Vector__XXX
 SG_ Obj_18_RelativeLatVelocitySTD : 244|13@1+ (0.01,0) [0.00|81.91] "m/s" Vector__XXX
 SG_ Obj_18_RelLatVelSTDV : 257|1@1+ (1,0) [0|1] "" Vector__XXX
 SG_ Obj_18_LongtRltvDist : 258|14@1+ (0.05,-200) [-200.00|619.15] "m" Vector__XXX
 SG_ Obj_18_LongDistanceV : 272|1@1+ (1,0) [0|1] "" Vector__XXX
 SG_ Obj_18_LongDistanceSTD : 273|15@1+ (0.01,0) [0.00|327.67] "m" Vector__XXX
 SG_ Obj_18_LongDistanceSTDV : 288|1@1+ (1,0) [0|1] "" Vector__XXX
 SG_ Obj_18_LatRltvDist : 289|12@1+ (0.05,-100) [-100.00|104.75] "m" Vector__XXX
 SG_ Obj_18_LatDistanceV : 301|1@1+ (1,0) [0|1] "" Vector__XXX
 SG_ Obj_18_LatDistanceSTD : 302|14@1+ (0.01,0) [0.00|163.83] "m" Vector__XXX
 SG_ Obj_18_LatDistanceSTDV : 316|1@1+ (1,0) [0|1] "" Vector__XXX
 SG_ Obj_18_AbsoluteSpeed : 317|12@1+ (0.05,-65) [-65.00|139.75] "m/s" Vector__XXX
 SG_ Obj_18_AbsoluteSpeedV : 329|1@1+ (1,0) [0|1] "" Vector__XXX
 SG_ Obj_18_AbsoluteSpeedSTD : 330|13@1+ (0.01,0) [0.00|81.91] "m/s" Vector__XXX
 SG_ Obj_18_AbsoluteSpeedSTDV : 343|1@1+ (1,0) [0|1] "" Vector__XXX

BO_ 295 FVCM_Obj19_A: 64 FVCM
 SG_ OD_19_A_Head_CRC : 0|16@1+ (1,0) [0|65535] "" Vector__XXX
 SG_ OD_19_A_Head_ALIVE : 16|8@1+ (1,0) [0|255] "" Vector__XXX
 SG_ Obj_19_Id_A : 24|8@1+ (1,0) [0|255] "" Vector__XXX
 SG_ Obj_19_SyncCounter_A : 32|8@1+ (1,0) [0|255] "" Vector__XXX
 SG_ Obj_19_ExistPrblty : 40|8@1+ (0.01,0) [0.00|2.55] "" Vector__XXX
 SG_ Obj_19_MotionCategory : 48|4@1+ (1,0) [0|15] "" Vector__XXX
 SG_ Obj_19_Age : 52|11@1+ (1,0) [0|2047] "" Vector__XXX
 SG_ Obj_19_MeasSts : 63|3@1+ (1,0) [0|7] "" Vector__XXX
 SG_ Obj_19_Typ : 66|4@1+ (1,0) [0|15] "" Vector__XXX
 SG_ Obj_19_ClassProbability : 70|7@1+ (0.01,0) [0.00|1.27] "" Vector__XXX
 SG_ Obj_19_MotionSts : 77|3@1+ (1,0) [0|7] "" Vector__XXX
 SG_ Obj_19_MotionOrientation : 80|4@1+ (1,0) [0|15] "" Vector__XXX
 SG_ Obj_19_BrakeLight : 84|1@1+ (1,0) [0|1] "" Vector__XXX
 SG_ Obj_19_TurnIndicatorRight : 85|1@1+ (1,0) [0|1] "" Vector__XXX
 SG_ Obj_19_TurnIndicatorLeft : 86|1@1+ (1,0) [0|1] "" Vector__XXX
 SG_ Obj_19_LightIndicatorValidity : 87|1@1+ (1,0) [0|1] "" Vector__XXX
 SG_ Obj_19_LaneAssignment : 88|3@1+ (1,0) [0|7] "" Vector__XXX
 SG_ Obj_19_LaneAssignmentV : 91|1@1+ (1,0) [0|1] "" Vector__XXX
 SG_ Obj_19_Width : 92|9@1+ (0.01,0.4) [0.40|5.51] "m" Vector__XXX
 SG_ Obj_19_WidthV : 101|1@1+ (1,0) [0|1] "" Vector__XXX
 SG_ Obj_19_WidthSTD : 102|11@1+ (0.001,0) [0.000|2.047] "m" Vector__XXX
 SG_ Obj_19_WidthSTDV : 113|1@1+ (1,0) [0|1] "" Vector__XXX
 SG_ Obj_19_Length : 114|9@1+ (0.05,1.2) [1.20|26.75] "m" Vector__XXX
 SG_ Obj_19_LengthV : 123|1@1+ (1,0) [0|1] "" Vector__XXX
 SG_ Obj_19_LengthSTD : 124|10@1+ (0.01,0) [0.00|10.23] "m" Vector__XXX
 SG_ Obj_19_LengthSTDV : 134|1@1+ (1,0) [0|1] "" Vector__XXX
 SG_ Obj_19_RadarID : 135|8@1+ (1,0) [0|255] "" Vector__XXX
 SG_ Obj_19_Height : 143|9@1+ (0.01,0) [0.00|5.11] "m" Vector__XXX
 SG_ Obj_19_HeightV : 152|1@1+ (1,0) [0|1] "" Vector__XXX
 SG_ Obj_19_HeightSTD : 153|11@1+ (0.001,0) [0.000|2.047] "m" Vector__XXX
 SG_ Obj_19_HeightSTDV : 164|1@1+ (1,0) [0|1] "" Vector__XXX
 SG_ Obj_19_Heading : 165|10@1+ (0.01,-3.14) [-3.14|7.09] "rad" Vector__XXX
 SG_ Obj_19_HeadingV : 175|1@1+ (1,0) [0|1] "" Vector__XXX
 SG_ Obj_19_HeadingSTD : 176|15@1+ (0.00010,0) [0.00000|3.27670] "rad" Vector__XXX
 SG_ Obj_19_HeadingSTDV : 191|1@1+ (1,0) [0|1] "" Vector__XXX
 SG_ Obj_19_AngleRateSTD : 192|15@1+ (0.00010,0) [0.00000|3.27670] "RPS" Vector__XXX
 SG_ Obj_19_AngleRateSTDV : 207|1@1+ (1,0) [0|1] "" Vector__XXX
 SG_ Obj_19_AngleRate : 208|12@1+ (0.002,-2.234) [-2.234|5.956] "RPS" Vector__XXX
 SG_ Obj_19_AngleRateV : 220|1@1+ (1,0) [0|1] "" Vector__XXX
 SG_ Obj_19_AngleRight : 221|14@1+ (0.00020,-1.571) [-1.57100|1.70560] "rad" Vector__XXX
 SG_ Obj_19_AngleRightV : 235|1@1+ (1,0) [0|1] "" Vector__XXX
 SG_ Obj_19_AngleRightSTD : 236|14@1+ (0.00010,0) [0.00000|1.63830] "rad" Vector__XXX
 SG_ Obj_19_AngleRightSTDV : 250|1@1+ (1,0) [0|1] "" Vector__XXX
 SG_ Obj_19_AngleLeft : 251|14@1+ (0.00020,-1.571) [-1.57100|1.70560] "rad" Vector__XXX
 SG_ Obj_19_AngleLeftV : 265|1@1+ (1,0) [0|1] "" Vector__XXX
 SG_ Obj_19_AngleLeftSTD : 266|14@1+ (0.00010,0) [0.00000|1.63830] "rad" Vector__XXX
 SG_ Obj_19_AngleLeftSTDV : 280|1@1+ (1,0) [0|1] "" Vector__XXX
 SG_ Obj_19_AngleSide : 281|14@1+ (0.00020,-1.571) [-1.57100|1.70560] "rad" Vector__XXX
 SG_ Obj_19_AngleSideV : 295|1@1+ (1,0) [0|1] "" Vector__XXX
 SG_ Obj_19_AngleSideSTD : 296|14@1+ (0.00010,0) [0.00000|1.63830] "rad" Vector__XXX
 SG_ Obj_19_AngleSideSTDV : 310|1@1+ (1,0) [0|1] "" Vector__XXX
 SG_ Obj_19_AngleBottomV : 311|1@1+ (1,0) [0|1] "" Vector__XXX
 SG_ Obj_19_AngleBottom : 312|14@1+ (0.00020,-1.571) [-1.57100|1.70560] "rad" Vector__XXX
 SG_ Obj_19_AngleBottomSTD : 326|14@1+ (0.00010,0) [0.00000|1.63830] "rad" Vector__XXX
 SG_ Obj_19_AngleBottomSTDV : 340|1@1+ (1,0) [0|1] "" Vector__XXX

BO_ 296 FVCM_Obj19_B: 64 FVCM
 SG_ OD_19_B_Head_CRC : 0|16@1+ (1,0) [0|65535] "" Vector__XXX
 SG_ OD_19_B_Head_ALIVE : 16|8@1+ (1,0) [0|255] "" Vector__XXX
 SG_ Obj_19_Id_B : 24|8@1+ (1,0) [0|255] "" Vector__XXX
 SG_ Obj_19_SyncCounter_B : 32|8@1+ (1,0) [0|255] "" Vector__XXX
 SG_ Obj_19_AbsLongVelocity : 40|12@1+ (0.05,-100) [-100.00|104.75] "m/s" Vector__XXX
 SG_ Obj_19_AbsLongVelocityV : 52|1@1+ (1,0) [0|1] "" Vector__XXX
 SG_ Obj_19_AbsLongVelocitySTD : 53|13@1+ (0.01,0) [0.00|81.91] "m/s" Vector__XXX
 SG_ Obj_19_AbsLongVelSTDV : 66|1@1+ (1,0) [0|1] "" Vector__XXX
 SG_ Obj_19_AbsLatVelocity : 67|11@1+ (0.05,-50) [-50.00|52.35] "m/s" Vector__XXX
 SG_ Obj_19_AbsLatVelocityV : 78|1@1+ (1,0) [0|1] "" Vector__XXX
 SG_ Obj_19_AbsLatVelocitySTD : 79|13@1+ (0.01,0) [0.00|81.91] "m/s" Vector__XXX
 SG_ Obj_19_AbsLatVelSTDV : 92|1@1+ (1,0) [0|1] "" Vector__XXX
 SG_ Obj_19_AbsLongAcc : 93|9@1+ (0.05,-10) [-10.00|15.55] "m/s²" Vector__XXX
 SG_ Obj_19_AbsLongAccV : 102|1@1+ (1,0) [0|1] "" Vector__XXX
 SG_ Obj_19_AbsLongAccSTD : 103|10@1+ (0.01,0) [0.00|10.23] "m/s²" Vector__XXX
 SG_ Obj_19_AbsLongAccSTDV : 113|1@1+ (1,0) [0|1] "" Vector__XXX
 SG_ Obj_19_AbsLatAcc : 114|9@1+ (0.05,-10) [-10.00|15.55] "m/s²" Vector__XXX
 SG_ Obj_19_AbsLatAccV : 123|1@1+ (1,0) [0|1] "" Vector__XXX
 SG_ Obj_19_AbsLatAccSTD : 124|10@1+ (0.01,0) [0.00|10.23] "m/s²" Vector__XXX
 SG_ Obj_19_AbsLatAccSTDV : 134|1@1+ (1,0) [0|1] "" Vector__XXX
 SG_ Obj_19_AbsAcceleration : 135|9@1+ (0.05,-12.7) [-12.70|12.85] "m/s²" Vector__XXX
 SG_ Obj_19_AbsAccelerationV : 144|1@1+ (1,0) [0|1] "" Vector__XXX
 SG_ Obj_19_AbsAccSTD : 145|10@1+ (0.01,0) [0.00|10.23] "m/s²" Vector__XXX
 SG_ Obj_19_AbsAccSTDV : 155|1@1+ (1,0) [0|1] "" Vector__XXX
 SG_ Obj_19_InvTTC : 156|11@1+ (0.01,-8) [-8.00|12.47] "1/s" Vector__XXX
 SG_ Obj_19_InvTTCV : 167|1@1+ (1,0) [0|1] "" Vector__XXX
 SG_ Obj_19_InvTTCSTD : 168|12@1+ (0.001,0) [0.000|4.095] "1/s" Vector__XXX
 SG_ Obj_19_InvTTCSTDV : 180|1@1+ (1,0) [0|1] "" Vector__XXX
 SG_ Obj_19_RelativeLongAcc : 181|10@1+ (0.05,-20) [-20.00|31.15] "m/s²" Vector__XXX
 SG_ Obj_19_RelativeLongAccV : 191|1@1+ (1,0) [0|1] "" Vector__XXX
 SG_ Obj_19_RelativeLongAccSTD : 192|10@1+ (0.01,0) [0.00|10.23] "m/s²" Vector__XXX
 SG_ Obj_19_RelLongAccSTDV : 202|1@1+ (1,0) [0|1] "" Vector__XXX
 SG_ Obj_19_LongtRltvSpd : 203|13@1+ (0.05,-120) [-120.00|289.55] "m/s" Vector__XXX
 SG_ Obj_19_LongtRltvSpdV : 216|1@1+ (1,0) [0|1] "" Vector__XXX
 SG_ Obj_19_LongtRltvSpdSTD : 217|14@1+ (0.01,0) [0.00|163.83] "m/s" Vector__XXX
 SG_ Obj_19_LongtRltvSpdSTDV : 231|1@1+ (1,0) [0|1] "" Vector__XXX
 SG_ Obj_19_RelativeLatVelocity : 232|11@1+ (0.05,-50) [-50.00|52.35] "m/s" Vector__XXX
 SG_ Obj_19_RelativeLatVelocityV : 243|1@1+ (1,0) [0|1] "" Vector__XXX
 SG_ Obj_19_RelativeLatVelocitySTD : 244|13@1+ (0.01,0) [0.00|81.91] "m/s" Vector__XXX
 SG_ Obj_19_RelLatVelSTDV : 257|1@1+ (1,0) [0|1] "" Vector__XXX
 SG_ Obj_19_LongtRltvDist : 258|14@1+ (0.05,-200) [-200.00|619.15] "m" Vector__XXX
 SG_ Obj_19_LongDistanceV : 272|1@1+ (1,0) [0|1] "" Vector__XXX
 SG_ Obj_19_LongDistanceSTD : 273|15@1+ (0.01,0) [0.00|327.67] "m" Vector__XXX
 SG_ Obj_19_LongDistanceSTDV : 288|1@1+ (1,0) [0|1] "" Vector__XXX
 SG_ Obj_19_LatRltvDist : 289|12@1+ (0.05,-100) [-100.00|104.75] "m" Vector__XXX
 SG_ Obj_19_LatDistanceV : 301|1@1+ (1,0) [0|1] "" Vector__XXX
 SG_ Obj_19_LatDistanceSTD : 302|14@1+ (0.01,0) [0.00|163.83] "m" Vector__XXX
 SG_ Obj_19_LatDistanceSTDV : 316|1@1+ (1,0) [0|1] "" Vector__XXX
 SG_ Obj_19_AbsoluteSpeed : 317|12@1+ (0.05,-65) [-65.00|139.75] "m/s" Vector__XXX
 SG_ Obj_19_AbsoluteSpeedV : 329|1@1+ (1,0) [0|1] "" Vector__XXX
 SG_ Obj_19_AbsoluteSpeedSTD : 330|13@1+ (0.01,0) [0.00|81.91] "m/s" Vector__XXX
 SG_ Obj_19_AbsoluteSpeedSTDV : 343|1@1+ (1,0) [0|1] "" Vector__XXX

BO_ 256 FVCM_ObjGeneral_Information: 64 FVCM
 SG_ ODG_Head_CRC : 0|16@1+ (1,0) [0|65535] "" Vector__XXX
 SG_ ODG_Head_ALIVE : 16|8@1+ (1,0) [0|255] "" Vector__XXX
 SG_ ObjVruCount : 24|5@1+ (1,0) [0|31] "" Vector__XXX
 SG_ ObjVdCount : 29|5@1+ (1,0) [0|31] "" Vector__XXX
 SG_ ObjVdNivLeft : 34|8@1+ (1,0) [0|255] "" Vector__XXX
 SG_ ObjVdNivRight : 42|8@1+ (1,0) [0|255] "" Vector__XXX
 SG_ ObjVdCipvId : 50|8@1+ (1,0) [0|255] "" Vector__XXX
 SG_ ObjVdCipvLost : 58|2@1+ (1,0) [0|3] "" Vector__XXX
 SG_ ObjSyncCounter : 60|8@1+ (1,0) [0|255] "" Vector__XXX
 SG_ ObjIsBlockedLeft : 68|1@1+ (1,0) [0|1] "" Vector__XXX
 SG_ ObjIsBlockedRight : 69|1@1+ (1,0) [0|1] "" Vector__XXX

BO_ 299 FVCM_RE: 64 FVCM
 SG_ RE_Head_CRC : 0|16@1+ (1,0) [0|65535] "" Vector__XXX
 SG_ RE_Head_ALIVE : 16|8@1+ (1,0) [0|255] "" Vector__XXX
 SG_ RE_Head_SyncCounter : 24|8@1+ (1,0) [0|255] "" Vector__XXX
 SG_ RE0_C1 : 32|9@1+ (0.01,-2) [-2.00|3.11] "rad" Vector__XXX
 SG_ RE0_C2 : 41|15@1+ (0.000016,-0.25) [-0.250000|0.274272] "1/m" Vector__XXX
 SG_ RE0_C3 : 56|20@1+ (5.0E-008,-0.024) [-0.024000000|0.028428750] "1/m2" Vector__XXX
 SG_ RE0_ViewRangeEnd : 76|15@1+ (0.01,0) [0.00|327.67] "m" Vector__XXX
 SG_ RE0_ViewRangeStart : 91|15@1+ (0.01,0) [0.00|327.67] "m" Vector__XXX
 SG_ RE0_C0 : 106|13@1+ (0.01,-30) [-30.00|51.91] "m" Vector__XXX
 SG_ RE0_ExistProb : 119|6@1+ (0.02,0) [0.00|1.26] "" Vector__XXX
 SG_ RE0_ID : 125|8@1+ (1,0) [0|255] "" Vector__XXX
 SG_ RE0_MeasureType : 133|2@1+ (1,0) [0|3] "" Vector__XXX
 SG_ RE0_MarkerType : 135|4@1+ (1,0) [0|15] "" Vector__XXX
 SG_ RE1_C1 : 139|9@1+ (0.01,-2) [-2.00|3.11] "rad" Vector__XXX
 SG_ RE1_C2 : 148|15@1+ (0.000016,-0.25) [-0.250000|0.274272] "1/m" Vector__XXX
 SG_ RE1_C3 : 163|20@1+ (5.0E-008,-0.024) [-0.024000000|0.028428750] "1/m2" Vector__XXX
 SG_ RE1_ViewRangeEnd : 183|15@1+ (0.01,0) [0.00|327.67] "m" Vector__XXX
 SG_ RE1_ViewRangeStart : 198|15@1+ (0.01,0) [0.00|327.67] "m" Vector__XXX
 SG_ RE1_C0 : 213|13@1+ (0.01,-30) [-30.00|51.91] "m" Vector__XXX
 SG_ RE1_ExistProb : 226|6@1+ (0.02,0) [0.00|1.26] "" Vector__XXX
 SG_ RE1_ID : 232|8@1+ (1,0) [0|255] "" Vector__XXX
 SG_ RE1_MeasureType : 240|2@1+ (1,0) [0|3] "" Vector__XXX
 SG_ RE1_MarkerType : 242|4@1+ (1,0) [0|15] "" Vector__XXX

BO_ 301 FVCM_TSR_A: 64 FVCM
 SG_ TSR_A_Head_CRC : 0|16@1+ (1,0) [0|65535] "" Vector__XXX
 SG_ TSR_A_Head_ALIVE : 16|8@1+ (1,0) [0|255] "" Vector__XXX
 SG_ TSR_A_SyncCounter : 24|8@1+ (1,0) [0|255] "" Vector__XXX
 SG_ Sign0ID : 32|8@1+ (1,0) [0|255] "" Vector__XXX
 SG_ Sign0SpdLmt : 40|10@1+ (1,0) [0|1023] "" Vector__XXX
 SG_ Sign0ExistPrblty : 50|7@1+ (0.01,0) [0.00|1.27] "" Vector__XXX
 SG_ Sign0TrackAge : 57|10@1+ (1,0) [0|1023] "" Vector__XXX
 SG_ Sign0PosY : 67|15@1+ (0.01,-50) [-50.00|277.67] "m" Vector__XXX
 SG_ Sign0PosX : 82|13@1+ (0.01,-32) [-32.00|49.91] "m" Vector__XXX
 SG_ Sign0PosZ : 95|15@1+ (0.01,-15) [-15.00|312.67] "m" Vector__XXX
 SG_ Sign0Wdth : 110|10@1+ (0.01,0) [0.00|10.23] "m" Vector__XXX
 SG_ Sign0Hght : 120|10@1+ (0.01,0) [0.00|10.23] "m" Vector__XXX
 SG_ Sign1ID : 130|8@1+ (1,0) [0|255] "" Vector__XXX
 SG_ Sign1SpdLmt : 138|10@1+ (1,0) [0|1023] "" Vector__XXX
 SG_ Sign1ExistPrblty : 148|7@1+ (0.01,0) [0.00|1.27] "" Vector__XXX
 SG_ Sign1TrackAge : 155|10@1+ (1,0) [0|1023] "" Vector__XXX
 SG_ Sign1PosY : 165|15@1+ (0.01,-50) [-50.00|277.67] "m" Vector__XXX
 SG_ Sign1PosX : 180|13@1+ (0.01,-32) [-32.00|49.91] "m" Vector__XXX
 SG_ Sign1PosZ : 193|15@1+ (0.01,-15) [-15.00|312.67] "m" Vector__XXX
 SG_ Sign1Wdth : 208|10@1+ (0.01,0) [0.00|10.23] "m" Vector__XXX
 SG_ Sign1Hght : 218|10@1+ (0.01,0) [0.00|10.23] "m" Vector__XXX
 SG_ Sign2ID : 228|8@1+ (1,0) [0|255] "" Vector__XXX
 SG_ Sign2SpdLmt : 236|10@1+ (1,0) [0|1023] "" Vector__XXX
 SG_ Sign2ExistPrblty : 246|7@1+ (0.01,0) [0.00|1.27] "" Vector__XXX
 SG_ Sign2TrackAge : 253|10@1+ (1,0) [0|1023] "" Vector__XXX
 SG_ Sign2PosY : 263|15@1+ (0.01,-50) [-50.00|277.67] "m" Vector__XXX
 SG_ Sign2PosX : 278|13@1+ (0.01,-32) [-32.00|49.91] "m" Vector__XXX
 SG_ Sign2PosZ : 291|15@1+ (0.01,-15) [-15.00|312.67] "m" Vector__XXX
 SG_ Sign2Wdth : 306|10@1+ (0.01,0) [0.00|10.23] "m" Vector__XXX
 SG_ Sign2Hght : 316|10@1+ (0.01,0) [0.00|10.23] "m" Vector__XXX
 SG_ Sign3ID : 326|8@1+ (1,0) [0|255] "" Vector__XXX
 SG_ Sign3SpdLmt : 334|10@1+ (1,0) [0|1023] "" Vector__XXX
 SG_ Sign3ExistPrblty : 344|7@1+ (0.01,0) [0.00|1.27] "" Vector__XXX
 SG_ Sign3TrackAge : 351|10@1+ (1,0) [0|1023] "" Vector__XXX
 SG_ Sign3PosY : 361|15@1+ (0.01,-50) [-50.00|277.67] "m" Vector__XXX
 SG_ Sign3PosX : 376|13@1+ (0.01,-32) [-32.00|49.91] "m" Vector__XXX
 SG_ Sign3PosZ : 389|15@1+ (0.01,-15) [-15.00|312.67] "m" Vector__XXX
 SG_ Sign3Wdth : 404|10@1+ (0.01,0) [0.00|10.23] "m" Vector__XXX
 SG_ Sign3Hght : 414|10@1+ (0.01,0) [0.00|10.23] "m" Vector__XXX

BO_ 302 FVCM_TSR_B: 64 FVCM
 SG_ TSR_B_Head_CRC : 0|16@1+ (1,0) [0|65535] "" Vector__XXX
 SG_ TSR_B_Head_ALIVE : 16|8@1+ (1,0) [0|255] "" Vector__XXX
 SG_ TSR_B_SyncCounter : 24|8@1+ (1,0) [0|255] "" Vector__XXX
 SG_ Sign4ID : 32|8@1+ (1,0) [0|255] "" Vector__XXX
 SG_ Sign4SpdLmt : 40|10@1+ (1,0) [0|1023] "" Vector__XXX
 SG_ Sign4ExistPrblty : 50|7@1+ (0.01,0) [0.00|1.27] "" Vector__XXX
 SG_ Sign4TrackAge : 57|10@1+ (1,0) [0|1023] "" Vector__XXX
 SG_ Sign4PosY : 67|15@1+ (0.01,-50) [-50.00|277.67] "m" Vector__XXX
 SG_ Sign4PosX : 82|13@1+ (0.01,-32) [-32.00|49.91] "m" Vector__XXX
 SG_ Sign4PosZ : 95|15@1+ (0.01,-15) [-15.00|312.67] "m" Vector__XXX
 SG_ Sign4Wdth : 110|10@1+ (0.01,0) [0.00|10.23] "m" Vector__XXX
 SG_ Sign4Hght : 120|10@1+ (0.01,0) [0.00|10.23] "m" Vector__XXX
 SG_ Sign5ID : 130|8@1+ (1,0) [0|255] "" Vector__XXX
 SG_ Sign5SpdLmt : 138|10@1+ (1,0) [0|1023] "" Vector__XXX
 SG_ Sign5ExistPrblty : 148|7@1+ (0.01,0) [0.00|1.27] "" Vector__XXX
 SG_ Sign5TrackAge : 155|10@1+ (1,0) [0|1023] "" Vector__XXX
 SG_ Sign5PosY : 165|15@1+ (0.01,-50) [-50.00|277.67] "m" Vector__XXX
 SG_ Sign5PosX : 180|13@1+ (0.01,-32) [-32.00|49.91] "m" Vector__XXX
 SG_ Sign5PosZ : 193|15@1+ (0.01,-15) [-15.00|312.67] "m" Vector__XXX
 SG_ Sign5Wdth : 208|10@1+ (0.01,0) [0.00|10.23] "m" Vector__XXX
 SG_ Sign5Hght : 218|10@1+ (0.01,0) [0.00|10.23] "m" Vector__XXX
 SG_ Sign6ID : 228|8@1+ (1,0) [0|255] "" Vector__XXX
 SG_ Sign6SpdLmt : 236|10@1+ (1,0) [0|1023] "" Vector__XXX
 SG_ Sign6ExistPrblty : 246|7@1+ (0.01,0) [0.00|1.27] "" Vector__XXX
 SG_ Sign6TrackAge : 253|10@1+ (1,0) [0|1023] "" Vector__XXX
 SG_ Sign6PosY : 263|15@1+ (0.01,-50) [-50.00|277.67] "m" Vector__XXX
 SG_ Sign6PosX : 278|13@1+ (0.01,-32) [-32.00|49.91] "m" Vector__XXX
 SG_ Sign6PosZ : 291|15@1+ (0.01,-15) [-15.00|312.67] "m" Vector__XXX
 SG_ Sign6Wdth : 306|10@1+ (0.01,0) [0.00|10.23] "m" Vector__XXX
 SG_ Sign6Hght : 316|10@1+ (0.01,0) [0.00|10.23] "m" Vector__XXX
 SG_ Sign7ID : 326|8@1+ (1,0) [0|255] "" Vector__XXX
 SG_ Sign7SpdLmt : 334|10@1+ (1,0) [0|1023] "" Vector__XXX
 SG_ Sign7ExistPrblty : 344|7@1+ (0.01,0) [0.00|1.27] "" Vector__XXX
 SG_ Sign7TrackAge : 351|10@1+ (1,0) [0|1023] "" Vector__XXX
 SG_ Sign7PosY : 361|15@1+ (0.01,-50) [-50.00|277.67] "m" Vector__XXX
 SG_ Sign7PosX : 376|13@1+ (0.01,-32) [-32.00|49.91] "m" Vector__XXX
 SG_ Sign7PosZ : 389|15@1+ (0.01,-15) [-15.00|312.67] "m" Vector__XXX
 SG_ Sign7Wdth : 404|10@1+ (0.01,0) [0.00|10.23] "m" Vector__XXX
 SG_ Sign7Hght : 414|10@1+ (0.01,0) [0.00|10.23] "m" Vector__XXX

BO_ 303 FVCM_TSR_C: 64 FVCM
 SG_ TSR_C_Head_CRC : 0|16@1+ (1,0) [0|65535] "" Vector__XXX
 SG_ TSR_C_Head_ALIVE : 16|8@1+ (1,0) [0|255] "" Vector__XXX
 SG_ TSR_C_SyncCounter : 24|8@1+ (1,0) [0|255] "" Vector__XXX
 SG_ Sign8ID : 32|8@1+ (1,0) [0|255] "" Vector__XXX
 SG_ Sign8SpdLmt : 40|10@1+ (1,0) [0|1023] "" Vector__XXX
 SG_ Sign8ExistPrblty : 50|7@1+ (0.01,0) [0.00|1.27] "" Vector__XXX
 SG_ Sign8TrackAge : 57|10@1+ (1,0) [0|1023] "" Vector__XXX
 SG_ Sign8PosY : 67|15@1+ (0.01,-50) [-50.00|277.67] "m" Vector__XXX
 SG_ Sign8PosX : 82|13@1+ (0.01,-32) [-32.00|49.91] "m" Vector__XXX
 SG_ Sign8PosZ : 95|15@1+ (0.01,-15) [-15.00|312.67] "m" Vector__XXX
 SG_ Sign8Wdth : 110|10@1+ (0.01,0) [0.00|10.23] "m" Vector__XXX
 SG_ Sign8Hght : 120|10@1+ (0.01,0) [0.00|10.23] "m" Vector__XXX
 SG_ Sign9ID : 130|8@1+ (1,0) [0|255] "" Vector__XXX
 SG_ Sign9SpdLmt : 138|10@1+ (1,0) [0|1023] "" Vector__XXX
 SG_ Sign9ExistPrblty : 148|7@1+ (0.01,0) [0.00|1.27] "" Vector__XXX
 SG_ Sign9TrackAge : 155|10@1+ (1,0) [0|1023] "" Vector__XXX
 SG_ Sign9PosY : 165|15@1+ (0.01,-50) [-50.00|277.67] "m" Vector__XXX
 SG_ Sign9PosX : 180|13@1+ (0.01,-32) [-32.00|49.91] "m" Vector__XXX
 SG_ Sign9PosZ : 193|15@1+ (0.01,-15) [-15.00|312.67] "m" Vector__XXX
 SG_ Sign9Wdth : 208|10@1+ (0.01,0) [0.00|10.23] "m" Vector__XXX
 SG_ Sign9Hght : 218|10@1+ (0.01,0) [0.00|10.23] "m" Vector__XXX

BO_ 307 HLB: 64 FVCM
 SG_ HLB_Decision : 0|2@1+ (1,0) [0|3] "" Vector__XXX
 SG_ HLB_Head_CRC : 2|16@1+ (1,0) [0|65535] "" Vector__XXX
 SG_ HLB_Head_ALIVE : 18|8@1+ (1,0) [0|255] "" Vector__XXX

BA_DEF_ BO_ "GenMsgCycleTime" INT 0 65535;
BA_DEF_ BO_ "GenMsgSendType" ENUM  "cyclicX","spontanX","cyclicIfActiveX","spontanWithDelay","cyclicAndSpontanX","cyclicAndSpontanWithDelay","spontanWithRepitition","cyclicIfActiveAndSpontanWD","cyclicIfActiveFast","cyclicWithRepeatOnDemand","none";
BA_DEF_ BO_ "GenMsgStartValue" STRING;
BA_DEF_ BO_ "VFrameFormat" ENUM  "StandardCAN","ExtendedCAN","reserved","reserved","reserved","reserved","reserved","reserved","reserved","reserved","reserved","reserved","reserved","reserved","StandardCAN_FD","ExtendedCAN_FD";
BA_ "GenMsgCycleTime" BO_ 264 55;
BA_ "GenMsgSendType" BO_ 264 0;
BA_ "GenMsgStartValue" BO_ 264 "0000000000d00700401f000019002003007f00003200003200004b0000e80300803e0000a00f0080a20000000000000000000000000000000000000000000000";
BA_ "VFrameFormat" BO_ 264 14;
BA_ "GenMsgCycleTime" BO_ 265 55;
BA_ "GenMsgSendType" BO_ 265 0;
BA_ "GenMsgStartValue" BO_ 265 "0000000000000000000000801d00a007000000004027000000005de4d5030078f500005e3d0000af1e0000000000000000000000000000000000000000000000";
BA_ "VFrameFormat" BO_ 265 14;
BA_ "GenMsgCycleTime" BO_ 266 55;
BA_ "GenMsgSendType" BO_ 266 0;
BA_ "GenMsgStartValue" BO_ 266 "0000000000d00700401f000019002003007f00003200003200004b0000e80300803e0000a00f0080a20000000000000000000000000000000000000000000000";
BA_ "VFrameFormat" BO_ 266 14;
BA_ "GenMsgCycleTime" BO_ 267 55;
BA_ "GenMsgSendType" BO_ 267 0;
BA_ "GenMsgStartValue" BO_ 267 "0000000000000000000000801d00a007000000004027000000005de4d5030078f500005e3d0000af1e0000000000000000000000000000000000000000000000";
BA_ "VFrameFormat" BO_ 267 14;
BA_ "GenMsgCycleTime" BO_ 268 55;
BA_ "GenMsgSendType" BO_ 268 0;
BA_ "GenMsgStartValue" BO_ 268 "0000000000d00700401f000019002003007f00003200003200004b0000e80300803e0000a00f0080a20000000000000000000000000000000000000000000000";
BA_ "VFrameFormat" BO_ 268 14;
BA_ "GenMsgCycleTime" BO_ 269 55;
BA_ "GenMsgSendType" BO_ 269 0;
BA_ "GenMsgStartValue" BO_ 269 "0000000000000000000000801d00a007000000004027000000005de4d5030078f500005e3d0000af1e0000000000000000000000000000000000000000000000";
BA_ "VFrameFormat" BO_ 269 14;
BA_ "GenMsgCycleTime" BO_ 270 55;
BA_ "GenMsgSendType" BO_ 270 0;
BA_ "GenMsgStartValue" BO_ 270 "0000000000d00700401f000019002003007f00003200003200004b0000e80300803e0000a00f0080a20000000000000000000000000000000000000000000000";
BA_ "VFrameFormat" BO_ 270 14;
BA_ "GenMsgCycleTime" BO_ 271 55;
BA_ "GenMsgSendType" BO_ 271 0;
BA_ "GenMsgStartValue" BO_ 271 "0000000000000000000000801d00a007000000004027000000005de4d5030078f500005e3d0000af1e0000000000000000000000000000000000000000000000";
BA_ "VFrameFormat" BO_ 271 14;
BA_ "GenMsgCycleTime" BO_ 272 55;
BA_ "GenMsgSendType" BO_ 272 0;
BA_ "GenMsgStartValue" BO_ 272 "0000000000d00700401f000019002003007f00003200003200004b0000e80300803e0000a00f0080a20000000000000000000000000000000000000000000000";
BA_ "VFrameFormat" BO_ 272 14;
BA_ "GenMsgCycleTime" BO_ 273 55;
BA_ "GenMsgSendType" BO_ 273 0;
BA_ "GenMsgStartValue" BO_ 273 "0000000000000000000000801d00a007000000004027000000005de4d5030078f500005e3d0000af1e0000000000000000000000000000000000000000000000";
BA_ "VFrameFormat" BO_ 273 14;
BA_ "GenMsgCycleTime" BO_ 274 55;
BA_ "GenMsgSendType" BO_ 274 0;
BA_ "GenMsgStartValue" BO_ 274 "0000000000d00700401f000019002003007f00003200003200004b0000e80300803e0000a00f0080a20000000000000000000000000000000000000000000000";
BA_ "VFrameFormat" BO_ 274 14;
BA_ "GenMsgCycleTime" BO_ 275 55;
BA_ "GenMsgSendType" BO_ 275 0;
BA_ "GenMsgStartValue" BO_ 275 "0000000000000000000000801d00a007000000004027000000005de4d5030078f500005e3d0000af1e0000000000000000000000000000000000000000000000";
BA_ "VFrameFormat" BO_ 275 14;
BA_ "GenMsgCycleTime" BO_ 276 55;
BA_ "GenMsgSendType" BO_ 276 0;
BA_ "GenMsgStartValue" BO_ 276 "0000000000d00700401f000019002003007f00003200003200004b0000e80300803e0000a00f0080a20000000000000000000000000000000000000000000000";
BA_ "VFrameFormat" BO_ 276 14;
BA_ "GenMsgCycleTime" BO_ 277 55;
BA_ "GenMsgSendType" BO_ 277 0;
BA_ "GenMsgStartValue" BO_ 277 "0000000000000000000000801d00a007000000004027000000005de4d5030078f500005e3d0000af1e0000000000000000000000000000000000000000000000";
BA_ "VFrameFormat" BO_ 277 14;
BA_ "GenMsgCycleTime" BO_ 278 55;
BA_ "GenMsgSendType" BO_ 278 0;
BA_ "GenMsgStartValue" BO_ 278 "0000000000d00700401f000019002003007f00003200003200004b0000e80300803e0000a00f0080a20000000000000000000000000000000000000000000000";
BA_ "VFrameFormat" BO_ 278 14;
BA_ "GenMsgCycleTime" BO_ 279 55;
BA_ "GenMsgSendType" BO_ 279 0;
BA_ "GenMsgStartValue" BO_ 279 "0000000000000000000000801d00a007000000004027000000005de4d5030078f500005e3d0000af1e0000000000000000000000000000000000000000000000";
BA_ "VFrameFormat" BO_ 279 14;
BA_ "GenMsgCycleTime" BO_ 280 55;
BA_ "GenMsgSendType" BO_ 280 0;
BA_ "GenMsgStartValue" BO_ 280 "0000000000d00700401f000019002003007f00003200003200004b0000e80300803e0000a00f0080a20000000000000000000000000000000000000000000000";
BA_ "VFrameFormat" BO_ 280 14;
BA_ "GenMsgCycleTime" BO_ 281 55;
BA_ "GenMsgSendType" BO_ 281 0;
BA_ "GenMsgStartValue" BO_ 281 "0000000000000000000000801d00a007000000004027000000005de4d5030078f500005e3d0000af1e0000000000000000000000000000000000000000000000";
BA_ "VFrameFormat" BO_ 281 14;
BA_ "GenMsgCycleTime" BO_ 282 55;
BA_ "GenMsgSendType" BO_ 282 0;
BA_ "GenMsgStartValue" BO_ 282 "0000000000d00700401f000019002003007f00003200003200004b0000e80300803e0000a00f0080a20000000000000000000000000000000000000000000000";
BA_ "VFrameFormat" BO_ 282 14;
BA_ "GenMsgCycleTime" BO_ 283 55;
BA_ "GenMsgSendType" BO_ 283 0;
BA_ "GenMsgStartValue" BO_ 283 "0000000000000000000000801d00a007000000004027000000005de4d5030078f500005e3d0000af1e0000000000000000000000000000000000000000000000";
BA_ "VFrameFormat" BO_ 283 14;
BA_ "GenMsgCycleTime" BO_ 284 55;
BA_ "GenMsgSendType" BO_ 284 0;
BA_ "GenMsgStartValue" BO_ 284 "0000000000d00700401f000019002003007f00003200003200004b0000e80300803e0000a00f0080a20000000000000000000000000000000000000000000000";
BA_ "VFrameFormat" BO_ 284 14;
BA_ "GenMsgCycleTime" BO_ 285 55;
BA_ "GenMsgSendType" BO_ 285 0;
BA_ "GenMsgStartValue" BO_ 285 "0000000000000000000000801d00a007000000004027000000005de4d5030078f500005e3d0000af1e0000000000000000000000000000000000000000000000";
BA_ "VFrameFormat" BO_ 285 14;
BA_ "GenMsgCycleTime" BO_ 286 55;
BA_ "GenMsgSendType" BO_ 286 0;
BA_ "GenMsgStartValue" BO_ 286 "0000000000d00700401f000019002003007f00003200003200004b0000e80300803e0000a00f0080a20000000000000000000000000000000000000000000000";
BA_ "VFrameFormat" BO_ 286 14;
BA_ "GenMsgCycleTime" BO_ 287 55;
BA_ "GenMsgSendType" BO_ 287 0;
BA_ "GenMsgStartValue" BO_ 287 "0000000000000000000000801d00a007000000004027000000005de4d5030078f500005e3d0000af1e0000000000000000000000000000000000000000000000";
BA_ "VFrameFormat" BO_ 287 14;
BA_ "GenMsgCycleTime" BO_ 288 55;
BA_ "GenMsgSendType" BO_ 288 0;
BA_ "GenMsgStartValue" BO_ 288 "0000000000d00700401f000019002003007f00003200003200004b0000e80300803e0000a00f0080a20000000000000000000000000000000000000000000000";
BA_ "VFrameFormat" BO_ 288 14;
BA_ "GenMsgCycleTime" BO_ 289 55;
BA_ "GenMsgSendType" BO_ 289 0;
BA_ "GenMsgStartValue" BO_ 289 "0000000000000000000000801d00a007000000004027000000005de4d5030078f500005e3d0000af1e0000000000000000000000000000000000000000000000";
BA_ "VFrameFormat" BO_ 289 14;
BA_ "GenMsgCycleTime" BO_ 290 55;
BA_ "GenMsgSendType" BO_ 290 0;
BA_ "GenMsgStartValue" BO_ 290 "0000000000d00700401f000019002003007f00003200003200004b0000e80300803e0000a00f0080a20000000000000000000000000000000000000000000000";
BA_ "VFrameFormat" BO_ 290 14;
BA_ "GenMsgCycleTime" BO_ 291 55;
BA_ "GenMsgSendType" BO_ 291 0;
BA_ "GenMsgStartValue" BO_ 291 "0000000000000000000000801d00a007000000004027000000005de4d5030078f500005e3d0000af1e0000000000000000000000000000000000000000000000";
BA_ "VFrameFormat" BO_ 291 14;
BA_ "GenMsgCycleTime" BO_ 292 55;
BA_ "GenMsgSendType" BO_ 292 0;
BA_ "GenMsgStartValue" BO_ 292 "0000000000d00700401f000019002003007f00003200003200004b0000e80300803e0000a00f0080a20000000000000000000000000000000000000000000000";
BA_ "VFrameFormat" BO_ 292 14;
BA_ "GenMsgCycleTime" BO_ 293 55;
BA_ "GenMsgSendType" BO_ 293 0;
BA_ "GenMsgStartValue" BO_ 293 "0000000000000000000000801d00a007000000004027000000005de4d5030078f500005e3d0000af1e0000000000000000000000000000000000000000000000";
BA_ "VFrameFormat" BO_ 293 14;
BA_ "GenMsgCycleTime" BO_ 294 55;
BA_ "GenMsgSendType" BO_ 294 0;
BA_ "GenMsgStartValue" BO_ 294 "0000000000d00700401f000019002003007f00003200003200004b0000e80300803e0000a00f0080a20000000000000000000000000000000000000000000000";
BA_ "VFrameFormat" BO_ 294 14;
BA_ "GenMsgCycleTime" BO_ 295 55;
BA_ "GenMsgSendType" BO_ 295 0;
BA_ "GenMsgStartValue" BO_ 295 "0000000000000000000000801d00a007000000004027000000005de4d5030078f500005e3d0000af1e0000000000000000000000000000000000000000000000";
BA_ "VFrameFormat" BO_ 295 14;
BA_ "GenMsgCycleTime" BO_ 296 55;
BA_ "GenMsgSendType" BO_ 296 0;
BA_ "GenMsgStartValue" BO_ 296 "0000000000d00700401f000019002003007f00003200003200004b0000e80300803e0000a00f0080a20000000000000000000000000000000000000000000000";
BA_ "VFrameFormat" BO_ 296 14;
BA_ "GenMsgCycleTime" BO_ 256 55;
BA_ "GenMsgSendType" BO_ 256 0;
BA_ "GenMsgStartValue" BO_ 256 "00000000000000000000000000000000000000000000000000000000000000000000000000000000000000000000000000000000000000000000000000000000";
BA_ "VFrameFormat" BO_ 256 14;
BA_ "GenMsgCycleTime" BO_ 299 55;
BA_ "GenMsgSendType" BO_ 299 0;
BA_ "GenMsgStartValue" BO_ 299 "00000000c8127a005307000000e02e00004096d003983a0000000077010000000000000000000000000000000000000000000000000000000000000000000000";
BA_ "VFrameFormat" BO_ 299 14;
BA_ "GenMsgCycleTime" BO_ 301 55;
BA_ "GenMsgSendType" BO_ 301 0;
BA_ "GenMsgStartValue" BO_ 301 "0000000000000000409c0032ee02000000000000007102c8b80b00000000000000c40920e32e000000000000001027808cbb0000000000000000000000000000";
BA_ "VFrameFormat" BO_ 301 14;
BA_ "GenMsgCycleTime" BO_ 302 55;
BA_ "GenMsgSendType" BO_ 302 0;
BA_ "GenMsgStartValue" BO_ 302 "0000000000000000409c0032ee02000000000000007102c8b80b00000000000000c40920e32e000000000000001027808cbb0000000000000000000000000000";
BA_ "VFrameFormat" BO_ 302 14;
BA_ "GenMsgCycleTime" BO_ 303 55;
BA_ "GenMsgSendType" BO_ 303 0;
BA_ "GenMsgStartValue" BO_ 303 "0000000000000000409c0032ee02000000000000007102c8b80b0000000000000000000000000000000000000000000000000000000000000000000000000000";
BA_ "VFrameFormat" BO_ 303 14;
BA_ "GenMsgCycleTime" BO_ 307 55;
BA_ "GenMsgSendType" BO_ 307 0;
BA_ "GenMsgStartValue" BO_ 307 "00000000000000000000000000000000000000000000000000000000000000000000000000000000000000000000000000000000000000000000000000000000";
BA_ "VFrameFormat" BO_ 307 14;
VAL_ 264 Obj_03_AbsLongVelocityV 0 "" 1 "";
VAL_ 264 Obj_03_AbsLongVelSTDV 0 "" 1 "";
VAL_ 264 Obj_03_AbsLatVelocityV 0 "" 1 "";
VAL_ 264 Obj_03_AbsLatVelSTDV 0 "" 1 "";
VAL_ 264 Obj_03_AbsLongAccV 0 "" 1 "";
VAL_ 264 Obj_03_AbsLongAccSTDV 0 "" 1 "";
VAL_ 264 Obj_03_AbsLatAccV 0 "" 1 "";
VAL_ 264 Obj_03_AbsLatAccSTDV 0 "" 1 "";
VAL_ 264 Obj_03_AbsAccelerationV 0 "" 1 "";
VAL_ 264 Obj_03_AbsAccSTDV 0 "" 1 "";
VAL_ 264 Obj_03_InvTTCV 0 "" 1 "";
VAL_ 264 Obj_03_InvTTCSTDV 0 "" 1 "";
VAL_ 264 Obj_03_RelativeLongAccV 0 "" 1 "";
VAL_ 264 Obj_03_RelLongAccSTDV 0 "" 1 "";
VAL_ 264 Obj_03_LongtRltvSpdV 0 "" 1 "";
VAL_ 264 Obj_03_LongtRltvSpdSTDV 0 "" 1 "";
VAL_ 264 Obj_03_RelativeLatVelocityV 0 "" 1 "";
VAL_ 264 Obj_03_RelLatVelSTDV 0 "" 1 "";
VAL_ 264 Obj_03_LongDistanceV 0 "" 1 "";
VAL_ 264 Obj_03_LongDistanceSTDV 0 "" 1 "";
VAL_ 264 Obj_03_LatDistanceV 0 "" 1 "";
VAL_ 264 Obj_03_LatDistanceSTDV 0 "" 1 "";
VAL_ 264 Obj_03_AbsoluteSpeedV 0 "" 1 "";
VAL_ 264 Obj_03_AbsoluteSpeedSTDV 0 "" 1 "";
VAL_ 265 Obj_04_MotionCategory 0 "" 1 "" 2 "" 3 "" 4 "" 5 "" 6 "" 7 "" 8 "" 9 "" 10 "" 11 "" 12 "" 13 "";
VAL_ 265 Obj_04_MeasSts 0 "" 1 "" 2 "" 3 "" 4 "" 5 "" 6 "" 7 "";
VAL_ 265 Obj_04_Typ 0 "" 1 "" 2 "" 3 "" 4 "" 5 "" 6 "" 7 "" 8 "";
VAL_ 265 Obj_04_MotionSts 0 "" 1 "" 2 "" 3 "" 4 "" 5 "";
VAL_ 265 Obj_04_MotionOrientation 0 "" 1 "" 3 "" 5 "" 6 "" 7 "" 9 "" 11 "" 12 "" 13 "";
VAL_ 265 Obj_04_BrakeLight 0 "" 1 "";
VAL_ 265 Obj_04_TurnIndicatorRight 0 "" 1 "";
VAL_ 265 Obj_04_TurnIndicatorLeft 0 "" 1 "";
VAL_ 265 Obj_04_LightIndicatorValidity 0 "" 1 "";
VAL_ 265 Obj_04_LaneAssignment 0 "" 1 "" 2 "" 3 "" 4 "" 5 "";
VAL_ 265 Obj_04_LaneAssignmentV 0 "" 1 "";
VAL_ 265 Obj_04_WidthV 0 "" 1 "";
VAL_ 265 Obj_04_WidthSTDV 0 "" 1 "";
VAL_ 265 Obj_04_LengthV 0 "" 1 "";
VAL_ 265 Obj_04_LengthSTDV 0 "" 1 "";
VAL_ 265 Obj_04_HeightV 0 "" 1 "";
VAL_ 265 Obj_04_HeightSTDV 0 "" 1 "";
VAL_ 265 Obj_04_HeadingV 0 "" 1 "";
VAL_ 265 Obj_04_HeadingSTDV 0 "" 1 "";
VAL_ 265 Obj_04_AngleRateSTDV 0 "" 1 "";
VAL_ 265 Obj_04_AngleRateV 0 "" 1 "";
VAL_ 265 Obj_04_AngleRightV 0 "" 1 "";
VAL_ 265 Obj_04_AngleRightSTDV 0 "" 1 "";
VAL_ 265 Obj_04_AngleLeftV 0 "" 1 "";
VAL_ 265 Obj_04_AngleLeftSTDV 0 "" 1 "";
VAL_ 265 Obj_04_AngleSideV 0 "" 1 "";
VAL_ 265 Obj_04_AngleSideSTDV 0 "" 1 "";
VAL_ 265 Obj_04_AngleBottomV 0 "" 1 "";
VAL_ 265 Obj_04_AngleBottomSTDV 0 "" 1 "";
VAL_ 266 Obj_04_AbsLongVelocityV 0 "" 1 "";
VAL_ 266 Obj_04_AbsLongVelSTDV 0 "" 1 "";
VAL_ 266 Obj_04_AbsLatVelocityV 0 "" 1 "";
VAL_ 266 Obj_04_AbsLatVelSTDV 0 "" 1 "";
VAL_ 266 Obj_04_AbsLongAccV 0 "" 1 "";
VAL_ 266 Obj_04_AbsLongAccSTDV 0 "" 1 "";
VAL_ 266 Obj_04_AbsLatAccV 0 "" 1 "";
VAL_ 266 Obj_04_AbsLatAccSTDV 0 "" 1 "";
VAL_ 266 Obj_04_AbsAccelerationV 0 "" 1 "";
VAL_ 266 Obj_04_AbsAccSTDV 0 "" 1 "";
VAL_ 266 Obj_04_InvTTCV 0 "" 1 "";
VAL_ 266 Obj_04_InvTTCSTDV 0 "" 1 "";
VAL_ 266 Obj_04_RelativeLongAccV 0 "" 1 "";
VAL_ 266 Obj_04_RelLongAccSTDV 0 "" 1 "";
VAL_ 266 Obj_04_LongtRltvSpdV 0 "" 1 "";
VAL_ 266 Obj_04_LongtRltvSpdSTDV 0 "" 1 "";
VAL_ 266 Obj_04_RelativeLatVelocityV 0 "" 1 "";
VAL_ 266 Obj_04_RelLatVelSTDV 0 "" 1 "";
VAL_ 266 Obj_04_LongDistanceV 0 "" 1 "";
VAL_ 266 Obj_04_LongDistanceSTDV 0 "" 1 "";
VAL_ 266 Obj_04_LatDistanceV 0 "" 1 "";
VAL_ 266 Obj_04_LatDistanceSTDV 0 "" 1 "";
VAL_ 266 Obj_04_AbsoluteSpeedV 0 "" 1 "";
VAL_ 266 Obj_04_AbsoluteSpeedSTDV 0 "" 1 "";
VAL_ 267 Obj_05_MotionCategory 0 "" 1 "" 2 "" 3 "" 4 "" 5 "" 6 "" 7 "" 8 "" 9 "" 10 "" 11 "" 12 "" 13 "";
VAL_ 267 Obj_05_MeasSts 0 "" 1 "" 2 "" 3 "" 4 "" 5 "" 6 "" 7 "";
VAL_ 267 Obj_05_Typ 0 "" 1 "" 2 "" 3 "" 4 "" 5 "" 6 "" 7 "" 8 "";
VAL_ 267 Obj_05_MotionSts 0 "" 1 "" 2 "" 3 "" 4 "" 5 "";
VAL_ 267 Obj_05_MotionOrientation 0 "" 1 "" 3 "" 5 "" 6 "" 7 "" 9 "" 11 "" 12 "" 13 "";
VAL_ 267 Obj_05_BrakeLight 0 "" 1 "";
VAL_ 267 Obj_05_TurnIndicatorRight 0 "" 1 "";
VAL_ 267 Obj_05_TurnIndicatorLeft 0 "" 1 "";
VAL_ 267 Obj_05_LightIndicatorValidity 0 "" 1 "";
VAL_ 267 Obj_05_LaneAssignment 0 "" 1 "" 2 "" 3 "" 4 "" 5 "";
VAL_ 267 Obj_05_LaneAssignmentV 0 "" 1 "";
VAL_ 267 Obj_05_WidthV 0 "" 1 "";
VAL_ 267 Obj_05_WidthSTDV 0 "" 1 "";
VAL_ 267 Obj_05_LengthV 0 "" 1 "";
VAL_ 267 Obj_05_LengthSTDV 0 "" 1 "";
VAL_ 267 Obj_05_HeightV 0 "" 1 "";
VAL_ 267 Obj_05_HeightSTDV 0 "" 1 "";
VAL_ 267 Obj_05_HeadingV 0 "" 1 "";
VAL_ 267 Obj_05_HeadingSTDV 0 "" 1 "";
VAL_ 267 Obj_05_AngleRateSTDV 0 "" 1 "";
VAL_ 267 Obj_05_AngleRateV 0 "" 1 "";
VAL_ 267 Obj_05_AngleRightV 0 "" 1 "";
VAL_ 267 Obj_05_AngleRightSTDV 0 "" 1 "";
VAL_ 267 Obj_05_AngleLeftV 0 "" 1 "";
VAL_ 267 Obj_05_AngleLeftSTDV 0 "" 1 "";
VAL_ 267 Obj_05_AngleSideV 0 "" 1 "";
VAL_ 267 Obj_05_AngleSideSTDV 0 "" 1 "";
VAL_ 267 Obj_05_AngleBottomV 0 "" 1 "";
VAL_ 267 Obj_05_AngleBottomSTDV 0 "" 1 "";
VAL_ 268 Obj_05_AbsLongVelocityV 0 "" 1 "";
VAL_ 268 Obj_05_AbsLongVelSTDV 0 "" 1 "";
VAL_ 268 Obj_05_AbsLatVelocityV 0 "" 1 "";
VAL_ 268 Obj_05_AbsLatVelSTDV 0 "" 1 "";
VAL_ 268 Obj_05_AbsLongAccV 0 "" 1 "";
VAL_ 268 Obj_05_AbsLongAccSTDV 0 "" 1 "";
VAL_ 268 Obj_05_AbsLatAccV 0 "" 1 "";
VAL_ 268 Obj_05_AbsLatAccSTDV 0 "" 1 "";
VAL_ 268 Obj_05_AbsAccelerationV 0 "" 1 "";
VAL_ 268 Obj_05_AbsAccSTDV 0 "" 1 "";
VAL_ 268 Obj_05_InvTTCV 0 "" 1 "";
VAL_ 268 Obj_05_InvTTCSTDV 0 "" 1 "";
VAL_ 268 Obj_05_RelativeLongAccV 0 "" 1 "";
VAL_ 268 Obj_05_RelLongAccSTDV 0 "" 1 "";
VAL_ 268 Obj_05_LongtRltvSpdV 0 "" 1 "";
VAL_ 268 Obj_05_LongtRltvSpdSTDV 0 "" 1 "";
VAL_ 268 Obj_05_RelativeLatVelocityV 0 "" 1 "";
VAL_ 268 Obj_05_RelLatVelSTDV 0 "" 1 "";
VAL_ 268 Obj_05_LongDistanceV 0 "" 1 "";
VAL_ 268 Obj_05_LongDistanceSTDV 0 "" 1 "";
VAL_ 268 Obj_05_LatDistanceV 0 "" 1 "";
VAL_ 268 Obj_05_LatDistanceSTDV 0 "" 1 "";
VAL_ 268 Obj_05_AbsoluteSpeedV 0 "" 1 "";
VAL_ 268 Obj_05_AbsoluteSpeedSTDV 0 "" 1 "";
VAL_ 269 Obj_06_MotionCategory 0 "" 1 "" 2 "" 3 "" 4 "" 5 "" 6 "" 7 "" 8 "" 9 "" 10 "" 11 "" 12 "" 13 "";
VAL_ 269 Obj_06_MeasSts 0 "" 1 "" 2 "" 3 "" 4 "" 5 "" 6 "" 7 "";
VAL_ 269 Obj_06_Typ 0 "" 1 "" 2 "" 3 "" 4 "" 5 "" 6 "" 7 "" 8 "";
VAL_ 269 Obj_06_MotionSts 0 "" 1 "" 2 "" 3 "" 4 "" 5 "";
VAL_ 269 Obj_06_MotionOrientation 0 "" 1 "" 3 "" 5 "" 6 "" 7 "" 9 "" 11 "" 12 "" 13 "";
VAL_ 269 Obj_06_BrakeLight 0 "" 1 "";
VAL_ 269 Obj_06_TurnIndicatorRight 0 "" 1 "";
VAL_ 269 Obj_06_TurnIndicatorLeft 0 "" 1 "";
VAL_ 269 Obj_06_LightIndicatorValidity 0 "" 1 "";
VAL_ 269 Obj_06_LaneAssignment 0 "" 1 "" 2 "" 3 "" 4 "" 5 "";
VAL_ 269 Obj_06_LaneAssignmentV 0 "" 1 "";
VAL_ 269 Obj_06_WidthV 0 "" 1 "";
VAL_ 269 Obj_06_WidthSTDV 0 "" 1 "";
VAL_ 269 Obj_06_LengthV 0 "" 1 "";
VAL_ 269 Obj_06_LengthSTDV 0 "" 1 "";
VAL_ 269 Obj_06_HeightV 0 "" 1 "";
VAL_ 269 Obj_06_HeightSTDV 0 "" 1 "";
VAL_ 269 Obj_06_HeadingV 0 "" 1 "";
VAL_ 269 Obj_06_HeadingSTDV 0 "" 1 "";
VAL_ 269 Obj_06_AngleRateSTDV 0 "" 1 "";
VAL_ 269 Obj_06_AngleRateV 0 "" 1 "";
VAL_ 269 Obj_06_AngleRightV 0 "" 1 "";
VAL_ 269 Obj_06_AngleRightSTDV 0 "" 1 "";
VAL_ 269 Obj_06_AngleLeftV 0 "" 1 "";
VAL_ 269 Obj_06_AngleLeftSTDV 0 "" 1 "";
VAL_ 269 Obj_06_AngleSideV 0 "" 1 "";
VAL_ 269 Obj_06_AngleSideSTDV 0 "" 1 "";
VAL_ 269 Obj_06_AngleBottomV 0 "" 1 "";
VAL_ 269 Obj_06_AngleBottomSTDV 0 "" 1 "";
VAL_ 270 Obj_06_AbsLongVelocityV 0 "" 1 "";
VAL_ 270 Obj_06_AbsLongVelSTDV 0 "" 1 "";
VAL_ 270 Obj_06_AbsLatVelocityV 0 "" 1 "";
VAL_ 270 Obj_06_AbsLatVelSTDV 0 "" 1 "";
VAL_ 270 Obj_06_AbsLongAccV 0 "" 1 "";
VAL_ 270 Obj_06_AbsLongAccSTDV 0 "" 1 "";
VAL_ 270 Obj_06_AbsLatAccV 0 "" 1 "";
VAL_ 270 Obj_06_AbsLatAccSTDV 0 "" 1 "";
VAL_ 270 Obj_06_AbsAccelerationV 0 "" 1 "";
VAL_ 270 Obj_06_AbsAccSTDV 0 "" 1 "";
VAL_ 270 Obj_06_InvTTCV 0 "" 1 "";
VAL_ 270 Obj_06_InvTTCSTDV 0 "" 1 "";
VAL_ 270 Obj_06_RelativeLongAccV 0 "" 1 "";
VAL_ 270 Obj_06_RelLongAccSTDV 0 "" 1 "";
VAL_ 270 Obj_06_LongtRltvSpdV 0 "" 1 "";
VAL_ 270 Obj_06_LongtRltvSpdSTDV 0 "" 1 "";
VAL_ 270 Obj_06_RelativeLatVelocityV 0 "" 1 "";
VAL_ 270 Obj_06_RelLatVelSTDV 0 "" 1 "";
VAL_ 270 Obj_06_LongDistanceV 0 "" 1 "";
VAL_ 270 Obj_06_LongDistanceSTDV 0 "" 1 "";
VAL_ 270 Obj_06_LatDistanceV 0 "" 1 "";
VAL_ 270 Obj_06_LatDistanceSTDV 0 "" 1 "";
VAL_ 270 Obj_06_AbsoluteSpeedV 0 "" 1 "";
VAL_ 270 Obj_06_AbsoluteSpeedSTDV 0 "" 1 "";
VAL_ 271 Obj_07_MotionCategory 0 "" 1 "" 2 "" 3 "" 4 "" 5 "" 6 "" 7 "" 8 "" 9 "" 10 "" 11 "" 12 "" 13 "";
VAL_ 271 Obj_07_MeasSts 0 "" 1 "" 2 "" 3 "" 4 "" 5 "" 6 "" 7 "";
VAL_ 271 Obj_07_Typ 0 "" 1 "" 2 "" 3 "" 4 "" 5 "" 6 "" 7 "" 8 "";
VAL_ 271 Obj_07_MotionSts 0 "" 1 "" 2 "" 3 "" 4 "" 5 "";
VAL_ 271 Obj_07_MotionOrientation 0 "" 1 "" 3 "" 5 "" 6 "" 7 "" 9 "" 11 "" 12 "" 13 "";
VAL_ 271 Obj_07_BrakeLight 0 "" 1 "";
VAL_ 271 Obj_07_TurnIndicatorRight 0 "" 1 "";
VAL_ 271 Obj_07_TurnIndicatorLeft 0 "" 1 "";
VAL_ 271 Obj_07_LightIndicatorValidity 0 "" 1 "";
VAL_ 271 Obj_07_LaneAssignment 0 "" 1 "" 2 "" 3 "" 4 "" 5 "";
VAL_ 271 Obj_07_LaneAssignmentV 0 "" 1 "";
VAL_ 271 Obj_07_WidthV 0 "" 1 "";
VAL_ 271 Obj_07_WidthSTDV 0 "" 1 "";
VAL_ 271 Obj_07_LengthV 0 "" 1 "";
VAL_ 271 Obj_07_LengthSTDV 0 "" 1 "";
VAL_ 271 Obj_07_HeightV 0 "" 1 "";
VAL_ 271 Obj_07_HeightSTDV 0 "" 1 "";
VAL_ 271 Obj_07_HeadingV 0 "" 1 "";
VAL_ 271 Obj_07_HeadingSTDV 0 "" 1 "";
VAL_ 271 Obj_07_AngleRateSTDV 0 "" 1 "";
VAL_ 271 Obj_07_AngleRateV 0 "" 1 "";
VAL_ 271 Obj_07_AngleRightV 0 "" 1 "";
VAL_ 271 Obj_07_AngleRightSTDV 0 "" 1 "";
VAL_ 271 Obj_07_AngleLeftV 0 "" 1 "";
VAL_ 271 Obj_07_AngleLeftSTDV 0 "" 1 "";
VAL_ 271 Obj_07_AngleSideV 0 "" 1 "";
VAL_ 271 Obj_07_AngleSideSTDV 0 "" 1 "";
VAL_ 271 Obj_07_AngleBottomV 0 "" 1 "";
VAL_ 271 Obj_07_AngleBottomSTDV 0 "" 1 "";
VAL_ 272 Obj_07_AbsLongVelocityV 0 "" 1 "";
VAL_ 272 Obj_07_AbsLongVelSTDV 0 "" 1 "";
VAL_ 272 Obj_07_AbsLatVelocityV 0 "" 1 "";
VAL_ 272 Obj_07_AbsLatVelSTDV 0 "" 1 "";
VAL_ 272 Obj_07_AbsLongAccV 0 "" 1 "";
VAL_ 272 Obj_07_AbsLongAccSTDV 0 "" 1 "";
VAL_ 272 Obj_07_AbsLatAccV 0 "" 1 "";
VAL_ 272 Obj_07_AbsLatAccSTDV 0 "" 1 "";
VAL_ 272 Obj_07_AbsAccelerationV 0 "" 1 "";
VAL_ 272 Obj_07_AbsAccSTDV 0 "" 1 "";
VAL_ 272 Obj_07_InvTTCV 0 "" 1 "";
VAL_ 272 Obj_07_InvTTCSTDV 0 "" 1 "";
VAL_ 272 Obj_07_RelativeLongAccV 0 "" 1 "";
VAL_ 272 Obj_07_RelLongAccSTDV 0 "" 1 "";
VAL_ 272 Obj_07_LongtRltvSpdV 0 "" 1 "";
VAL_ 272 Obj_07_LongtRltvSpdSTDV 0 "" 1 "";
VAL_ 272 Obj_07_RelativeLatVelocityV 0 "" 1 "";
VAL_ 272 Obj_07_RelLatVelSTDV 0 "" 1 "";
VAL_ 272 Obj_07_LongDistanceV 0 "" 1 "";
VAL_ 272 Obj_07_LongDistanceSTDV 0 "" 1 "";
VAL_ 272 Obj_07_LatDistanceV 0 "" 1 "";
VAL_ 272 Obj_07_LatDistanceSTDV 0 "" 1 "";
VAL_ 272 Obj_07_AbsoluteSpeedV 0 "" 1 "";
VAL_ 272 Obj_07_AbsoluteSpeedSTDV 0 "" 1 "";
VAL_ 273 Obj_08_MotionCategory 0 "" 1 "" 2 "" 3 "" 4 "" 5 "" 6 "" 7 "" 8 "" 9 "" 10 "" 11 "" 12 "" 13 "";
VAL_ 273 Obj_08_MeasSts 0 "" 1 "" 2 "" 3 "" 4 "" 5 "" 6 "" 7 "";
VAL_ 273 Obj_08_Typ 0 "" 1 "" 2 "" 3 "" 4 "" 5 "" 6 "" 7 "" 8 "";
VAL_ 273 Obj_08_MotionSts 0 "" 1 "" 2 "" 3 "" 4 "" 5 "";
VAL_ 273 Obj_08_MotionOrientation 0 "" 1 "" 3 "" 5 "" 6 "" 7 "" 9 "" 11 "" 12 "" 13 "";
VAL_ 273 Obj_08_BrakeLight 0 "" 1 "";
VAL_ 273 Obj_08_TurnIndicatorRight 0 "" 1 "";
VAL_ 273 Obj_08_TurnIndicatorLeft 0 "" 1 "";
VAL_ 273 Obj_08_LightIndicatorValidity 0 "" 1 "";
VAL_ 273 Obj_08_LaneAssignment 0 "" 1 "" 2 "" 3 "" 4 "" 5 "";
VAL_ 273 Obj_08_LaneAssignmentV 0 "" 1 "";
VAL_ 273 Obj_08_WidthV 0 "" 1 "";
VAL_ 273 Obj_08_WidthSTDV 0 "" 1 "";
VAL_ 273 Obj_08_LengthV 0 "" 1 "";
VAL_ 273 Obj_08_LengthSTDV 0 "" 1 "";
VAL_ 273 Obj_08_HeightV 0 "" 1 "";
VAL_ 273 Obj_08_HeightSTDV 0 "" 1 "";
VAL_ 273 Obj_08_HeadingV 0 "" 1 "";
VAL_ 273 Obj_08_HeadingSTDV 0 "" 1 "";
VAL_ 273 Obj_08_AngleRateSTDV 0 "" 1 "";
VAL_ 273 Obj_08_AngleRateV 0 "" 1 "";
VAL_ 273 Obj_08_AngleRightV 0 "" 1 "";
VAL_ 273 Obj_08_AngleRightSTDV 0 "" 1 "";
VAL_ 273 Obj_08_AngleLeftV 0 "" 1 "";
VAL_ 273 Obj_08_AngleLeftSTDV 0 "" 1 "";
VAL_ 273 Obj_08_AngleSideV 0 "" 1 "";
VAL_ 273 Obj_08_AngleSideSTDV 0 "" 1 "";
VAL_ 273 Obj_08_AngleBottomV 0 "" 1 "";
VAL_ 273 Obj_08_AngleBottomSTDV 0 "" 1 "";
VAL_ 274 Obj_08_AbsLongVelocityV 0 "" 1 "";
VAL_ 274 Obj_08_AbsLongVelSTDV 0 "" 1 "";
VAL_ 274 Obj_08_AbsLatVelocityV 0 "" 1 "";
VAL_ 274 Obj_08_AbsLatVelSTDV 0 "" 1 "";
VAL_ 274 Obj_08_AbsLongAccV 0 "" 1 "";
VAL_ 274 Obj_08_AbsLongAccSTDV 0 "" 1 "";
VAL_ 274 Obj_08_AbsLatAccV 0 "" 1 "";
VAL_ 274 Obj_08_AbsLatAccSTDV 0 "" 1 "";
VAL_ 274 Obj_08_AbsAccelerationV 0 "" 1 "";
VAL_ 274 Obj_08_AbsAccSTDV 0 "" 1 "";
VAL_ 274 Obj_08_InvTTCV 0 "" 1 "";
VAL_ 274 Obj_08_InvTTCSTDV 0 "" 1 "";
VAL_ 274 Obj_08_RelativeLongAccV 0 "" 1 "";
VAL_ 274 Obj_08_RelLongAccSTDV 0 "" 1 "";
VAL_ 274 Obj_08_LongtRltvSpdV 0 "" 1 "";
VAL_ 274 Obj_08_LongtRltvSpdSTDV 0 "" 1 "";
VAL_ 274 Obj_08_RelativeLatVelocityV 0 "" 1 "";
VAL_ 274 Obj_08_RelLatVelSTDV 0 "" 1 "";
VAL_ 274 Obj_08_LongDistanceV 0 "" 1 "";
VAL_ 274 Obj_08_LongDistanceSTDV 0 "" 1 "";
VAL_ 274 Obj_08_LatDistanceV 0 "" 1 "";
VAL_ 274 Obj_08_LatDistanceSTDV 0 "" 1 "";
VAL_ 274 Obj_08_AbsoluteSpeedV 0 "" 1 "";
VAL_ 274 Obj_08_AbsoluteSpeedSTDV 0 "" 1 "";
VAL_ 275 Obj_09_MotionCategory 0 "" 1 "" 2 "" 3 "" 4 "" 5 "" 6 "" 7 "" 8 "" 9 "" 10 "" 11 "" 12 "" 13 "";
VAL_ 275 Obj_09_MeasSts 0 "" 1 "" 2 "" 3 "" 4 "" 5 "" 6 "" 7 "";
VAL_ 275 Obj_09_Typ 0 "" 1 "" 2 "" 3 "" 4 "" 5 "" 6 "" 7 "" 8 "";
VAL_ 275 Obj_09_MotionSts 0 "" 1 "" 2 "" 3 "" 4 "" 5 "";
VAL_ 275 Obj_09_MotionOrientation 0 "" 1 "" 3 "" 5 "" 6 "" 7 "" 9 "" 11 "" 12 "" 13 "";
VAL_ 275 Obj_09_BrakeLight 0 "" 1 "";
VAL_ 275 Obj_09_TurnIndicatorRight 0 "" 1 "";
VAL_ 275 Obj_09_TurnIndicatorLeft 0 "" 1 "";
VAL_ 275 Obj_09_LightIndicatorValidity 0 "" 1 "";
VAL_ 275 Obj_09_LaneAssignment 0 "" 1 "" 2 "" 3 "" 4 "" 5 "";
VAL_ 275 Obj_09_LaneAssignmentV 0 "" 1 "";
VAL_ 275 Obj_09_WidthV 0 "" 1 "";
VAL_ 275 Obj_09_WidthSTDV 0 "" 1 "";
VAL_ 275 Obj_09_LengthV 0 "" 1 "";
VAL_ 275 Obj_09_LengthSTDV 0 "" 1 "";
VAL_ 275 Obj_09_HeightV 0 "" 1 "";
VAL_ 275 Obj_09_HeightSTDV 0 "" 1 "";
VAL_ 275 Obj_09_HeadingV 0 "" 1 "";
VAL_ 275 Obj_09_HeadingSTDV 0 "" 1 "";
VAL_ 275 Obj_09_AngleRateSTDV 0 "" 1 "";
VAL_ 275 Obj_09_AngleRateV 0 "" 1 "";
VAL_ 275 Obj_09_AngleRightV 0 "" 1 "";
VAL_ 275 Obj_09_AngleRightSTDV 0 "" 1 "";
VAL_ 275 Obj_09_AngleLeftV 0 "" 1 "";
VAL_ 275 Obj_09_AngleLeftSTDV 0 "" 1 "";
VAL_ 275 Obj_09_AngleSideV 0 "" 1 "";
VAL_ 275 Obj_09_AngleSideSTDV 0 "" 1 "";
VAL_ 275 Obj_09_AngleBottomV 0 "" 1 "";
VAL_ 275 Obj_09_AngleBottomSTDV 0 "" 1 "";
VAL_ 276 Obj_09_AbsLongVelocityV 0 "" 1 "";
VAL_ 276 Obj_09_AbsLongVelSTDV 0 "" 1 "";
VAL_ 276 Obj_09_AbsLatVelocityV 0 "" 1 "";
VAL_ 276 Obj_09_AbsLatVelSTDV 0 "" 1 "";
VAL_ 276 Obj_09_AbsLongAccV 0 "" 1 "";
VAL_ 276 Obj_09_AbsLongAccSTDV 0 "" 1 "";
VAL_ 276 Obj_09_AbsLatAccV 0 "" 1 "";
VAL_ 276 Obj_09_AbsLatAccSTDV 0 "" 1 "";
VAL_ 276 Obj_09_AbsAccelerationV 0 "" 1 "";
VAL_ 276 Obj_09_AbsAccSTDV 0 "" 1 "";
VAL_ 276 Obj_09_InvTTCV 0 "" 1 "";
VAL_ 276 Obj_09_InvTTCSTDV 0 "" 1 "";
VAL_ 276 Obj_09_RelativeLongAccV 0 "" 1 "";
VAL_ 276 Obj_09_RelLongAccSTDV 0 "" 1 "";
VAL_ 276 Obj_09_LongtRltvSpdV 0 "" 1 "";
VAL_ 276 Obj_09_LongtRltvSpdSTDV 0 "" 1 "";
VAL_ 276 Obj_09_RelativeLatVelocityV 0 "" 1 "";
VAL_ 276 Obj_09_RelLatVelSTDV 0 "" 1 "";
VAL_ 276 Obj_09_LongDistanceV 0 "" 1 "";
VAL_ 276 Obj_09_LongDistanceSTDV 0 "" 1 "";
VAL_ 276 Obj_09_LatDistanceV 0 "" 1 "";
VAL_ 276 Obj_09_LatDistanceSTDV 0 "" 1 "";
VAL_ 276 Obj_09_AbsoluteSpeedV 0 "" 1 "";
VAL_ 276 Obj_09_AbsoluteSpeedSTDV 0 "" 1 "";
VAL_ 277 Obj_10_MotionCategory 0 "" 1 "" 2 "" 3 "" 4 "" 5 "" 6 "" 7 "" 8 "" 9 "" 10 "" 11 "" 12 "" 13 "";
VAL_ 277 Obj_10_MeasSts 0 "" 1 "" 2 "" 3 "" 4 "" 5 "" 6 "" 7 "";
VAL_ 277 Obj_10_Typ 0 "" 1 "" 2 "" 3 "" 4 "" 5 "" 6 "" 7 "" 8 "";
VAL_ 277 Obj_10_MotionSts 0 "" 1 "" 2 "" 3 "" 4 "" 5 "";
VAL_ 277 Obj_10_MotionOrientation 0 "" 1 "" 3 "" 5 "" 6 "" 7 "" 9 "" 11 "" 12 "" 13 "";
VAL_ 277 Obj_10_BrakeLight 0 "" 1 "";
VAL_ 277 Obj_10_TurnIndicatorRight 0 "" 1 "";
VAL_ 277 Obj_10_TurnIndicatorLeft 0 "" 1 "";
VAL_ 277 Obj_10_LightIndicatorValidity 0 "" 1 "";
VAL_ 277 Obj_10_LaneAssignment 0 "" 1 "" 2 "" 3 "" 4 "" 5 "";
VAL_ 277 Obj_10_LaneAssignmentV 0 "" 1 "";
VAL_ 277 Obj_10_WidthV 0 "" 1 "";
VAL_ 277 Obj_10_WidthSTDV 0 "" 1 "";
VAL_ 277 Obj_10_LengthV 0 "" 1 "";
VAL_ 277 Obj_10_LengthSTDV 0 "" 1 "";
VAL_ 277 Obj_10_HeightV 0 "" 1 "";
VAL_ 277 Obj_10_HeightSTDV 0 "" 1 "";
VAL_ 277 Obj_10_HeadingV 0 "" 1 "";
VAL_ 277 Obj_10_HeadingSTDV 0 "" 1 "";
VAL_ 277 Obj_10_AngleRateSTDV 0 "" 1 "";
VAL_ 277 Obj_10_AngleRateV 0 "" 1 "";
VAL_ 277 Obj_10_AngleRightV 0 "" 1 "";
VAL_ 277 Obj_10_AngleRightSTDV 0 "" 1 "";
VAL_ 277 Obj_10_AngleLeftV 0 "" 1 "";
VAL_ 277 Obj_10_AngleLeftSTDV 0 "" 1 "";
VAL_ 277 Obj_10_AngleSideV 0 "" 1 "";
VAL_ 277 Obj_10_AngleSideSTDV 0 "" 1 "";
VAL_ 277 Obj_10_AngleBottomV 0 "" 1 "";
VAL_ 277 Obj_10_AngleBottomSTDV 0 "" 1 "";
VAL_ 278 Obj_10_AbsLongVelocityV 0 "" 1 "";
VAL_ 278 Obj_10_AbsLongVelSTDV 0 "" 1 "";
VAL_ 278 Obj_10_AbsLatVelocityV 0 "" 1 "";
VAL_ 278 Obj_10_AbsLatVelSTDV 0 "" 1 "";
VAL_ 278 Obj_10_AbsLongAccV 0 "" 1 "";
VAL_ 278 Obj_10_AbsLongAccSTDV 0 "" 1 "";
VAL_ 278 Obj_10_AbsLatAccV 0 "" 1 "";
VAL_ 278 Obj_10_AbsLatAccSTDV 0 "" 1 "";
VAL_ 278 Obj_10_AbsAccelerationV 0 "" 1 "";
VAL_ 278 Obj_10_AbsAccSTDV 0 "" 1 "";
VAL_ 278 Obj_10_InvTTCV 0 "" 1 "";
VAL_ 278 Obj_10_InvTTCSTDV 0 "" 1 "";
VAL_ 278 Obj_10_RelativeLongAccV 0 "" 1 "";
VAL_ 278 Obj_10_RelLongAccSTDV 0 "" 1 "";
VAL_ 278 Obj_10_LongtRltvSpdV 0 "" 1 "";
VAL_ 278 Obj_10_LongtRltvSpdSTDV 0 "" 1 "";
VAL_ 278 Obj_10_RelativeLatVelocityV 0 "" 1 "";
VAL_ 278 Obj_10_RelLatVelSTDV 0 "" 1 "";
VAL_ 278 Obj_10_LongDistanceV 0 "" 1 "";
VAL_ 278 Obj_10_LongDistanceSTDV 0 "" 1 "";
VAL_ 278 Obj_10_LatDistanceV 0 "" 1 "";
VAL_ 278 Obj_10_LatDistanceSTDV 0 "" 1 "";
VAL_ 278 Obj_10_AbsoluteSpeedV 0 "" 1 "";
VAL_ 278 Obj_10_AbsoluteSpeedSTDV 0 "" 1 "";
VAL_ 279 Obj_11_MotionCategory 0 "" 1 "" 2 "" 3 "" 4 "" 5 "" 6 "" 7 "" 8 "" 9 "" 10 "" 11 "" 12 "" 13 "";
VAL_ 279 Obj_11_MeasSts 0 "" 1 "" 2 "" 3 "" 4 "" 5 "" 6 "" 7 "";
VAL_ 279 Obj_11_Typ 0 "" 1 "" 2 "" 3 "" 4 "" 5 "" 6 "" 7 "" 8 "";
VAL_ 279 Obj_11_MotionSts 0 "" 1 "" 2 "" 3 "" 4 "" 5 "";
VAL_ 279 Obj_11_MotionOrientation 0 "" 1 "" 3 "" 5 "" 6 "" 7 "" 9 "" 11 "" 12 "" 13 "";
VAL_ 279 Obj_11_BrakeLight 0 "" 1 "";
VAL_ 279 Obj_11_TurnIndicatorRight 0 "" 1 "";
VAL_ 279 Obj_11_TurnIndicatorLeft 0 "" 1 "";
VAL_ 279 Obj_11_LightIndicatorValidity 0 "" 1 "";
VAL_ 279 Obj_11_LaneAssignment 0 "" 1 "" 2 "" 3 "" 4 "" 5 "";
VAL_ 279 Obj_11_LaneAssignmentV 0 "" 1 "";
VAL_ 279 Obj_11_WidthV 0 "" 1 "";
VAL_ 279 Obj_11_WidthSTDV 0 "" 1 "";
VAL_ 279 Obj_11_LengthV 0 "" 1 "";
VAL_ 279 Obj_11_LengthSTDV 0 "" 1 "";
VAL_ 279 Obj_11_HeightV 0 "" 1 "";
VAL_ 279 Obj_11_HeightSTDV 0 "" 1 "";
VAL_ 279 Obj_11_HeadingV 0 "" 1 "";
VAL_ 279 Obj_11_HeadingSTDV 0 "" 1 "";
VAL_ 279 Obj_11_AngleRateSTDV 0 "" 1 "";
VAL_ 279 Obj_11_AngleRateV 0 "" 1 "";
VAL_ 279 Obj_11_AngleRightV 0 "" 1 "";
VAL_ 279 Obj_11_AngleRightSTDV 0 "" 1 "";
VAL_ 279 Obj_11_AngleLeftV 0 "" 1 "";
VAL_ 279 Obj_11_AngleLeftSTDV 0 "" 1 "";
VAL_ 279 Obj_11_AngleSideV 0 "" 1 "";
VAL_ 279 Obj_11_AngleSideSTDV 0 "" 1 "";
VAL_ 279 Obj_11_AngleBottomV 0 "" 1 "";
VAL_ 279 Obj_11_AngleBottomSTDV 0 "" 1 "";
VAL_ 280 Obj_11_AbsLongVelocityV 0 "" 1 "";
VAL_ 280 Obj_11_AbsLongVelSTDV 0 "" 1 "";
VAL_ 280 Obj_11_AbsLatVelocityV 0 "" 1 "";
VAL_ 280 Obj_11_AbsLatVelSTDV 0 "" 1 "";
VAL_ 280 Obj_11_AbsLongAccV 0 "" 1 "";
VAL_ 280 Obj_11_AbsLongAccSTDV 0 "" 1 "";
VAL_ 280 Obj_11_AbsLatAccV 0 "" 1 "";
VAL_ 280 Obj_11_AbsLatAccSTDV 0 "" 1 "";
VAL_ 280 Obj_11_AbsAccelerationV 0 "" 1 "";
VAL_ 280 Obj_11_AbsAccSTDV 0 "" 1 "";
VAL_ 280 Obj_11_InvTTCV 0 "" 1 "";
VAL_ 280 Obj_11_InvTTCSTDV 0 "" 1 "";
VAL_ 280 Obj_11_RelativeLongAccV 0 "" 1 "";
VAL_ 280 Obj_11_RelLongAccSTDV 0 "" 1 "";
VAL_ 280 Obj_11_LongtRltvSpdV 0 "" 1 "";
VAL_ 280 Obj_11_LongtRltvSpdSTDV 0 "" 1 "";
VAL_ 280 Obj_11_RelativeLatVelocityV 0 "" 1 "";
VAL_ 280 Obj_11_RelLatVelSTDV 0 "" 1 "";
VAL_ 280 Obj_11_LongDistanceV 0 "" 1 "";
VAL_ 280 Obj_11_LongDistanceSTDV 0 "" 1 "";
VAL_ 280 Obj_11_LatDistanceV 0 "" 1 "";
VAL_ 280 Obj_11_LatDistanceSTDV 0 "" 1 "";
VAL_ 280 Obj_11_AbsoluteSpeedV 0 "" 1 "";
VAL_ 280 Obj_11_AbsoluteSpeedSTDV 0 "" 1 "";
VAL_ 281 Obj_12_MotionCategory 0 "" 1 "" 2 "" 3 "" 4 "" 5 "" 6 "" 7 "" 8 "" 9 "" 10 "" 11 "" 12 "" 13 "";
VAL_ 281 Obj_12_MeasSts 0 "" 1 "" 2 "" 3 "" 4 "" 5 "" 6 "" 7 "";
VAL_ 281 Obj_12_Typ 0 "" 1 "" 2 "" 3 "" 4 "" 5 "" 6 "" 7 "" 8 "";
VAL_ 281 Obj_12_MotionSts 0 "" 1 "" 2 "" 3 "" 4 "" 5 "";
VAL_ 281 Obj_12_MotionOrientation 0 "" 1 "" 3 "" 5 "" 6 "" 7 "" 9 "" 11 "" 12 "" 13 "";
VAL_ 281 Obj_12_BrakeLight 0 "" 1 "";
VAL_ 281 Obj_12_TurnIndicatorRight 0 "" 1 "";
VAL_ 281 Obj_12_TurnIndicatorLeft 0 "" 1 "";
VAL_ 281 Obj_12_LightIndicatorValidity 0 "" 1 "";
VAL_ 281 Obj_12_LaneAssignment 0 "" 1 "" 2 "" 3 "" 4 "" 5 "";
VAL_ 281 Obj_12_LaneAssignmentV 0 "" 1 "";
VAL_ 281 Obj_12_WidthV 0 "" 1 "";
VAL_ 281 Obj_12_WidthSTDV 0 "" 1 "";
VAL_ 281 Obj_12_LengthV 0 "" 1 "";
VAL_ 281 Obj_12_LengthSTDV 0 "" 1 "";
VAL_ 281 Obj_12_HeightV 0 "" 1 "";
VAL_ 281 Obj_12_HeightSTDV 0 "" 1 "";
VAL_ 281 Obj_12_HeadingV 0 "" 1 "";
VAL_ 281 Obj_12_HeadingSTDV 0 "" 1 "";
VAL_ 281 Obj_12_AngleRateSTDV 0 "" 1 "";
VAL_ 281 Obj_12_AngleRateV 0 "" 1 "";
VAL_ 281 Obj_12_AngleRightV 0 "" 1 "";
VAL_ 281 Obj_12_AngleRightSTDV 0 "" 1 "";
VAL_ 281 Obj_12_AngleLeftV 0 "" 1 "";
VAL_ 281 Obj_12_AngleLeftSTDV 0 "" 1 "";
VAL_ 281 Obj_12_AngleSideV 0 "" 1 "";
VAL_ 281 Obj_12_AngleSideSTDV 0 "" 1 "";
VAL_ 281 Obj_12_AngleBottomV 0 "" 1 "";
VAL_ 281 Obj_12_AngleBottomSTDV 0 "" 1 "";
VAL_ 282 Obj_12_AbsLongVelocityV 0 "" 1 "";
VAL_ 282 Obj_12_AbsLongVelSTDV 0 "" 1 "";
VAL_ 282 Obj_12_AbsLatVelocityV 0 "" 1 "";
VAL_ 282 Obj_12_AbsLatVelSTDV 0 "" 1 "";
VAL_ 282 Obj_12_AbsLongAccV 0 "" 1 "";
VAL_ 282 Obj_12_AbsLongAccSTDV 0 "" 1 "";
VAL_ 282 Obj_12_AbsLatAccV 0 "" 1 "";
VAL_ 282 Obj_12_AbsLatAccSTDV 0 "" 1 "";
VAL_ 282 Obj_12_AbsAccelerationV 0 "" 1 "";
VAL_ 282 Obj_12_AbsAccSTDV 0 "" 1 "";
VAL_ 282 Obj_12_InvTTCV 0 "" 1 "";
VAL_ 282 Obj_12_InvTTCSTDV 0 "" 1 "";
VAL_ 282 Obj_12_RelativeLongAccV 0 "" 1 "";
VAL_ 282 Obj_12_RelLongAccSTDV 0 "" 1 "";
VAL_ 282 Obj_12_LongtRltvSpdV 0 "" 1 "";
VAL_ 282 Obj_12_LongtRltvSpdSTDV 0 "" 1 "";
VAL_ 282 Obj_12_RelativeLatVelocityV 0 "" 1 "";
VAL_ 282 Obj_12_RelLatVelSTDV 0 "" 1 "";
VAL_ 282 Obj_12_LongDistanceV 0 "" 1 "";
VAL_ 282 Obj_12_LongDistanceSTDV 0 "" 1 "";
VAL_ 282 Obj_12_LatDistanceV 0 "" 1 "";
VAL_ 282 Obj_12_LatDistanceSTDV 0 "" 1 "";
VAL_ 282 Obj_12_AbsoluteSpeedV 0 "" 1 "";
VAL_ 282 Obj_12_AbsoluteSpeedSTDV 0 "" 1 "";
VAL_ 283 Obj_13_MotionCategory 0 "" 1 "" 2 "" 3 "" 4 "" 5 "" 6 "" 7 "" 8 "" 9 "" 10 "" 11 "" 12 "" 13 "";
VAL_ 283 Obj_13_MeasSts 0 "" 1 "" 2 "" 3 "" 4 "" 5 "" 6 "" 7 "";
VAL_ 283 Obj_13_Typ 0 "" 1 "" 2 "" 3 "" 4 "" 5 "" 6 "" 7 "" 8 "";
VAL_ 283 Obj_13_MotionSts 0 "" 1 "" 2 "" 3 "" 4 "" 5 "";
VAL_ 283 Obj_13_MotionOrientation 0 "" 1 "" 3 "" 5 "" 6 "" 7 "" 9 "" 11 "" 12 "" 13 "";
VAL_ 283 Obj_13_BrakeLight 0 "" 1 "";
VAL_ 283 Obj_13_TurnIndicatorRight 0 "" 1 "";
VAL_ 283 Obj_13_TurnIndicatorLeft 0 "" 1 "";
VAL_ 283 Obj_13_LightIndicatorValidity 0 "" 1 "";
VAL_ 283 Obj_13_LaneAssignment 0 "" 1 "" 2 "" 3 "" 4 "" 5 "";
VAL_ 283 Obj_13_LaneAssignmentV 0 "" 1 "";
VAL_ 283 Obj_13_WidthV 0 "" 1 "";
VAL_ 283 Obj_13_WidthSTDV 0 "" 1 "";
VAL_ 283 Obj_13_LengthV 0 "" 1 "";
VAL_ 283 Obj_13_LengthSTDV 0 "" 1 "";
VAL_ 283 Obj_13_HeightV 0 "" 1 "";
VAL_ 283 Obj_13_HeightSTDV 0 "" 1 "";
VAL_ 283 Obj_13_HeadingV 0 "" 1 "";
VAL_ 283 Obj_13_HeadingSTDV 0 "" 1 "";
VAL_ 283 Obj_13_AngleRateSTDV 0 "" 1 "";
VAL_ 283 Obj_13_AngleRateV 0 "" 1 "";
VAL_ 283 Obj_13_AngleRightV 0 "" 1 "";
VAL_ 283 Obj_13_AngleRightSTDV 0 "" 1 "";
VAL_ 283 Obj_13_AngleLeftV 0 "" 1 "";
VAL_ 283 Obj_13_AngleLeftSTDV 0 "" 1 "";
VAL_ 283 Obj_13_AngleSideV 0 "" 1 "";
VAL_ 283 Obj_13_AngleSideSTDV 0 "" 1 "";
VAL_ 283 Obj_13_AngleBottomV 0 "" 1 "";
VAL_ 283 Obj_13_AngleBottomSTDV 0 "" 1 "";
VAL_ 284 Obj_13_AbsLongVelocityV 0 "" 1 "";
VAL_ 284 Obj_13_AbsLongVelSTDV 0 "" 1 "";
VAL_ 284 Obj_13_AbsLatVelocityV 0 "" 1 "";
VAL_ 284 Obj_13_AbsLatVelSTDV 0 "" 1 "";
VAL_ 284 Obj_13_AbsLongAccV 0 "" 1 "";
VAL_ 284 Obj_13_AbsLongAccSTDV 0 "" 1 "";
VAL_ 284 Obj_13_AbsLatAccV 0 "" 1 "";
VAL_ 284 Obj_13_AbsLatAccSTDV 0 "" 1 "";
VAL_ 284 Obj_13_AbsAccelerationV 0 "" 1 "";
VAL_ 284 Obj_13_AbsAccSTDV 0 "" 1 "";
VAL_ 284 Obj_13_InvTTCV 0 "" 1 "";
VAL_ 284 Obj_13_InvTTCSTDV 0 "" 1 "";
VAL_ 284 Obj_13_RelativeLongAccV 0 "" 1 "";
VAL_ 284 Obj_13_RelLongAccSTDV 0 "" 1 "";
VAL_ 284 Obj_13_LongtRltvSpdV 0 "" 1 "";
VAL_ 284 Obj_13_LongtRltvSpdSTDV 0 "" 1 "";
VAL_ 284 Obj_13_RelativeLatVelocityV 0 "" 1 "";
VAL_ 284 Obj_13_RelLatVelSTDV 0 "" 1 "";
VAL_ 284 Obj_13_LongDistanceV 0 "" 1 "";
VAL_ 284 Obj_13_LongDistanceSTDV 0 "" 1 "";
VAL_ 284 Obj_13_LatDistanceV 0 "" 1 "";
VAL_ 284 Obj_13_LatDistanceSTDV 0 "" 1 "";
VAL_ 284 Obj_13_AbsoluteSpeedV 0 "" 1 "";
VAL_ 284 Obj_13_AbsoluteSpeedSTDV 0 "" 1 "";
VAL_ 285 Obj_14_MotionCategory 0 "" 1 "" 2 "" 3 "" 4 "" 5 "" 6 "" 7 "" 8 "" 9 "" 10 "" 11 "" 12 "" 13 "";
VAL_ 285 Obj_14_MeasSts 0 "" 1 "" 2 "" 3 "" 4 "" 5 "" 6 "" 7 "";
VAL_ 285 Obj_14_Typ 0 "" 1 "" 2 "" 3 "" 4 "" 5 "" 6 "" 7 "" 8 "";
VAL_ 285 Obj_14_MotionSts 0 "" 1 "" 2 "" 3 "" 4 "" 5 "";
VAL_ 285 Obj_14_MotionOrientation 0 "" 1 "" 3 "" 5 "" 6 "" 7 "" 9 "" 11 "" 12 "" 13 "";
VAL_ 285 Obj_14_BrakeLight 0 "" 1 "";
VAL_ 285 Obj_14_TurnIndicatorRight 0 "" 1 "";
VAL_ 285 Obj_14_TurnIndicatorLeft 0 "" 1 "";
VAL_ 285 Obj_14_LightIndicatorValidity 0 "" 1 "";
VAL_ 285 Obj_14_LaneAssignment 0 "" 1 "" 2 "" 3 "" 4 "" 5 "";
VAL_ 285 Obj_14_LaneAssignmentV 0 "" 1 "";
VAL_ 285 Obj_14_WidthV 0 "" 1 "";
VAL_ 285 Obj_14_WidthSTDV 0 "" 1 "";
VAL_ 285 Obj_14_LengthV 0 "" 1 "";
VAL_ 285 Obj_14_LengthSTDV 0 "" 1 "";
VAL_ 285 Obj_14_HeightV 0 "" 1 "";
VAL_ 285 Obj_14_HeightSTDV 0 "" 1 "";
VAL_ 285 Obj_14_HeadingV 0 "" 1 "";
VAL_ 285 Obj_14_HeadingSTDV 0 "" 1 "";
VAL_ 285 Obj_14_AngleRateSTDV 0 "" 1 "";
VAL_ 285 Obj_14_AngleRateV 0 "" 1 "";
VAL_ 285 Obj_14_AngleRightV 0 "" 1 "";
VAL_ 285 Obj_14_AngleRightSTDV 0 "" 1 "";
VAL_ 285 Obj_14_AngleLeftV 0 "" 1 "";
VAL_ 285 Obj_14_AngleLeftSTDV 0 "" 1 "";
VAL_ 285 Obj_14_AngleSideV 0 "" 1 "";
VAL_ 285 Obj_14_AngleSideSTDV 0 "" 1 "";
VAL_ 285 Obj_14_AngleBottomV 0 "" 1 "";
VAL_ 285 Obj_14_AngleBottomSTDV 0 "" 1 "";
VAL_ 286 Obj_14_AbsLongVelocityV 0 "" 1 "";
VAL_ 286 Obj_14_AbsLongVelSTDV 0 "" 1 "";
VAL_ 286 Obj_14_AbsLatVelocityV 0 "" 1 "";
VAL_ 286 Obj_14_AbsLatVelSTDV 0 "" 1 "";
VAL_ 286 Obj_14_AbsLongAccV 0 "" 1 "";
VAL_ 286 Obj_14_AbsLongAccSTDV 0 "" 1 "";
VAL_ 286 Obj_14_AbsLatAccV 0 "" 1 "";
VAL_ 286 Obj_14_AbsLatAccSTDV 0 "" 1 "";
VAL_ 286 Obj_14_AbsAccelerationV 0 "" 1 "";
VAL_ 286 Obj_14_AbsAccSTDV 0 "" 1 "";
VAL_ 286 Obj_14_InvTTCV 0 "" 1 "";
VAL_ 286 Obj_14_InvTTCSTDV 0 "" 1 "";
VAL_ 286 Obj_14_RelativeLongAccV 0 "" 1 "";
VAL_ 286 Obj_14_RelLongAccSTDV 0 "" 1 "";
VAL_ 286 Obj_14_LongtRltvSpdV 0 "" 1 "";
VAL_ 286 Obj_14_LongtRltvSpdSTDV 0 "" 1 "";
VAL_ 286 Obj_14_RelativeLatVelocityV 0 "" 1 "";
VAL_ 286 Obj_14_RelLatVelSTDV 0 "" 1 "";
VAL_ 286 Obj_14_LongDistanceV 0 "" 1 "";
VAL_ 286 Obj_14_LongDistanceSTDV 0 "" 1 "";
VAL_ 286 Obj_14_LatDistanceV 0 "" 1 "";
VAL_ 286 Obj_14_LatDistanceSTDV 0 "" 1 "";
VAL_ 286 Obj_14_AbsoluteSpeedV 0 "" 1 "";
VAL_ 286 Obj_14_AbsoluteSpeedSTDV 0 "" 1 "";
VAL_ 287 Obj_15_MotionCategory 0 "" 1 "" 2 "" 3 "" 4 "" 5 "" 6 "" 7 "" 8 "" 9 "" 10 "" 11 "" 12 "" 13 "";
VAL_ 287 Obj_15_MeasSts 0 "" 1 "" 2 "" 3 "" 4 "" 5 "" 6 "" 7 "";
VAL_ 287 Obj_15_Typ 0 "" 1 "" 2 "" 3 "" 4 "" 5 "" 6 "" 7 "" 8 "";
VAL_ 287 Obj_15_MotionSts 0 "" 1 "" 2 "" 3 "" 4 "" 5 "";
VAL_ 287 Obj_15_MotionOrientation 0 "" 1 "" 3 "" 5 "" 6 "" 7 "" 9 "" 11 "" 12 "" 13 "";
VAL_ 287 Obj_15_BrakeLight 0 "" 1 "";
VAL_ 287 Obj_15_TurnIndicatorRight 0 "" 1 "";
VAL_ 287 Obj_15_TurnIndicatorLeft 0 "" 1 "";
VAL_ 287 Obj_15_LightIndicatorValidity 0 "" 1 "";
VAL_ 287 Obj_15_LaneAssignment 0 "" 1 "" 2 "" 3 "" 4 "" 5 "";
VAL_ 287 Obj_15_LaneAssignmentV 0 "" 1 "";
VAL_ 287 Obj_15_WidthV 0 "" 1 "";
VAL_ 287 Obj_15_WidthSTDV 0 "" 1 "";
VAL_ 287 Obj_15_LengthV 0 "" 1 "";
VAL_ 287 Obj_15_LengthSTDV 0 "" 1 "";
VAL_ 287 Obj_15_HeightV 0 "" 1 "";
VAL_ 287 Obj_15_HeightSTDV 0 "" 1 "";
VAL_ 287 Obj_15_HeadingV 0 "" 1 "";
VAL_ 287 Obj_15_HeadingSTDV 0 "" 1 "";
VAL_ 287 Obj_15_AngleRateSTDV 0 "" 1 "";
VAL_ 287 Obj_15_AngleRateV 0 "" 1 "";
VAL_ 287 Obj_15_AngleRightV 0 "" 1 "";
VAL_ 287 Obj_15_AngleRightSTDV 0 "" 1 "";
VAL_ 287 Obj_15_AngleLeftV 0 "" 1 "";
VAL_ 287 Obj_15_AngleLeftSTDV 0 "" 1 "";
VAL_ 287 Obj_15_AngleSideV 0 "" 1 "";
VAL_ 287 Obj_15_AngleSideSTDV 0 "" 1 "";
VAL_ 287 Obj_15_AngleBottomV 0 "" 1 "";
VAL_ 287 Obj_15_AngleBottomSTDV 0 "" 1 "";
VAL_ 288 Obj_15_AbsLongVelocityV 0 "" 1 "";
VAL_ 288 Obj_15_AbsLongVelSTDV 0 "" 1 "";
VAL_ 288 Obj_15_AbsLatVelocityV 0 "" 1 "";
VAL_ 288 Obj_15_AbsLatVelSTDV 0 "" 1 "";
VAL_ 288 Obj_15_AbsLongAccV 0 "" 1 "";
VAL_ 288 Obj_15_AbsLongAccSTDV 0 "" 1 "";
VAL_ 288 Obj_15_AbsLatAccV 0 "" 1 "";
VAL_ 288 Obj_15_AbsLatAccSTDV 0 "" 1 "";
VAL_ 288 Obj_15_AbsAccelerationV 0 "" 1 "";
VAL_ 288 Obj_15_AbsAccSTDV 0 "" 1 "";
VAL_ 288 Obj_15_InvTTCV 0 "" 1 "";
VAL_ 288 Obj_15_InvTTCSTDV 0 "" 1 "";
VAL_ 288 Obj_15_RelativeLongAccV 0 "" 1 "";
VAL_ 288 Obj_15_RelLongAccSTDV 0 "" 1 "";
VAL_ 288 Obj_15_LongtRltvSpdV 0 "" 1 "";
VAL_ 288 Obj_15_LongtRltvSpdSTDV 0 "" 1 "";
VAL_ 288 Obj_15_RelativeLatVelocityV 0 "" 1 "";
VAL_ 288 Obj_15_RelLatVelSTDV 0 "" 1 "";
VAL_ 288 Obj_15_LongDistanceV 0 "" 1 "";
VAL_ 288 Obj_15_LongDistanceSTDV 0 "" 1 "";
VAL_ 288 Obj_15_LatDistanceV 0 "" 1 "";
VAL_ 288 Obj_15_LatDistanceSTDV 0 "" 1 "";
VAL_ 288 Obj_15_AbsoluteSpeedV 0 "" 1 "";
VAL_ 288 Obj_15_AbsoluteSpeedSTDV 0 "" 1 "";
VAL_ 289 Obj_16_MotionCategory 0 "" 1 "" 2 "" 3 "" 4 "" 5 "" 6 "" 7 "" 8 "" 9 "" 10 "" 11 "" 12 "" 13 "";
VAL_ 289 Obj_16_MeasSts 0 "" 1 "" 2 "" 3 "" 4 "" 5 "" 6 "" 7 "";
VAL_ 289 Obj_16_Typ 0 "" 1 "" 2 "" 3 "" 4 "" 5 "" 6 "" 7 "" 8 "";
VAL_ 289 Obj_16_MotionSts 0 "" 1 "" 2 "" 3 "" 4 "" 5 "";
VAL_ 289 Obj_16_MotionOrientation 0 "" 1 "" 3 "" 5 "" 6 "" 7 "" 9 "" 11 "" 12 "" 13 "";
VAL_ 289 Obj_16_BrakeLight 0 "" 1 "";
VAL_ 289 Obj_16_TurnIndicatorRight 0 "" 1 "";
VAL_ 289 Obj_16_TurnIndicatorLeft 0 "" 1 "";
VAL_ 289 Obj_16_LightIndicatorValidity 0 "" 1 "";
VAL_ 289 Obj_16_LaneAssignment 0 "" 1 "" 2 "" 3 "" 4 "" 5 "";
VAL_ 289 Obj_16_LaneAssignmentV 0 "" 1 "";
VAL_ 289 Obj_16_WidthV 0 "" 1 "";
VAL_ 289 Obj_16_WidthSTDV 0 "" 1 "";
VAL_ 289 Obj_16_LengthV 0 "" 1 "";
VAL_ 289 Obj_16_LengthSTDV 0 "" 1 "";
VAL_ 289 Obj_16_HeightV 0 "" 1 "";
VAL_ 289 Obj_16_HeightSTDV 0 "" 1 "";
VAL_ 289 Obj_16_HeadingV 0 "" 1 "";
VAL_ 289 Obj_16_HeadingSTDV 0 "" 1 "";
VAL_ 289 Obj_16_AngleRateSTDV 0 "" 1 "";
VAL_ 289 Obj_16_AngleRateV 0 "" 1 "";
VAL_ 289 Obj_16_AngleRightV 0 "" 1 "";
VAL_ 289 Obj_16_AngleRightSTDV 0 "" 1 "";
VAL_ 289 Obj_16_AngleLeftV 0 "" 1 "";
VAL_ 289 Obj_16_AngleLeftSTDV 0 "" 1 "";
VAL_ 289 Obj_16_AngleSideV 0 "" 1 "";
VAL_ 289 Obj_16_AngleSideSTDV 0 "" 1 "";
VAL_ 289 Obj_16_AngleBottomV 0 "" 1 "";
VAL_ 289 Obj_16_AngleBottomSTDV 0 "" 1 "";
VAL_ 290 Obj_16_AbsLongVelocityV 0 "" 1 "";
VAL_ 290 Obj_16_AbsLongVelSTDV 0 "" 1 "";
VAL_ 290 Obj_16_AbsLatVelocityV 0 "" 1 "";
VAL_ 290 Obj_16_AbsLatVelSTDV 0 "" 1 "";
VAL_ 290 Obj_16_AbsLongAccV 0 "" 1 "";
VAL_ 290 Obj_16_AbsLongAccSTDV 0 "" 1 "";
VAL_ 290 Obj_16_AbsLatAccV 0 "" 1 "";
VAL_ 290 Obj_16_AbsLatAccSTDV 0 "" 1 "";
VAL_ 290 Obj_16_AbsAccelerationV 0 "" 1 "";
VAL_ 290 Obj_16_AbsAccSTDV 0 "" 1 "";
VAL_ 290 Obj_16_InvTTCV 0 "" 1 "";
VAL_ 290 Obj_16_InvTTCSTDV 0 "" 1 "";
VAL_ 290 Obj_16_RelativeLongAccV 0 "" 1 "";
VAL_ 290 Obj_16_RelLongAccSTDV 0 "" 1 "";
VAL_ 290 Obj_16_LongtRltvSpdV 0 "" 1 "";
VAL_ 290 Obj_16_LongtRltvSpdSTDV 0 "" 1 "";
VAL_ 290 Obj_16_RelativeLatVelocityV 0 "" 1 "";
VAL_ 290 Obj_16_RelLatVelSTDV 0 "" 1 "";
VAL_ 290 Obj_16_LongDistanceV 0 "" 1 "";
VAL_ 290 Obj_16_LongDistanceSTDV 0 "" 1 "";
VAL_ 290 Obj_16_LatDistanceV 0 "" 1 "";
VAL_ 290 Obj_16_LatDistanceSTDV 0 "" 1 "";
VAL_ 290 Obj_16_AbsoluteSpeedV 0 "" 1 "";
VAL_ 290 Obj_16_AbsoluteSpeedSTDV 0 "" 1 "";
VAL_ 291 Obj_17_MotionCategory 0 "" 1 "" 2 "" 3 "" 4 "" 5 "" 6 "" 7 "" 8 "" 9 "" 10 "" 11 "" 12 "" 13 "";
VAL_ 291 Obj_17_MeasSts 0 "" 1 "" 2 "" 3 "" 4 "" 5 "" 6 "" 7 "";
VAL_ 291 Obj_17_Typ 0 "" 1 "" 2 "" 3 "" 4 "" 5 "" 6 "" 7 "" 8 "";
VAL_ 291 Obj_17_MotionSts 0 "" 1 "" 2 "" 3 "" 4 "" 5 "";
VAL_ 291 Obj_17_MotionOrientation 0 "" 1 "" 3 "" 5 "" 6 "" 7 "" 9 "" 11 "" 12 "" 13 "";
VAL_ 291 Obj_17_BrakeLight 0 "" 1 "";
VAL_ 291 Obj_17_TurnIndicatorRight 0 "" 1 "";
VAL_ 291 Obj_17_TurnIndicatorLeft 0 "" 1 "";
VAL_ 291 Obj_17_LightIndicatorValidity 0 "" 1 "";
VAL_ 291 Obj_17_LaneAssignment 0 "" 1 "" 2 "" 3 "" 4 "" 5 "";
VAL_ 291 Obj_17_LaneAssignmentV 0 "" 1 "";
VAL_ 291 Obj_17_WidthV 0 "" 1 "";
VAL_ 291 Obj_17_WidthSTDV 0 "" 1 "";
VAL_ 291 Obj_17_LengthV 0 "" 1 "";
VAL_ 291 Obj_17_LengthSTDV 0 "" 1 "";
VAL_ 291 Obj_17_HeightV 0 "" 1 "";
VAL_ 291 Obj_17_HeightSTDV 0 "" 1 "";
VAL_ 291 Obj_17_HeadingV 0 "" 1 "";
VAL_ 291 Obj_17_HeadingSTDV 0 "" 1 "";
VAL_ 291 Obj_17_AngleRateSTDV 0 "" 1 "";
VAL_ 291 Obj_17_AngleRateV 0 "" 1 "";
VAL_ 291 Obj_17_AngleRightV 0 "" 1 "";
VAL_ 291 Obj_17_AngleRightSTDV 0 "" 1 "";
VAL_ 291 Obj_17_AngleLeftV 0 "" 1 "";
VAL_ 291 Obj_17_AngleLeftSTDV 0 "" 1 "";
VAL_ 291 Obj_17_AngleSideV 0 "" 1 "";
VAL_ 291 Obj_17_AngleSideSTDV 0 "" 1 "";
VAL_ 291 Obj_17_AngleBottomV 0 "" 1 "";
VAL_ 291 Obj_17_AngleBottomSTDV 0 "" 1 "";
VAL_ 292 Obj_17_AbsLongVelocityV 0 "" 1 "";
VAL_ 292 Obj_17_AbsLongVelSTDV 0 "" 1 "";
VAL_ 292 Obj_17_AbsLatVelocityV 0 "" 1 "";
VAL_ 292 Obj_17_AbsLatVelSTDV 0 "" 1 "";
VAL_ 292 Obj_17_AbsLongAccV 0 "" 1 "";
VAL_ 292 Obj_17_AbsLongAccSTDV 0 "" 1 "";
VAL_ 292 Obj_17_AbsLatAccV 0 "" 1 "";
VAL_ 292 Obj_17_AbsLatAccSTDV 0 "" 1 "";
VAL_ 292 Obj_17_AbsAccelerationV 0 "" 1 "";
VAL_ 292 Obj_17_AbsAccSTDV 0 "" 1 "";
VAL_ 292 Obj_17_InvTTCV 0 "" 1 "";
VAL_ 292 Obj_17_InvTTCSTDV 0 "" 1 "";
VAL_ 292 Obj_17_RelativeLongAccV 0 "" 1 "";
VAL_ 292 Obj_17_RelLongAccSTDV 0 "" 1 "";
VAL_ 292 Obj_17_LongtRltvSpdV 0 "" 1 "";
VAL_ 292 Obj_17_LongtRltvSpdSTDV 0 "" 1 "";
VAL_ 292 Obj_17_RelativeLatVelocityV 0 "" 1 "";
VAL_ 292 Obj_17_RelLatVelSTDV 0 "" 1 "";
VAL_ 292 Obj_17_LongDistanceV 0 "" 1 "";
VAL_ 292 Obj_17_LongDistanceSTDV 0 "" 1 "";
VAL_ 292 Obj_17_LatDistanceV 0 "" 1 "";
VAL_ 292 Obj_17_LatDistanceSTDV 0 "" 1 "";
VAL_ 292 Obj_17_AbsoluteSpeedV 0 "" 1 "";
VAL_ 292 Obj_17_AbsoluteSpeedSTDV 0 "" 1 "";
VAL_ 293 Obj_18_MotionCategory 0 "" 1 "" 2 "" 3 "" 4 "" 5 "" 6 "" 7 "" 8 "" 9 "" 10 "" 11 "" 12 "" 13 "";
VAL_ 293 Obj_18_MeasSts 0 "" 1 "" 2 "" 3 "" 4 "" 5 "" 6 "" 7 "";
VAL_ 293 Obj_18_Typ 0 "" 1 "" 2 "" 3 "" 4 "" 5 "" 6 "" 7 "" 8 "";
VAL_ 293 Obj_18_MotionSts 0 "" 1 "" 2 "" 3 "" 4 "" 5 "";
VAL_ 293 Obj_18_MotionOrientation 0 "" 1 "" 3 "" 5 "" 6 "" 7 "" 9 "" 11 "" 12 "" 13 "";
VAL_ 293 Obj_18_BrakeLight 0 "" 1 "";
VAL_ 293 Obj_18_TurnIndicatorRight 0 "" 1 "";
VAL_ 293 Obj_18_TurnIndicatorLeft 0 "" 1 "";
VAL_ 293 Obj_18_LightIndicatorValidity 0 "" 1 "";
VAL_ 293 Obj_18_LaneAssignment 0 "" 1 "" 2 "" 3 "" 4 "" 5 "";
VAL_ 293 Obj_18_LaneAssignmentV 0 "" 1 "";
VAL_ 293 Obj_18_WidthV 0 "" 1 "";
VAL_ 293 Obj_18_WidthSTDV 0 "" 1 "";
VAL_ 293 Obj_18_LengthV 0 "" 1 "";
VAL_ 293 Obj_18_LengthSTDV 0 "" 1 "";
VAL_ 293 Obj_18_HeightV 0 "" 1 "";
VAL_ 293 Obj_18_HeightSTDV 0 "" 1 "";
VAL_ 293 Obj_18_HeadingV 0 "" 1 "";
VAL_ 293 Obj_18_HeadingSTDV 0 "" 1 "";
VAL_ 293 Obj_18_AngleRateSTDV 0 "" 1 "";
VAL_ 293 Obj_18_AngleRateV 0 "" 1 "";
VAL_ 293 Obj_18_AngleRightV 0 "" 1 "";
VAL_ 293 Obj_18_AngleRightSTDV 0 "" 1 "";
VAL_ 293 Obj_18_AngleLeftV 0 "" 1 "";
VAL_ 293 Obj_18_AngleLeftSTDV 0 "" 1 "";
VAL_ 293 Obj_18_AngleSideV 0 "" 1 "";
VAL_ 293 Obj_18_AngleSideSTDV 0 "" 1 "";
VAL_ 293 Obj_18_AngleBottomV 0 "" 1 "";
VAL_ 293 Obj_18_AngleBottomSTDV 0 "" 1 "";
VAL_ 294 Obj_18_AbsLongVelocityV 0 "" 1 "";
VAL_ 294 Obj_18_AbsLongVelSTDV 0 "" 1 "";
VAL_ 294 Obj_18_AbsLatVelocityV 0 "" 1 "";
VAL_ 294 Obj_18_AbsLatVelSTDV 0 "" 1 "";
VAL_ 294 Obj_18_AbsLongAccV 0 "" 1 "";
VAL_ 294 Obj_18_AbsLongAccSTDV 0 "" 1 "";
VAL_ 294 Obj_18_AbsLatAccV 0 "" 1 "";
VAL_ 294 Obj_18_AbsLatAccSTDV 0 "" 1 "";
VAL_ 294 Obj_18_AbsAccelerationV 0 "" 1 "";
VAL_ 294 Obj_18_AbsAccSTDV 0 "" 1 "";
VAL_ 294 Obj_18_InvTTCV 0 "" 1 "";
VAL_ 294 Obj_18_InvTTCSTDV 0 "" 1 "";
VAL_ 294 Obj_18_RelativeLongAccV 0 "" 1 "";
VAL_ 294 Obj_18_RelLongAccSTDV 0 "" 1 "";
VAL_ 294 Obj_18_LongtRltvSpdV 0 "" 1 "";
VAL_ 294 Obj_18_LongtRltvSpdSTDV 0 "" 1 "";
VAL_ 294 Obj_18_RelativeLatVelocityV 0 "" 1 "";
VAL_ 294 Obj_18_RelLatVelSTDV 0 "" 1 "";
VAL_ 294 Obj_18_LongDistanceV 0 "" 1 "";
VAL_ 294 Obj_18_LongDistanceSTDV 0 "" 1 "";
VAL_ 294 Obj_18_LatDistanceV 0 "" 1 "";
VAL_ 294 Obj_18_LatDistanceSTDV 0 "" 1 "";
VAL_ 294 Obj_18_AbsoluteSpeedV 0 "" 1 "";
VAL_ 294 Obj_18_AbsoluteSpeedSTDV 0 "" 1 "";
VAL_ 295 Obj_19_MotionCategory 0 "" 1 "" 2 "" 3 "" 4 "" 5 "" 6 "" 7 "" 8 "" 9 "" 10 "" 11 "" 12 "" 13 "";
VAL_ 295 Obj_19_MeasSts 0 "" 1 "" 2 "" 3 "" 4 "" 5 "" 6 "" 7 "";
VAL_ 295 Obj_19_Typ 0 "" 1 "" 2 "" 3 "" 4 "" 5 "" 6 "" 7 "" 8 "";
VAL_ 295 Obj_19_MotionSts 0 "" 1 "" 2 "" 3 "" 4 "" 5 "";
VAL_ 295 Obj_19_MotionOrientation 0 "" 1 "" 3 "" 5 "" 6 "" 7 "" 9 "" 11 "" 12 "" 13 "";
VAL_ 295 Obj_19_BrakeLight 0 "" 1 "";
VAL_ 295 Obj_19_TurnIndicatorRight 0 "" 1 "";
VAL_ 295 Obj_19_TurnIndicatorLeft 0 "" 1 "";
VAL_ 295 Obj_19_LightIndicatorValidity 0 "" 1 "";
VAL_ 295 Obj_19_LaneAssignment 0 "" 1 "" 2 "" 3 "" 4 "" 5 "";
VAL_ 295 Obj_19_LaneAssignmentV 0 "" 1 "";
VAL_ 295 Obj_19_WidthV 0 "" 1 "";
VAL_ 295 Obj_19_WidthSTDV 0 "" 1 "";
VAL_ 295 Obj_19_LengthV 0 "" 1 "";
VAL_ 295 Obj_19_LengthSTDV 0 "" 1 "";
VAL_ 295 Obj_19_HeightV 0 "" 1 "";
VAL_ 295 Obj_19_HeightSTDV 0 "" 1 "";
VAL_ 295 Obj_19_HeadingV 0 "" 1 "";
VAL_ 295 Obj_19_HeadingSTDV 0 "" 1 "";
VAL_ 295 Obj_19_AngleRateSTDV 0 "" 1 "";
VAL_ 295 Obj_19_AngleRateV 0 "" 1 "";
VAL_ 295 Obj_19_AngleRightV 0 "" 1 "";
VAL_ 295 Obj_19_AngleRightSTDV 0 "" 1 "";
VAL_ 295 Obj_19_AngleLeftV 0 "" 1 "";
VAL_ 295 Obj_19_AngleLeftSTDV 0 "" 1 "";
VAL_ 295 Obj_19_AngleSideV 0 "" 1 "";
VAL_ 295 Obj_19_AngleSideSTDV 0 "" 1 "";
VAL_ 295 Obj_19_AngleBottomV 0 "" 1 "";
VAL_ 295 Obj_19_AngleBottomSTDV 0 "" 1 "";
VAL_ 296 Obj_19_AbsLongVelocityV 0 "" 1 "";
VAL_ 296 Obj_19_AbsLongVelSTDV 0 "" 1 "";
VAL_ 296 Obj_19_AbsLatVelocityV 0 "" 1 "";
VAL_ 296 Obj_19_AbsLatVelSTDV 0 "" 1 "";
VAL_ 296 Obj_19_AbsLongAccV 0 "" 1 "";
VAL_ 296 Obj_19_AbsLongAccSTDV 0 "" 1 "";
VAL_ 296 Obj_19_AbsLatAccV 0 "" 1 "";
VAL_ 296 Obj_19_AbsLatAccSTDV 0 "" 1 "";
VAL_ 296 Obj_19_AbsAccelerationV 0 "" 1 "";
VAL_ 296 Obj_19_AbsAccSTDV 0 "" 1 "";
VAL_ 296 Obj_19_InvTTCV 0 "" 1 "";
VAL_ 296 Obj_19_InvTTCSTDV 0 "" 1 "";
VAL_ 296 Obj_19_RelativeLongAccV 0 "" 1 "";
VAL_ 296 Obj_19_RelLongAccSTDV 0 "" 1 "";
VAL_ 296 Obj_19_LongtRltvSpdV 0 "" 1 "";
VAL_ 296 Obj_19_LongtRltvSpdSTDV 0 "" 1 "";
VAL_ 296 Obj_19_RelativeLatVelocityV 0 "" 1 "";
VAL_ 296 Obj_19_RelLatVelSTDV 0 "" 1 "";
VAL_ 296 Obj_19_LongDistanceV 0 "" 1 "";
VAL_ 296 Obj_19_LongDistanceSTDV 0 "" 1 "";
VAL_ 296 Obj_19_LatDistanceV 0 "" 1 "";
VAL_ 296 Obj_19_LatDistanceSTDV 0 "" 1 "";
VAL_ 296 Obj_19_AbsoluteSpeedV 0 "" 1 "";
VAL_ 296 Obj_19_AbsoluteSpeedSTDV 0 "" 1 "";
VAL_ 256 ObjVdCipvLost 0 "" 1 "" 2 "";
VAL_ 256 ObjIsBlockedLeft 0 "" 1 "";
VAL_ 256 ObjIsBlockedRight 0 "" 1 "";
VAL_ 299 RE_Head_CRC 0 "cm_RE_Head_CRC";
VAL_ 299 RE_Head_ALIVE 0 "cm_RE_Head_ALIVE";
VAL_ 299 RE0_MeasureType 0 "" 1 "" 2 "" 3 "";
VAL_ 299 RE0_MarkerType 0 "" 1 "" 2 "" 3 "" 4 "";
VAL_ 299 RE1_MeasureType 0 "" 1 "" 2 "" 3 "";
VAL_ 299 RE1_MarkerType 0 "" 1 "" 2 "" 3 "" 4 "";
VAL_ 307 HLB_Decision 0 "" 1 "" 2 "";
SIG_GROUP_ 264 FVCM_Obj03_B 1 :;
SIG_GROUP_ 265 FVCM_Obj04_A 1 :;
SIG_GROUP_ 266 FVCM_Obj04_B 1 :;
SIG_GROUP_ 267 FVCM_Obj05_A 1 :;
SIG_GROUP_ 268 FVCM_Obj05_B 1 :;
SIG_GROUP_ 269 FVCM_Obj06_A 1 :;
SIG_GROUP_ 270 FVCM_Obj06_B 1 :;
SIG_GROUP_ 271 FVCM_Obj07_A 1 :;
SIG_GROUP_ 272 FVCM_Obj07_B 1 :;
SIG_GROUP_ 273 FVCM_Obj08_A 1 :;
SIG_GROUP_ 274 FVCM_Obj08_B 1 :;
SIG_GROUP_ 275 FVCM_Obj09_A 1 :;
SIG_GROUP_ 276 FVCM_Obj09_B 1 :;
SIG_GROUP_ 277 FVCM_Obj10_A 1 :;
SIG_GROUP_ 278 FVCM_Obj10_B 1 :;
SIG_GROUP_ 279 FVCM_Obj11_A 1 :;
SIG_GROUP_ 280 FVCM_Obj11_B 1 :;
SIG_GROUP_ 281 FVCM_Obj12_A 1 :;
SIG_GROUP_ 282 FVCM_Obj12_B 1 :;
SIG_GROUP_ 283 FVCM_Obj13_A 1 :;
SIG_GROUP_ 284 FVCM_Obj13_B 1 :;
SIG_GROUP_ 285 FVCM_Obj14_A 1 :;
SIG_GROUP_ 286 FVCM_Obj14_B 1 :;
SIG_GROUP_ 287 FVCM_Obj15_A 1 :;
SIG_GROUP_ 288 FVCM_Obj15_B 1 :;
SIG_GROUP_ 289 FVCM_Obj16_A 1 :;
SIG_GROUP_ 290 FVCM_Obj16_B 1 :;
SIG_GROUP_ 291 FVCM_Obj17_A 1 :;
SIG_GROUP_ 292 FVCM_Obj17_B 1 :;
SIG_GROUP_ 293 FVCM_Obj18_A 1 :;
SIG_GROUP_ 294 FVCM_Obj18_B 1 :;
SIG_GROUP_ 295 FVCM_Obj19_A 1 :;
SIG_GROUP_ 296 FVCM_Obj19_B 1 :;
SIG_GROUP_ 256 FVCM_ObjGeneral_Information 1 :;
SIG_GROUP_ 299 FVCM_RE 1 :;
SIG_GROUP_ 301 FVCM_TSR_A 1 :;
SIG_GROUP_ 302 FVCM_TSR_B 1 :;
SIG_GROUP_ 303 FVCM_TSR_C 1 :;
SIG_GROUP_ 307 HLB 1 :;
