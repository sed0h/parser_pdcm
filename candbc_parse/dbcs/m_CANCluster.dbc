VERSION "created by canmatrix"

NS_ :

BS_:

BU_: FVCM

BO_ 513 FDR_Object_0: 64 Vector__XXX
 SG_ OD_Info_CRC_00 : 0|16@1+ (1,0) [0|65535] "" FVCM
 SG_ OD_Info_ALIVE_00 : 16|8@1+ (1,0) [0|255] "" FVCM
 SG_ IsNew_00 : 24|2@1+ (1,0) [0|3] "" FVCM
 SG_ ClassificationType_00 : 26|3@1+ (1,0) [0|7] "" FVCM
 SG_ MeasurementStatus_00 : 29|3@1+ (1,0) [0|7] "" FVCM
 SG_ LongitudinalDistance_00 : 32|13@1+ (0.05,-50) [-50.00|359.55] "m" FVCM
 SG_ MovementStatus_00 : 45|3@1+ (1,0) [0|7] "" FVCM
 SG_ ObjectID_00 : 48|8@1+ (1,0) [0|255] "" FVCM
 SG_ ReferencePoint_00 : 56|4@1+ (1,0) [0|15] "" FVCM
 SG_ AbsLongVelocity_00 : 60|12@1+ (0.05,-100) [-100.00|104.75] "m/s" FVCM
 SG_ AbsLatAccSTD_00 : 72|9@1+ (0.008,0) [0.000|4.088] "m/s²" FVCM
 SG_ Reserved_PMOI_Debug_Signal1_00 : 81|8@1+ (0.01,-1) [-1.00|1.55] "" FVCM
 SG_ ExistenceProbability_00 : 89|7@1+ (1,0) [0|127] "%" FVCM
 SG_ AbsLatVeloSTD_00 : 96|9@1+ (0.02,0) [0.00|10.22] "m/s" FVCM
 SG_ ClassificationTypeProbability_00 : 105|7@1+ (1,0) [0|127] "%" FVCM
 SG_ AbsLongAccSTD_00 : 112|9@1+ (0.008,0) [0.000|4.088] "m/s²" FVCM
 SG_ AbsLongVelocitySTD_00 : 121|9@1+ (0.02,0) [0.00|10.22] "m/s" FVCM
 SG_ AbsLatVelocity_00 : 130|12@1+ (0.05,-100) [-100.00|104.75] "m/s" FVCM
 SG_ LengthSTD_00 : 142|7@1+ (0.1,0) [0|12.7] "m" FVCM
 SG_ AbsLatAcc_00 : 149|10@1+ (0.05,-25) [-25.00|26.15] "m/s²" FVCM
 SG_ AbsLongAcc__00 : 159|10@1+ (0.05,-25) [-25.00|26.15] "m/s²" FVCM
 SG_ Width_00 : 169|6@1+ (0.1,0) [0|6.3] "m" FVCM
 SG_ WidthSTD_00 : 175|6@1+ (0.1,0) [0|6.3] "m" FVCM
 SG_ Reserved_PMOI_Debug_Signal2_00 : 181|8@1+ (0.01,-1) [-1.00|1.55] "m/s" FVCM
 SG_ ObjectAge_00 : 189|13@1+ (0.06,0) [0.00|491.46] "s" FVCM
 SG_ Reserved_PMOI_Debug_Signal3_00 : 202|8@1+ (0.01,-1) [-1.00|1.55] "" FVCM
 SG_ Reserved_PMOI_Debug_Signal4_00 : 210|8@1+ (0.01,-1) [-1.00|1.55] "" FVCM
 SG_ LateralDistance_00 : 218|12@1+ (0.05,-100) [-100.00|104.75] "m" FVCM
 SG_ LateralDistanceSTD_00 : 230|9@1+ (0.05,0) [0.00|25.55] "m" FVCM
 SG_ LongitudinalDistanceSTD_00 : 239|9@1+ (0.05,0) [0.00|25.55] "m" FVCM
 SG_ Length_00 : 248|8@1+ (0.1,0) [0|25.5] "m" FVCM
 SG_ Reserved_PMOI_Debug_Signal5_00 : 256|8@1+ (0.01,-1) [-1.00|1.55] "" FVCM
 SG_ Reserved_PMOI_Debug_Signal6_00 : 264|8@1+ (0.01,-1) [-1.00|1.55] "" FVCM
 SG_ RadarCrossSection_00 : 272|7@1+ (1,-60) [-60|67] "dBm²" FVCM
 SG_ Yaw_00 : 279|9@1+ (0.02,-3.142) [-3.142|7.078] "rad" FVCM
 SG_ YawSTD_00 : 288|9@1+ (0.02,0) [0.00|10.22] "rad" FVCM
 SG_ Height_00 : 297|6@1+ (0.1,0) [0|6.3] "m" FVCM
 SG_ HeightSTD_00 : 303|6@1+ (0.1,0) [0|6.3] "m" FVCM

BO_ 514 FDR_Object_1: 64 Vector__XXX
 SG_ OD_Info_CRC_01 : 0|16@1+ (1,0) [0|65535] "" FVCM
 SG_ OD_Info_ALIVE_01 : 16|8@1+ (1,0) [0|255] "" FVCM
 SG_ IsNew_01 : 24|2@1+ (1,0) [0|3] "" FVCM
 SG_ ClassificationType_01 : 26|3@1+ (1,0) [0|7] "" FVCM
 SG_ MeasurementStatus_01 : 29|3@1+ (1,0) [0|7] "" FVCM
 SG_ LongitudinalDistance_01 : 32|13@1+ (0.05,-50) [-50.00|359.55] "m" FVCM
 SG_ MovementStatus_01 : 45|3@1+ (1,0) [0|7] "" FVCM
 SG_ ObjectID_01 : 48|8@1+ (1,0) [0|255] "" FVCM
 SG_ ReferencePoint_01 : 56|4@1+ (1,0) [0|15] "" FVCM
 SG_ AbsLongVelocity_01 : 60|12@1+ (0.05,-100) [-100.00|104.75] "m/s" FVCM
 SG_ AbsLatAccSTD_01 : 72|9@1+ (0.008,0) [0.000|4.088] "m/s²" FVCM
 SG_ Reserved_PMOI_Debug_Signal1_01 : 81|8@1+ (0.01,-1) [-1.00|1.55] "" FVCM
 SG_ ExistenceProbability_01 : 89|7@1+ (1,0) [0|127] "%" FVCM
 SG_ AbsLatVeloSTD_01 : 96|9@1+ (0.02,0) [0.00|10.22] "m/s" FVCM
 SG_ ClassificationTypeProbability_01 : 105|7@1+ (1,0) [0|127] "%" FVCM
 SG_ AbsLongAccSTD_01 : 112|9@1+ (0.008,0) [0.000|4.088] "m/s²" FVCM
 SG_ AbsLongVelocitySTD_01 : 121|9@1+ (0.02,0) [0.00|10.22] "m/s" FVCM
 SG_ AbsLatVelocity_01 : 130|12@1+ (0.05,-100) [-100.00|104.75] "m/s" FVCM
 SG_ LengthSTD_01 : 142|7@1+ (0.1,0) [0|12.7] "m" FVCM
 SG_ AbsLatAcc_01 : 149|10@1+ (0.05,-25) [-25.00|26.15] "m/s²" FVCM
 SG_ AbsLongAcc__01 : 159|10@1+ (0.05,-25) [-25.00|26.15] "m/s²" FVCM
 SG_ Width_01 : 169|6@1+ (0.1,0) [0|6.3] "m" FVCM
 SG_ WidthSTD_01 : 175|6@1+ (0.1,0) [0|6.3] "m" FVCM
 SG_ Reserved_PMOI_Debug_Signal2_01 : 181|8@1+ (0.01,-1) [-1.00|1.55] "m/s" FVCM
 SG_ ObjectAge_01 : 189|13@1+ (0.06,0) [0.00|491.46] "s" FVCM
 SG_ Reserved_PMOI_Debug_Signal3_01 : 202|8@1+ (0.01,-1) [-1.00|1.55] "" FVCM
 SG_ Reserved_PMOI_Debug_Signal4_01 : 210|8@1+ (0.01,-1) [-1.00|1.55] "" FVCM
 SG_ LateralDistance_01 : 218|12@1+ (0.05,-100) [-100.00|104.75] "m" FVCM
 SG_ LateralDistanceSTD_01 : 230|9@1+ (0.05,0) [0.00|25.55] "m" FVCM
 SG_ LongitudinalDistanceSTD_01 : 239|9@1+ (0.05,0) [0.00|25.55] "m" FVCM
 SG_ Length_01 : 248|8@1+ (0.1,0) [0|25.5] "m" FVCM
 SG_ Reserved_PMOI_Debug_Signal5_01 : 256|8@1+ (0.01,-1) [-1.00|1.55] "" FVCM
 SG_ Reserved_PMOI_Debug_Signal6_01 : 264|8@1+ (0.01,-1) [-1.00|1.55] "" FVCM
 SG_ RadarCrossSection_01 : 272|7@1+ (1,-60) [-60|67] "dBm²" FVCM
 SG_ Yaw_01 : 279|9@1+ (0.02,-3.142) [-3.142|7.078] "rad" FVCM
 SG_ YawSTD_01 : 288|9@1+ (0.02,0) [0.00|10.22] "rad" FVCM
 SG_ Height_01 : 297|6@1+ (0.1,0) [0|6.3] "m" FVCM
 SG_ HeightSTD_01 : 303|6@1+ (0.1,0) [0|6.3] "m" FVCM

BO_ 523 FDR_Object_10: 64 Vector__XXX
 SG_ OD_Info_CRC_10 : 0|16@1+ (1,0) [0|65535] "" FVCM
 SG_ OD_Info_ALIVE_10 : 16|8@1+ (1,0) [0|255] "" FVCM
 SG_ IsNew_10 : 24|2@1+ (1,0) [0|3] "" FVCM
 SG_ ClassificationType_10 : 26|3@1+ (1,0) [0|7] "" FVCM
 SG_ MeasurementStatus_10 : 29|3@1+ (1,0) [0|7] "" FVCM
 SG_ LongitudinalDistance_10 : 32|13@1+ (0.05,-50) [-50.00|359.55] "m" FVCM
 SG_ MovementStatus_10 : 45|3@1+ (1,0) [0|7] "" FVCM
 SG_ ObjectID_10 : 48|8@1+ (1,0) [0|255] "" FVCM
 SG_ ReferencePoint_10 : 56|4@1+ (1,0) [0|15] "" FVCM
 SG_ AbsLongVelocity_10 : 60|12@1+ (0.05,-100) [-100.00|104.75] "m/s" FVCM
 SG_ AbsLatAccSTD_10 : 72|9@1+ (0.008,0) [0.000|4.088] "m/s²" FVCM
 SG_ Reserved_PMOI_Debug_Signal1_10 : 81|8@1+ (0.01,-1) [-1.00|1.55] "" FVCM
 SG_ ExistenceProbability_10 : 89|7@1+ (1,0) [0|127] "%" FVCM
 SG_ AbsLatVeloSTD_10 : 96|9@1+ (0.02,0) [0.00|10.22] "m/s" FVCM
 SG_ ClassificationTypeProbability_10 : 105|7@1+ (1,0) [0|127] "%" FVCM
 SG_ AbsLongAccSTD_10 : 112|9@1+ (0.008,0) [0.000|4.088] "m/s²" FVCM
 SG_ AbsLongVelocitySTD_10 : 121|9@1+ (0.02,0) [0.00|10.22] "m/s" FVCM
 SG_ AbsLatVelocity_10 : 130|12@1+ (0.05,-100) [-100.00|104.75] "m/s" FVCM
 SG_ LengthSTD_10 : 142|7@1+ (0.1,0) [0|12.7] "m" FVCM
 SG_ AbsLatAcc_10 : 149|10@1+ (0.05,-25) [-25.00|26.15] "m/s²" FVCM
 SG_ AbsLongAcc__10 : 159|10@1+ (0.05,-25) [-25.00|26.15] "m/s²" FVCM
 SG_ Width_10 : 169|6@1+ (0.1,0) [0|6.3] "m" FVCM
 SG_ WidthSTD_10 : 175|6@1+ (0.1,0) [0|6.3] "m" FVCM
 SG_ Reserved_PMOI_Debug_Signal2_10 : 181|8@1+ (0.01,-1) [-1.00|1.55] "m/s" FVCM
 SG_ ObjectAge_10 : 189|13@1+ (0.06,0) [0.00|491.46] "s" FVCM
 SG_ Reserved_PMOI_Debug_Signal3_10 : 202|8@1+ (0.01,-1) [-1.00|1.55] "" FVCM
 SG_ Reserved_PMOI_Debug_Signal4_10 : 210|8@1+ (0.01,-1) [-1.00|1.55] "" FVCM
 SG_ LateralDistance_10 : 218|12@1+ (0.05,-100) [-100.00|104.75] "m" FVCM
 SG_ LateralDistanceSTD_10 : 230|9@1+ (0.05,0) [0.00|25.55] "m" FVCM
 SG_ LongitudinalDistanceSTD_10 : 239|9@1+ (0.05,0) [0.00|25.55] "m" FVCM
 SG_ Length_10 : 248|8@1+ (0.1,0) [0|25.5] "m" FVCM
 SG_ Reserved_PMOI_Debug_Signal5_10 : 256|8@1+ (0.01,-1) [-1.00|1.55] "" FVCM
 SG_ Reserved_PMOI_Debug_Signal6_10 : 264|8@1+ (0.01,-1) [-1.00|1.55] "" FVCM
 SG_ RadarCrossSection_10 : 272|7@1+ (1,-60) [-60|67] "dBm²" FVCM
 SG_ Yaw_10 : 279|9@1+ (0.02,-3.142) [-3.142|7.078] "rad" FVCM
 SG_ YawSTD_10 : 288|9@1+ (0.02,0) [0.00|10.22] "rad" FVCM
 SG_ Height_10 : 297|6@1+ (0.1,0) [0|6.3] "m" FVCM
 SG_ HeightSTD_10 : 303|6@1+ (0.1,0) [0|6.3] "m" FVCM

BO_ 524 FDR_Object_11: 64 Vector__XXX
 SG_ OD_Info_CRC_11 : 0|16@1+ (1,0) [0|65535] "" FVCM
 SG_ OD_Info_ALIVE_11 : 16|8@1+ (1,0) [0|255] "" FVCM
 SG_ IsNew_11 : 24|2@1+ (1,0) [0|3] "" FVCM
 SG_ ClassificationType_11 : 26|3@1+ (1,0) [0|7] "" FVCM
 SG_ MeasurementStatus_11 : 29|3@1+ (1,0) [0|7] "" FVCM
 SG_ LongitudinalDistance_11 : 32|13@1+ (0.05,-50) [-50.00|359.55] "m" FVCM
 SG_ MovementStatus_11 : 45|3@1+ (1,0) [0|7] "" FVCM
 SG_ ObjectID_11 : 48|8@1+ (1,0) [0|255] "" FVCM
 SG_ ReferencePoint_11 : 56|4@1+ (1,0) [0|15] "" FVCM
 SG_ AbsLongVelocity_11 : 60|12@1+ (0.05,-100) [-100.00|104.75] "m/s" FVCM
 SG_ AbsLatAccSTD_11 : 72|9@1+ (0.008,0) [0.000|4.088] "m/s²" FVCM
 SG_ Reserved_PMOI_Debug_Signal1_11 : 81|8@1+ (0.01,-1) [-1.00|1.55] "" FVCM
 SG_ ExistenceProbability_11 : 89|7@1+ (1,0) [0|127] "%" FVCM
 SG_ AbsLatVeloSTD_11 : 96|9@1+ (0.02,0) [0.00|10.22] "m/s" FVCM
 SG_ ClassificationTypeProbability_11 : 105|7@1+ (1,0) [0|127] "%" FVCM
 SG_ AbsLongAccSTD_11 : 112|9@1+ (0.008,0) [0.000|4.088] "m/s²" FVCM
 SG_ AbsLongVelocitySTD_11 : 121|9@1+ (0.02,0) [0.00|10.22] "m/s" FVCM
 SG_ AbsLatVelocity_11 : 130|12@1+ (0.05,-100) [-100.00|104.75] "m/s" FVCM
 SG_ LengthSTD_11 : 142|7@1+ (0.1,0) [0|12.7] "m" FVCM
 SG_ AbsLatAcc_11 : 149|10@1+ (0.05,-25) [-25.00|26.15] "m/s²" FVCM
 SG_ AbsLongAcc__11 : 159|10@1+ (0.05,-25) [-25.00|26.15] "m/s²" FVCM
 SG_ Width_11 : 169|6@1+ (0.1,0) [0|6.3] "m" FVCM
 SG_ WidthSTD_11 : 175|6@1+ (0.1,0) [0|6.3] "m" FVCM
 SG_ Reserved_PMOI_Debug_Signal2_11 : 181|8@1+ (0.01,-1) [-1.00|1.55] "m/s" FVCM
 SG_ ObjectAge_11 : 189|13@1+ (0.06,0) [0.00|491.46] "s" FVCM
 SG_ Reserved_PMOI_Debug_Signal3_11 : 202|8@1+ (0.01,-1) [-1.00|1.55] "" FVCM
 SG_ Reserved_PMOI_Debug_Signal4_11 : 210|8@1+ (0.01,-1) [-1.00|1.55] "" FVCM
 SG_ LateralDistance_11 : 218|12@1+ (0.05,-100) [-100.00|104.75] "m" FVCM
 SG_ LateralDistanceSTD_11 : 230|9@1+ (0.05,0) [0.00|25.55] "m" FVCM
 SG_ LongitudinalDistanceSTD_11 : 239|9@1+ (0.05,0) [0.00|25.55] "m" FVCM
 SG_ Length_11 : 248|8@1+ (0.1,0) [0|25.5] "m" FVCM
 SG_ Reserved_PMOI_Debug_Signal5_11 : 256|8@1+ (0.01,-1) [-1.00|1.55] "" FVCM
 SG_ Reserved_PMOI_Debug_Signal6_11 : 264|8@1+ (0.01,-1) [-1.00|1.55] "" FVCM
 SG_ RadarCrossSection_11 : 272|7@1+ (1,-60) [-60|67] "dBm²" FVCM
 SG_ Yaw_11 : 279|9@1+ (0.02,-3.142) [-3.142|7.078] "rad" FVCM
 SG_ YawSTD_11 : 288|9@1+ (0.02,0) [0.00|10.22] "rad" FVCM
 SG_ Height_11 : 297|6@1+ (0.1,0) [0|6.3] "m" FVCM
 SG_ HeightSTD_11 : 303|6@1+ (0.1,0) [0|6.3] "m" FVCM

BO_ 525 FDR_Object_12: 64 Vector__XXX
 SG_ OD_Info_CRC_12 : 0|16@1+ (1,0) [0|65535] "" FVCM
 SG_ OD_Info_ALIVE_12 : 16|8@1+ (1,0) [0|255] "" FVCM
 SG_ IsNew_12 : 24|2@1+ (1,0) [0|3] "" FVCM
 SG_ ClassificationType_12 : 26|3@1+ (1,0) [0|7] "" FVCM
 SG_ MeasurementStatus_12 : 29|3@1+ (1,0) [0|7] "" FVCM
 SG_ LongitudinalDistance_12 : 32|13@1+ (0.05,-50) [-50.00|359.55] "m" FVCM
 SG_ MovementStatus_12 : 45|3@1+ (1,0) [0|7] "" FVCM
 SG_ ObjectID_12 : 48|8@1+ (1,0) [0|255] "" FVCM
 SG_ ReferencePoint_12 : 56|4@1+ (1,0) [0|15] "" FVCM
 SG_ AbsLongVelocity_12 : 60|12@1+ (0.05,-100) [-100.00|104.75] "m/s" FVCM
 SG_ AbsLatAccSTD_12 : 72|9@1+ (0.008,0) [0.000|4.088] "m/s²" FVCM
 SG_ Reserved_PMOI_Debug_Signal1_12 : 81|8@1+ (0.01,-1) [-1.00|1.55] "" FVCM
 SG_ ExistenceProbability_12 : 89|7@1+ (1,0) [0|127] "%" FVCM
 SG_ AbsLatVeloSTD_12 : 96|9@1+ (0.02,0) [0.00|10.22] "m/s" FVCM
 SG_ ClassificationTypeProbability_12 : 105|7@1+ (1,0) [0|127] "%" FVCM
 SG_ AbsLongAccSTD_12 : 112|9@1+ (0.008,0) [0.000|4.088] "m/s²" FVCM
 SG_ AbsLongVelocitySTD_12 : 121|9@1+ (0.02,0) [0.00|10.22] "m/s" FVCM
 SG_ AbsLatVelocity_12 : 130|12@1+ (0.05,-100) [-100.00|104.75] "m/s" FVCM
 SG_ LengthSTD_12 : 142|7@1+ (0.1,0) [0|12.7] "m" FVCM
 SG_ AbsLatAcc_12 : 149|10@1+ (0.05,-25) [-25.00|26.15] "m/s²" FVCM
 SG_ AbsLongAcc__12 : 159|10@1+ (0.05,-25) [-25.00|26.15] "m/s²" FVCM
 SG_ Width_12 : 169|6@1+ (0.1,0) [0|6.3] "m" FVCM
 SG_ WidthSTD_12 : 175|6@1+ (0.1,0) [0|6.3] "m" FVCM
 SG_ Reserved_PMOI_Debug_Signal2_12 : 181|8@1+ (0.01,-1) [-1.00|1.55] "m/s" FVCM
 SG_ ObjectAge_12 : 189|13@1+ (0.06,0) [0.00|491.46] "s" FVCM
 SG_ Reserved_PMOI_Debug_Signal3_12 : 202|8@1+ (0.01,-1) [-1.00|1.55] "" FVCM
 SG_ Reserved_PMOI_Debug_Signal4_12 : 210|8@1+ (0.01,-1) [-1.00|1.55] "" FVCM
 SG_ LateralDistance_12 : 218|12@1+ (0.05,-100) [-100.00|104.75] "m" FVCM
 SG_ LateralDistanceSTD_12 : 230|9@1+ (0.05,0) [0.00|25.55] "m" FVCM
 SG_ LongitudinalDistanceSTD_12 : 239|9@1+ (0.05,0) [0.00|25.55] "m" FVCM
 SG_ Length_12 : 248|8@1+ (0.1,0) [0|25.5] "m" FVCM
 SG_ Reserved_PMOI_Debug_Signal5_12 : 256|8@1+ (0.01,-1) [-1.00|1.55] "" FVCM
 SG_ Reserved_PMOI_Debug_Signal6_12 : 264|8@1+ (0.01,-1) [-1.00|1.55] "" FVCM
 SG_ RadarCrossSection_12 : 272|7@1+ (1,-60) [-60|67] "dBm²" FVCM
 SG_ Yaw_12 : 279|9@1+ (0.02,-3.142) [-3.142|7.078] "rad" FVCM
 SG_ YawSTD_12 : 288|9@1+ (0.02,0) [0.00|10.22] "rad" FVCM
 SG_ Height_12 : 297|6@1+ (0.1,0) [0|6.3] "m" FVCM
 SG_ HeightSTD_12 : 303|6@1+ (0.1,0) [0|6.3] "m" FVCM

BO_ 526 FDR_Object_13: 64 Vector__XXX
 SG_ OD_Info_CRC_13 : 0|16@1+ (1,0) [0|65535] "" FVCM
 SG_ OD_Info_ALIVE_13 : 16|8@1+ (1,0) [0|255] "" FVCM
 SG_ IsNew_13 : 24|2@1+ (1,0) [0|3] "" FVCM
 SG_ ClassificationType_13 : 26|3@1+ (1,0) [0|7] "" FVCM
 SG_ MeasurementStatus_13 : 29|3@1+ (1,0) [0|7] "" FVCM
 SG_ LongitudinalDistance_13 : 32|13@1+ (0.05,-50) [-50.00|359.55] "m" FVCM
 SG_ MovementStatus_13 : 45|3@1+ (1,0) [0|7] "" FVCM
 SG_ ObjectID_13 : 48|8@1+ (1,0) [0|255] "" FVCM
 SG_ ReferencePoint_13 : 56|4@1+ (1,0) [0|15] "" FVCM
 SG_ AbsLongVelocity_13 : 60|12@1+ (0.05,-100) [-100.00|104.75] "m/s" FVCM
 SG_ AbsLatAccSTD_13 : 72|9@1+ (0.008,0) [0.000|4.088] "m/s²" FVCM
 SG_ Reserved_PMOI_Debug_Signal1_13 : 81|8@1+ (0.01,-1) [-1.00|1.55] "" FVCM
 SG_ ExistenceProbability_13 : 89|7@1+ (1,0) [0|127] "%" FVCM
 SG_ AbsLatVeloSTD_13 : 96|9@1+ (0.02,0) [0.00|10.22] "m/s" FVCM
 SG_ ClassificationTypeProbability_13 : 105|7@1+ (1,0) [0|127] "%" FVCM
 SG_ AbsLongAccSTD_13 : 112|9@1+ (0.008,0) [0.000|4.088] "m/s²" FVCM
 SG_ AbsLongVelocitySTD_13 : 121|9@1+ (0.02,0) [0.00|10.22] "m/s" FVCM
 SG_ AbsLatVelocity_13 : 130|12@1+ (0.05,-100) [-100.00|104.75] "m/s" FVCM
 SG_ LengthSTD_13 : 142|7@1+ (0.1,0) [0|12.7] "m" FVCM
 SG_ AbsLatAcc_13 : 149|10@1+ (0.05,-25) [-25.00|26.15] "m/s²" FVCM
 SG_ AbsLongAcc__13 : 159|10@1+ (0.05,-25) [-25.00|26.15] "m/s²" FVCM
 SG_ Width_13 : 169|6@1+ (0.1,0) [0|6.3] "m" FVCM
 SG_ WidthSTD_13 : 175|6@1+ (0.1,0) [0|6.3] "m" FVCM
 SG_ Reserved_PMOI_Debug_Signal2_13 : 181|8@1+ (0.01,-1) [-1.00|1.55] "m/s" FVCM
 SG_ ObjectAge_13 : 189|13@1+ (0.06,0) [0.00|491.46] "s" FVCM
 SG_ Reserved_PMOI_Debug_Signal3_13 : 202|8@1+ (0.01,-1) [-1.00|1.55] "" FVCM
 SG_ Reserved_PMOI_Debug_Signal4_13 : 210|8@1+ (0.01,-1) [-1.00|1.55] "" FVCM
 SG_ LateralDistance_13 : 218|12@1+ (0.05,-100) [-100.00|104.75] "m" FVCM
 SG_ LateralDistanceSTD_13 : 230|9@1+ (0.05,0) [0.00|25.55] "m" FVCM
 SG_ LongitudinalDistanceSTD_13 : 239|9@1+ (0.05,0) [0.00|25.55] "m" FVCM
 SG_ Length_13 : 248|8@1+ (0.1,0) [0|25.5] "m" FVCM
 SG_ Reserved_PMOI_Debug_Signal5_13 : 256|8@1+ (0.01,-1) [-1.00|1.55] "" FVCM
 SG_ Reserved_PMOI_Debug_Signal6_13 : 264|8@1+ (0.01,-1) [-1.00|1.55] "" FVCM
 SG_ RadarCrossSection_13 : 272|7@1+ (1,-60) [-60|67] "dBm²" FVCM
 SG_ Yaw_13 : 279|9@1+ (0.02,-3.142) [-3.142|7.078] "rad" FVCM
 SG_ YawSTD_13 : 288|9@1+ (0.02,0) [0.00|10.22] "rad" FVCM
 SG_ Height_13 : 297|6@1+ (0.1,0) [0|6.3] "m" FVCM
 SG_ HeightSTD_13 : 303|6@1+ (0.1,0) [0|6.3] "m" FVCM

BO_ 527 FDR_Object_14: 64 Vector__XXX
 SG_ OD_Info_CRC_14 : 0|16@1+ (1,0) [0|65535] "" FVCM
 SG_ OD_Info_ALIVE_14 : 16|8@1+ (1,0) [0|255] "" FVCM
 SG_ IsNew_14 : 24|2@1+ (1,0) [0|3] "" FVCM
 SG_ ClassificationType_14 : 26|3@1+ (1,0) [0|7] "" FVCM
 SG_ MeasurementStatus_14 : 29|3@1+ (1,0) [0|7] "" FVCM
 SG_ LongitudinalDistance_14 : 32|13@1+ (0.05,-50) [-50.00|359.55] "m" FVCM
 SG_ MovementStatus_14 : 45|3@1+ (1,0) [0|7] "" FVCM
 SG_ ObjectID_14 : 48|8@1+ (1,0) [0|255] "" FVCM
 SG_ ReferencePoint_14 : 56|4@1+ (1,0) [0|15] "" FVCM
 SG_ AbsLongVelocity_14 : 60|12@1+ (0.05,-100) [-100.00|104.75] "m/s" FVCM
 SG_ AbsLatAccSTD_14 : 72|9@1+ (0.008,0) [0.000|4.088] "m/s²" FVCM
 SG_ Reserved_PMOI_Debug_Signal1_14 : 81|8@1+ (0.01,-1) [-1.00|1.55] "" FVCM
 SG_ ExistenceProbability_14 : 89|7@1+ (1,0) [0|127] "%" FVCM
 SG_ AbsLatVeloSTD_14 : 96|9@1+ (0.02,0) [0.00|10.22] "m/s" FVCM
 SG_ ClassificationTypeProbability_14 : 105|7@1+ (1,0) [0|127] "%" FVCM
 SG_ AbsLongAccSTD_14 : 112|9@1+ (0.008,0) [0.000|4.088] "m/s²" FVCM
 SG_ AbsLongVelocitySTD_14 : 121|9@1+ (0.02,0) [0.00|10.22] "m/s" FVCM
 SG_ AbsLatVelocity_14 : 130|12@1+ (0.05,-100) [-100.00|104.75] "m/s" FVCM
 SG_ LengthSTD_14 : 142|7@1+ (0.1,0) [0|12.7] "m" FVCM
 SG_ AbsLatAcc_14 : 149|10@1+ (0.05,-25) [-25.00|26.15] "m/s²" FVCM
 SG_ AbsLongAcc__14 : 159|10@1+ (0.05,-25) [-25.00|26.15] "m/s²" FVCM
 SG_ Width_14 : 169|6@1+ (0.1,0) [0|6.3] "m" FVCM
 SG_ WidthSTD_14 : 175|6@1+ (0.1,0) [0|6.3] "m" FVCM
 SG_ Reserved_PMOI_Debug_Signal2_14 : 181|8@1+ (0.01,-1) [-1.00|1.55] "m/s" FVCM
 SG_ ObjectAge_14 : 189|13@1+ (0.06,0) [0.00|491.46] "s" FVCM
 SG_ Reserved_PMOI_Debug_Signal3_14 : 202|8@1+ (0.01,-1) [-1.00|1.55] "" FVCM
 SG_ Reserved_PMOI_Debug_Signal4_14 : 210|8@1+ (0.01,-1) [-1.00|1.55] "" FVCM
 SG_ LateralDistance_14 : 218|12@1+ (0.05,-100) [-100.00|104.75] "m" FVCM
 SG_ LateralDistanceSTD_14 : 230|9@1+ (0.05,0) [0.00|25.55] "m" FVCM
 SG_ LongitudinalDistanceSTD_14 : 239|9@1+ (0.05,0) [0.00|25.55] "m" FVCM
 SG_ Length_14 : 248|8@1+ (0.1,0) [0|25.5] "m" FVCM
 SG_ Reserved_PMOI_Debug_Signal5_14 : 256|8@1+ (0.01,-1) [-1.00|1.55] "" FVCM
 SG_ Reserved_PMOI_Debug_Signal6_14 : 264|8@1+ (0.01,-1) [-1.00|1.55] "" FVCM
 SG_ RadarCrossSection_14 : 272|7@1+ (1,-60) [-60|67] "dBm²" FVCM
 SG_ Yaw_14 : 279|9@1+ (0.02,-3.142) [-3.142|7.078] "rad" FVCM
 SG_ YawSTD_14 : 288|9@1+ (0.02,0) [0.00|10.22] "rad" FVCM
 SG_ Height_14 : 297|6@1+ (0.1,0) [0|6.3] "m" FVCM
 SG_ HeightSTD_14 : 303|6@1+ (0.1,0) [0|6.3] "m" FVCM

BO_ 528 FDR_Object_15: 64 Vector__XXX
 SG_ OD_Info_CRC_15 : 0|16@1+ (1,0) [0|65535] "" FVCM
 SG_ OD_Info_ALIVE_15 : 16|8@1+ (1,0) [0|255] "" FVCM
 SG_ IsNew_15 : 24|2@1+ (1,0) [0|3] "" FVCM
 SG_ ClassificationType_15 : 26|3@1+ (1,0) [0|7] "" FVCM
 SG_ MeasurementStatus_15 : 29|3@1+ (1,0) [0|7] "" FVCM
 SG_ LongitudinalDistance_15 : 32|13@1+ (0.05,-50) [-50.00|359.55] "m" FVCM
 SG_ MovementStatus_15 : 45|3@1+ (1,0) [0|7] "" FVCM
 SG_ ObjectID_15 : 48|8@1+ (1,0) [0|255] "" FVCM
 SG_ ReferencePoint_15 : 56|4@1+ (1,0) [0|15] "" FVCM
 SG_ AbsLongVelocity_15 : 60|12@1+ (0.05,-100) [-100.00|104.75] "m/s" FVCM
 SG_ AbsLatAccSTD_15 : 72|9@1+ (0.008,0) [0.000|4.088] "m/s²" FVCM
 SG_ Reserved_PMOI_Debug_Signal1_15 : 81|8@1+ (0.01,-1) [-1.00|1.55] "" FVCM
 SG_ ExistenceProbability_15 : 89|7@1+ (1,0) [0|127] "%" FVCM
 SG_ AbsLatVeloSTD_15 : 96|9@1+ (0.02,0) [0.00|10.22] "m/s" FVCM
 SG_ ClassificationTypeProbability_15 : 105|7@1+ (1,0) [0|127] "%" FVCM
 SG_ AbsLongAccSTD_15 : 112|9@1+ (0.008,0) [0.000|4.088] "m/s²" FVCM
 SG_ AbsLongVelocitySTD_15 : 121|9@1+ (0.02,0) [0.00|10.22] "m/s" FVCM
 SG_ AbsLatVelocity_15 : 130|12@1+ (0.05,-100) [-100.00|104.75] "m/s" FVCM
 SG_ LengthSTD_15 : 142|7@1+ (0.1,0) [0|12.7] "m" FVCM
 SG_ AbsLatAcc_15 : 149|10@1+ (0.05,-25) [-25.00|26.15] "m/s²" FVCM
 SG_ AbsLongAcc__15 : 159|10@1+ (0.05,-25) [-25.00|26.15] "m/s²" FVCM
 SG_ Width_15 : 169|6@1+ (0.1,0) [0|6.3] "m" FVCM
 SG_ WidthSTD_15 : 175|6@1+ (0.1,0) [0|6.3] "m" FVCM
 SG_ Reserved_PMOI_Debug_Signal2_15 : 181|8@1+ (0.01,-1) [-1.00|1.55] "m/s" FVCM
 SG_ ObjectAge_15 : 189|13@1+ (0.06,0) [0.00|491.46] "s" FVCM
 SG_ Reserved_PMOI_Debug_Signal3_15 : 202|8@1+ (0.01,-1) [-1.00|1.55] "" FVCM
 SG_ Reserved_PMOI_Debug_Signal4_15 : 210|8@1+ (0.01,-1) [-1.00|1.55] "" FVCM
 SG_ LateralDistance_15 : 218|12@1+ (0.05,-100) [-100.00|104.75] "m" FVCM
 SG_ LateralDistanceSTD_15 : 230|9@1+ (0.05,0) [0.00|25.55] "m" FVCM
 SG_ LongitudinalDistanceSTD_15 : 239|9@1+ (0.05,0) [0.00|25.55] "m" FVCM
 SG_ Length_15 : 248|8@1+ (0.1,0) [0|25.5] "m" FVCM
 SG_ Reserved_PMOI_Debug_Signal5_15 : 256|8@1+ (0.01,-1) [-1.00|1.55] "" FVCM
 SG_ Reserved_PMOI_Debug_Signal6_15 : 264|8@1+ (0.01,-1) [-1.00|1.55] "" FVCM
 SG_ RadarCrossSection_15 : 272|7@1+ (1,-60) [-60|67] "dBm²" FVCM
 SG_ Yaw_15 : 279|9@1+ (0.02,-3.142) [-3.142|7.078] "rad" FVCM
 SG_ YawSTD_15 : 288|9@1+ (0.02,0) [0.00|10.22] "rad" FVCM
 SG_ Height_15 : 297|6@1+ (0.1,0) [0|6.3] "m" FVCM
 SG_ HeightSTD_15 : 303|6@1+ (0.1,0) [0|6.3] "m" FVCM

BO_ 529 FDR_Object_16: 64 Vector__XXX
 SG_ OD_Info_CRC_16 : 0|16@1+ (1,0) [0|65535] "" FVCM
 SG_ OD_Info_ALIVE_16 : 16|8@1+ (1,0) [0|255] "" FVCM
 SG_ IsNew_16 : 24|2@1+ (1,0) [0|3] "" FVCM
 SG_ ClassificationType_16 : 26|3@1+ (1,0) [0|7] "" FVCM
 SG_ MeasurementStatus_16 : 29|3@1+ (1,0) [0|7] "" FVCM
 SG_ LongitudinalDistance_16 : 32|13@1+ (0.05,-50) [-50.00|359.55] "m" FVCM
 SG_ MovementStatus_16 : 45|3@1+ (1,0) [0|7] "" FVCM
 SG_ ObjectID_16 : 48|8@1+ (1,0) [0|255] "" FVCM
 SG_ ReferencePoint_16 : 56|4@1+ (1,0) [0|15] "" FVCM
 SG_ AbsLongVelocity_16 : 60|12@1+ (0.05,-100) [-100.00|104.75] "m/s" FVCM
 SG_ AbsLatAccSTD_16 : 72|9@1+ (0.008,0) [0.000|4.088] "m/s²" FVCM
 SG_ Reserved_PMOI_Debug_Signal1_16 : 81|8@1+ (0.01,-1) [-1.00|1.55] "" FVCM
 SG_ ExistenceProbability_16 : 89|7@1+ (1,0) [0|127] "%" FVCM
 SG_ AbsLatVeloSTD_16 : 96|9@1+ (0.02,0) [0.00|10.22] "m/s" FVCM
 SG_ ClassificationTypeProbability_16 : 105|7@1+ (1,0) [0|127] "%" FVCM
 SG_ AbsLongAccSTD_16 : 112|9@1+ (0.008,0) [0.000|4.088] "m/s²" FVCM
 SG_ AbsLongVelocitySTD_16 : 121|9@1+ (0.02,0) [0.00|10.22] "m/s" FVCM
 SG_ AbsLatVelocity_16 : 130|12@1+ (0.05,-100) [-100.00|104.75] "m/s" FVCM
 SG_ LengthSTD_16 : 142|7@1+ (0.1,0) [0|12.7] "m" FVCM
 SG_ AbsLatAcc_16 : 149|10@1+ (0.05,-25) [-25.00|26.15] "m/s²" FVCM
 SG_ AbsLongAcc__16 : 159|10@1+ (0.05,-25) [-25.00|26.15] "m/s²" FVCM
 SG_ Width_16 : 169|6@1+ (0.1,0) [0|6.3] "m" FVCM
 SG_ WidthSTD_16 : 175|6@1+ (0.1,0) [0|6.3] "m" FVCM
 SG_ Reserved_PMOI_Debug_Signal2_16 : 181|8@1+ (0.01,-1) [-1.00|1.55] "m/s" FVCM
 SG_ ObjectAge_16 : 189|13@1+ (0.06,0) [0.00|491.46] "s" FVCM
 SG_ Reserved_PMOI_Debug_Signal3_16 : 202|8@1+ (0.01,-1) [-1.00|1.55] "" FVCM
 SG_ Reserved_PMOI_Debug_Signal4_16 : 210|8@1+ (0.01,-1) [-1.00|1.55] "" FVCM
 SG_ LateralDistance_16 : 218|12@1+ (0.05,-100) [-100.00|104.75] "m" FVCM
 SG_ LateralDistanceSTD_16 : 230|9@1+ (0.05,0) [0.00|25.55] "m" FVCM
 SG_ LongitudinalDistanceSTD_16 : 239|9@1+ (0.05,0) [0.00|25.55] "m" FVCM
 SG_ Length_16 : 248|8@1+ (0.1,0) [0|25.5] "m" FVCM
 SG_ Reserved_PMOI_Debug_Signal5_16 : 256|8@1+ (0.01,-1) [-1.00|1.55] "" FVCM
 SG_ Reserved_PMOI_Debug_Signal6_16 : 264|8@1+ (0.01,-1) [-1.00|1.55] "" FVCM
 SG_ RadarCrossSection_16 : 272|7@1+ (1,-60) [-60|67] "dBm²" FVCM
 SG_ Yaw_16 : 279|9@1+ (0.02,-3.142) [-3.142|7.078] "rad" FVCM
 SG_ YawSTD_16 : 288|9@1+ (0.02,0) [0.00|10.22] "rad" FVCM
 SG_ Height_16 : 297|6@1+ (0.1,0) [0|6.3] "m" FVCM
 SG_ HeightSTD_16 : 303|6@1+ (0.1,0) [0|6.3] "m" FVCM

BO_ 530 FDR_Object_17: 64 Vector__XXX
 SG_ OD_Info_CRC_17 : 0|16@1+ (1,0) [0|65535] "" FVCM
 SG_ OD_Info_ALIVE_17 : 16|8@1+ (1,0) [0|255] "" FVCM
 SG_ IsNew_17 : 24|2@1+ (1,0) [0|3] "" FVCM
 SG_ ClassificationType_17 : 26|3@1+ (1,0) [0|7] "" FVCM
 SG_ MeasurementStatus_17 : 29|3@1+ (1,0) [0|7] "" FVCM
 SG_ LongitudinalDistance_17 : 32|13@1+ (0.05,-50) [-50.00|359.55] "m" FVCM
 SG_ MovementStatus_17 : 45|3@1+ (1,0) [0|7] "" FVCM
 SG_ ObjectID_17 : 48|8@1+ (1,0) [0|255] "" FVCM
 SG_ ReferencePoint_17 : 56|4@1+ (1,0) [0|15] "" FVCM
 SG_ AbsLongVelocity_17 : 60|12@1+ (0.05,-100) [-100.00|104.75] "m/s" FVCM
 SG_ AbsLatAccSTD_17 : 72|9@1+ (0.008,0) [0.000|4.088] "m/s²" FVCM
 SG_ Reserved_PMOI_Debug_Signal1_17 : 81|8@1+ (0.01,-1) [-1.00|1.55] "" FVCM
 SG_ ExistenceProbability_17 : 89|7@1+ (1,0) [0|127] "%" FVCM
 SG_ AbsLatVeloSTD_17 : 96|9@1+ (0.02,0) [0.00|10.22] "m/s" FVCM
 SG_ ClassificationTypeProbability_17 : 105|7@1+ (1,0) [0|127] "%" FVCM
 SG_ AbsLongAccSTD_17 : 112|9@1+ (0.008,0) [0.000|4.088] "m/s²" FVCM
 SG_ AbsLongVelocitySTD_17 : 121|9@1+ (0.02,0) [0.00|10.22] "m/s" FVCM
 SG_ AbsLatVelocity_17 : 130|12@1+ (0.05,-100) [-100.00|104.75] "m/s" FVCM
 SG_ LengthSTD_17 : 142|7@1+ (0.1,0) [0|12.7] "m" FVCM
 SG_ AbsLatAcc_17 : 149|10@1+ (0.05,-25) [-25.00|26.15] "m/s²" FVCM
 SG_ AbsLongAcc__17 : 159|10@1+ (0.05,-25) [-25.00|26.15] "m/s²" FVCM
 SG_ Width_17 : 169|6@1+ (0.1,0) [0|6.3] "m" FVCM
 SG_ WidthSTD_17 : 175|6@1+ (0.1,0) [0|6.3] "m" FVCM
 SG_ Reserved_PMOI_Debug_Signal2_17 : 181|8@1+ (0.01,-1) [-1.00|1.55] "m/s" FVCM
 SG_ ObjectAge_17 : 189|13@1+ (0.06,0) [0.00|491.46] "s" FVCM
 SG_ Reserved_PMOI_Debug_Signal3_17 : 202|8@1+ (0.01,-1) [-1.00|1.55] "" FVCM
 SG_ Reserved_PMOI_Debug_Signal4_17 : 210|8@1+ (0.01,-1) [-1.00|1.55] "" FVCM
 SG_ LateralDistance_17 : 218|12@1+ (0.05,-100) [-100.00|104.75] "m" FVCM
 SG_ LateralDistanceSTD_17 : 230|9@1+ (0.05,0) [0.00|25.55] "m" FVCM
 SG_ LongitudinalDistanceSTD_17 : 239|9@1+ (0.05,0) [0.00|25.55] "m" FVCM
 SG_ Length_17 : 248|8@1+ (0.1,0) [0|25.5] "m" FVCM
 SG_ Reserved_PMOI_Debug_Signal5_17 : 256|8@1+ (0.01,-1) [-1.00|1.55] "" FVCM
 SG_ Reserved_PMOI_Debug_Signal6_17 : 264|8@1+ (0.01,-1) [-1.00|1.55] "" FVCM
 SG_ RadarCrossSection_17 : 272|7@1+ (1,-60) [-60|67] "dBm²" FVCM
 SG_ Yaw_17 : 279|9@1+ (0.02,-3.142) [-3.142|7.078] "rad" FVCM
 SG_ YawSTD_17 : 288|9@1+ (0.02,0) [0.00|10.22] "rad" FVCM
 SG_ Height_17 : 297|6@1+ (0.1,0) [0|6.3] "m" FVCM
 SG_ HeightSTD_17 : 303|6@1+ (0.1,0) [0|6.3] "m" FVCM

BO_ 531 FDR_Object_18: 64 Vector__XXX
 SG_ OD_Info_CRC_18 : 0|16@1+ (1,0) [0|65535] "" FVCM
 SG_ OD_Info_ALIVE_18 : 16|8@1+ (1,0) [0|255] "" FVCM
 SG_ IsNew_18 : 24|2@1+ (1,0) [0|3] "" FVCM
 SG_ ClassificationType_18 : 26|3@1+ (1,0) [0|7] "" FVCM
 SG_ MeasurementStatus_18 : 29|3@1+ (1,0) [0|7] "" FVCM
 SG_ LongitudinalDistance_18 : 32|13@1+ (0.05,-50) [-50.00|359.55] "m" FVCM
 SG_ MovementStatus_18 : 45|3@1+ (1,0) [0|7] "" FVCM
 SG_ ObjectID_18 : 48|8@1+ (1,0) [0|255] "" FVCM
 SG_ ReferencePoint_18 : 56|4@1+ (1,0) [0|15] "" FVCM
 SG_ AbsLongVelocity_18 : 60|12@1+ (0.05,-100) [-100.00|104.75] "m/s" FVCM
 SG_ AbsLatAccSTD_18 : 72|9@1+ (0.008,0) [0.000|4.088] "m/s²" FVCM
 SG_ Reserved_PMOI_Debug_Signal1_18 : 81|8@1+ (0.01,-1) [-1.00|1.55] "" FVCM
 SG_ ExistenceProbability_18 : 89|7@1+ (1,0) [0|127] "%" FVCM
 SG_ AbsLatVeloSTD_18 : 96|9@1+ (0.02,0) [0.00|10.22] "m/s" FVCM
 SG_ ClassificationTypeProbability_18 : 105|7@1+ (1,0) [0|127] "%" FVCM
 SG_ AbsLongAccSTD_18 : 112|9@1+ (0.008,0) [0.000|4.088] "m/s²" FVCM
 SG_ AbsLongVelocitySTD_18 : 121|9@1+ (0.02,0) [0.00|10.22] "m/s" FVCM
 SG_ AbsLatVelocity_18 : 130|12@1+ (0.05,-100) [-100.00|104.75] "m/s" FVCM
 SG_ LengthSTD_18 : 142|7@1+ (0.1,0) [0|12.7] "m" FVCM
 SG_ AbsLatAcc_18 : 149|10@1+ (0.05,-25) [-25.00|26.15] "m/s²" FVCM
 SG_ AbsLongAcc__18 : 159|10@1+ (0.05,-25) [-25.00|26.15] "m/s²" FVCM
 SG_ Width_18 : 169|6@1+ (0.1,0) [0|6.3] "m" FVCM
 SG_ WidthSTD_18 : 175|6@1+ (0.1,0) [0|6.3] "m" FVCM
 SG_ Reserved_PMOI_Debug_Signal2_18 : 181|8@1+ (0.01,-1) [-1.00|1.55] "m/s" FVCM
 SG_ ObjectAge_18 : 189|13@1+ (0.06,0) [0.00|491.46] "s" FVCM
 SG_ Reserved_PMOI_Debug_Signal3_18 : 202|8@1+ (0.01,-1) [-1.00|1.55] "" FVCM
 SG_ Reserved_PMOI_Debug_Signal4_18 : 210|8@1+ (0.01,-1) [-1.00|1.55] "" FVCM
 SG_ LateralDistance_18 : 218|12@1+ (0.05,-100) [-100.00|104.75] "m" FVCM
 SG_ LateralDistanceSTD_18 : 230|9@1+ (0.05,0) [0.00|25.55] "m" FVCM
 SG_ LongitudinalDistanceSTD_18 : 239|9@1+ (0.05,0) [0.00|25.55] "m" FVCM
 SG_ Length_18 : 248|8@1+ (0.1,0) [0|25.5] "m" FVCM
 SG_ Reserved_PMOI_Debug_Signal5_18 : 256|8@1+ (0.01,-1) [-1.00|1.55] "" FVCM
 SG_ Reserved_PMOI_Debug_Signal6_18 : 264|8@1+ (0.01,-1) [-1.00|1.55] "" FVCM
 SG_ RadarCrossSection_18 : 272|7@1+ (1,-60) [-60|67] "dBm²" FVCM
 SG_ Yaw_18 : 279|9@1+ (0.02,-3.142) [-3.142|7.078] "rad" FVCM
 SG_ YawSTD_18 : 288|9@1+ (0.02,0) [0.00|10.22] "rad" FVCM
 SG_ Height_18 : 297|6@1+ (0.1,0) [0|6.3] "m" FVCM
 SG_ HeightSTD_18 : 303|6@1+ (0.1,0) [0|6.3] "m" FVCM

BO_ 532 FDR_Object_19: 64 Vector__XXX
 SG_ OD_Info_CRC_19 : 0|16@1+ (1,0) [0|65535] "" FVCM
 SG_ OD_Info_ALIVE_19 : 16|8@1+ (1,0) [0|255] "" FVCM
 SG_ IsNew_19 : 24|2@1+ (1,0) [0|3] "" FVCM
 SG_ ClassificationType_19 : 26|3@1+ (1,0) [0|7] "" FVCM
 SG_ MeasurementStatus_19 : 29|3@1+ (1,0) [0|7] "" FVCM
 SG_ LongitudinalDistance_19 : 32|13@1+ (0.05,-50) [-50.00|359.55] "m" FVCM
 SG_ MovementStatus_19 : 45|3@1+ (1,0) [0|7] "" FVCM
 SG_ ObjectID_19 : 48|8@1+ (1,0) [0|255] "" FVCM
 SG_ ReferencePoint_19 : 56|4@1+ (1,0) [0|15] "" FVCM
 SG_ AbsLongVelocity_19 : 60|12@1+ (0.05,-100) [-100.00|104.75] "m/s" FVCM
 SG_ AbsLatAccSTD_19 : 72|9@1+ (0.008,0) [0.000|4.088] "m/s²" FVCM
 SG_ Reserved_PMOI_Debug_Signal1_19 : 81|8@1+ (0.01,-1) [-1.00|1.55] "" FVCM
 SG_ ExistenceProbability_19 : 89|7@1+ (1,0) [0|127] "%" FVCM
 SG_ AbsLatVeloSTD_19 : 96|9@1+ (0.02,0) [0.00|10.22] "m/s" FVCM
 SG_ ClassificationTypeProbability_19 : 105|7@1+ (1,0) [0|127] "%" FVCM
 SG_ AbsLongAccSTD_19 : 112|9@1+ (0.008,0) [0.000|4.088] "m/s²" FVCM
 SG_ AbsLongVelocitySTD_19 : 121|9@1+ (0.02,0) [0.00|10.22] "m/s" FVCM
 SG_ AbsLatVelocity_19 : 130|12@1+ (0.05,-100) [-100.00|104.75] "m/s" FVCM
 SG_ LengthSTD_19 : 142|7@1+ (0.1,0) [0|12.7] "m" FVCM
 SG_ AbsLatAcc_19 : 149|10@1+ (0.05,-25) [-25.00|26.15] "m/s²" FVCM
 SG_ AbsLongAcc__19 : 159|10@1+ (0.05,-25) [-25.00|26.15] "m/s²" FVCM
 SG_ Width_19 : 169|6@1+ (0.1,0) [0|6.3] "m" FVCM
 SG_ WidthSTD_19 : 175|6@1+ (0.1,0) [0|6.3] "m" FVCM
 SG_ Reserved_PMOI_Debug_Signal2_19 : 181|8@1+ (0.01,-1) [-1.00|1.55] "m/s" FVCM
 SG_ ObjectAge_19 : 189|13@1+ (0.06,0) [0.00|491.46] "s" FVCM
 SG_ Reserved_PMOI_Debug_Signal3_19 : 202|8@1+ (0.01,-1) [-1.00|1.55] "" FVCM
 SG_ Reserved_PMOI_Debug_Signal4_19 : 210|8@1+ (0.01,-1) [-1.00|1.55] "" FVCM
 SG_ LateralDistance_19 : 218|12@1+ (0.05,-100) [-100.00|104.75] "m" FVCM
 SG_ LateralDistanceSTD_19 : 230|9@1+ (0.05,0) [0.00|25.55] "m" FVCM
 SG_ LongitudinalDistanceSTD_19 : 239|9@1+ (0.05,0) [0.00|25.55] "m" FVCM
 SG_ Length_19 : 248|8@1+ (0.1,0) [0|25.5] "m" FVCM
 SG_ Reserved_PMOI_Debug_Signal5_19 : 256|8@1+ (0.01,-1) [-1.00|1.55] "" FVCM
 SG_ Reserved_PMOI_Debug_Signal6_19 : 264|8@1+ (0.01,-1) [-1.00|1.55] "" FVCM
 SG_ RadarCrossSection_19 : 272|7@1+ (1,-60) [-60|67] "dBm²" FVCM
 SG_ Yaw_19 : 279|9@1+ (0.02,-3.142) [-3.142|7.078] "rad" FVCM
 SG_ YawSTD_19 : 288|9@1+ (0.02,0) [0.00|10.22] "rad" FVCM
 SG_ Height_19 : 297|6@1+ (0.1,0) [0|6.3] "m" FVCM
 SG_ HeightSTD_19 : 303|6@1+ (0.1,0) [0|6.3] "m" FVCM

BO_ 515 FDR_Object_2: 64 Vector__XXX
 SG_ OD_Info_CRC_02 : 0|16@1+ (1,0) [0|65535] "" FVCM
 SG_ OD_Info_ALIVE_02 : 16|8@1+ (1,0) [0|255] "" FVCM
 SG_ IsNew_02 : 24|2@1+ (1,0) [0|3] "" FVCM
 SG_ ClassificationType_02 : 26|3@1+ (1,0) [0|7] "" FVCM
 SG_ MeasurementStatus_02 : 29|3@1+ (1,0) [0|7] "" FVCM
 SG_ LongitudinalDistance_02 : 32|13@1+ (0.05,-50) [-50.00|359.55] "m" FVCM
 SG_ MovementStatus_02 : 45|3@1+ (1,0) [0|7] "" FVCM
 SG_ ObjectID_02 : 48|8@1+ (1,0) [0|255] "" FVCM
 SG_ ReferencePoint_02 : 56|4@1+ (1,0) [0|15] "" FVCM
 SG_ AbsLongVelocity_02 : 60|12@1+ (0.05,-100) [-100.00|104.75] "m/s" FVCM
 SG_ AbsLatAccSTD_02 : 72|9@1+ (0.008,0) [0.000|4.088] "m/s²" FVCM
 SG_ Reserved_PMOI_Debug_Signal1_02 : 81|8@1+ (0.01,-1) [-1.00|1.55] "" FVCM
 SG_ ExistenceProbability_02 : 89|7@1+ (1,0) [0|127] "%" FVCM
 SG_ AbsLatVeloSTD_02 : 96|9@1+ (0.02,0) [0.00|10.22] "m/s" FVCM
 SG_ ClassificationTypeProbability_02 : 105|7@1+ (1,0) [0|127] "%" FVCM
 SG_ AbsLongAccSTD_02 : 112|9@1+ (0.008,0) [0.000|4.088] "m/s²" FVCM
 SG_ AbsLongVelocitySTD_02 : 121|9@1+ (0.02,0) [0.00|10.22] "m/s" FVCM
 SG_ AbsLatVelocity_02 : 130|12@1+ (0.05,-100) [-100.00|104.75] "m/s" FVCM
 SG_ LengthSTD_02 : 142|7@1+ (0.1,0) [0|12.7] "m" FVCM
 SG_ AbsLatAcc_02 : 149|10@1+ (0.05,-25) [-25.00|26.15] "m/s²" FVCM
 SG_ AbsLongAcc__02 : 159|10@1+ (0.05,-25) [-25.00|26.15] "m/s²" FVCM
 SG_ Width_02 : 169|6@1+ (0.1,0) [0|6.3] "m" FVCM
 SG_ WidthSTD_02 : 175|6@1+ (0.1,0) [0|6.3] "m" FVCM
 SG_ Reserved_PMOI_Debug_Signal2_02 : 181|8@1+ (0.01,-1) [-1.00|1.55] "m/s" FVCM
 SG_ ObjectAge_02 : 189|13@1+ (0.06,0) [0.00|491.46] "s" FVCM
 SG_ Reserved_PMOI_Debug_Signal3_02 : 202|8@1+ (0.01,-1) [-1.00|1.55] "" FVCM
 SG_ Reserved_PMOI_Debug_Signal4_02 : 210|8@1+ (0.01,-1) [-1.00|1.55] "" FVCM
 SG_ LateralDistance_02 : 218|12@1+ (0.05,-100) [-100.00|104.75] "m" FVCM
 SG_ LateralDistanceSTD_02 : 230|9@1+ (0.05,0) [0.00|25.55] "m" FVCM
 SG_ LongitudinalDistanceSTD_02 : 239|9@1+ (0.05,0) [0.00|25.55] "m" FVCM
 SG_ Length_02 : 248|8@1+ (0.1,0) [0|25.5] "m" FVCM
 SG_ Reserved_PMOI_Debug_Signal5_02 : 256|8@1+ (0.01,-1) [-1.00|1.55] "" FVCM
 SG_ Reserved_PMOI_Debug_Signal6_02 : 264|8@1+ (0.01,-1) [-1.00|1.55] "" FVCM
 SG_ RadarCrossSection_02 : 272|7@1+ (1,-60) [-60|67] "dBm²" FVCM
 SG_ Yaw_02 : 279|9@1+ (0.02,-3.142) [-3.142|7.078] "rad" FVCM
 SG_ YawSTD_02 : 288|9@1+ (0.02,0) [0.00|10.22] "rad" FVCM
 SG_ Height_02 : 297|6@1+ (0.1,0) [0|6.3] "m" FVCM
 SG_ HeightSTD_02 : 303|6@1+ (0.1,0) [0|6.3] "m" FVCM

BO_ 533 FDR_Object_20: 64 Vector__XXX
 SG_ OD_Info_CRC_20 : 0|16@1+ (1,0) [0|65535] "" FVCM
 SG_ OD_Info_ALIVE_20 : 16|8@1+ (1,0) [0|255] "" FVCM
 SG_ IsNew_20 : 24|2@1+ (1,0) [0|3] "" FVCM
 SG_ ClassificationType_20 : 26|3@1+ (1,0) [0|7] "" FVCM
 SG_ MeasurementStatus_20 : 29|3@1+ (1,0) [0|7] "" FVCM
 SG_ LongitudinalDistance_20 : 32|13@1+ (0.05,-50) [-50.00|359.55] "m" FVCM
 SG_ MovementStatus_20 : 45|3@1+ (1,0) [0|7] "" FVCM
 SG_ ObjectID_20 : 48|8@1+ (1,0) [0|255] "" FVCM
 SG_ ReferencePoint_20 : 56|4@1+ (1,0) [0|15] "" FVCM
 SG_ AbsLongVelocity_20 : 60|12@1+ (0.05,-100) [-100.00|104.75] "m/s" FVCM
 SG_ AbsLatAccSTD_20 : 72|9@1+ (0.008,0) [0.000|4.088] "m/s²" FVCM
 SG_ Reserved_PMOI_Debug_Signal1_20 : 81|8@1+ (0.01,-1) [-1.00|1.55] "" FVCM
 SG_ ExistenceProbability_20 : 89|7@1+ (1,0) [0|127] "%" FVCM
 SG_ AbsLatVeloSTD_20 : 96|9@1+ (0.02,0) [0.00|10.22] "m/s" FVCM
 SG_ ClassificationTypeProbability_20 : 105|7@1+ (1,0) [0|127] "%" FVCM
 SG_ AbsLongAccSTD_20 : 112|9@1+ (0.008,0) [0.000|4.088] "m/s²" FVCM
 SG_ AbsLongVelocitySTD_20 : 121|9@1+ (0.02,0) [0.00|10.22] "m/s" FVCM
 SG_ AbsLatVelocity_20 : 130|12@1+ (0.05,-100) [-100.00|104.75] "m/s" FVCM
 SG_ LengthSTD_20 : 142|7@1+ (0.1,0) [0|12.7] "m" FVCM
 SG_ AbsLatAcc_20 : 149|10@1+ (0.05,-25) [-25.00|26.15] "m/s²" FVCM
 SG_ AbsLongAcc__20 : 159|10@1+ (0.05,-25) [-25.00|26.15] "m/s²" FVCM
 SG_ Width_20 : 169|6@1+ (0.1,0) [0|6.3] "m" FVCM
 SG_ WidthSTD_20 : 175|6@1+ (0.1,0) [0|6.3] "m" FVCM
 SG_ Reserved_PMOI_Debug_Signal2_20 : 181|8@1+ (0.01,-1) [-1.00|1.55] "m/s" FVCM
 SG_ ObjectAge_20 : 189|13@1+ (0.06,0) [0.00|491.46] "s" FVCM
 SG_ Reserved_PMOI_Debug_Signal3_20 : 202|8@1+ (0.01,-1) [-1.00|1.55] "" FVCM
 SG_ Reserved_PMOI_Debug_Signal4_20 : 210|8@1+ (0.01,-1) [-1.00|1.55] "" FVCM
 SG_ LateralDistance_20 : 218|12@1+ (0.05,-100) [-100.00|104.75] "m" FVCM
 SG_ LateralDistanceSTD_20 : 230|9@1+ (0.05,0) [0.00|25.55] "m" FVCM
 SG_ LongitudinalDistanceSTD_20 : 239|9@1+ (0.05,0) [0.00|25.55] "m" FVCM
 SG_ Length_20 : 248|8@1+ (0.1,0) [0|25.5] "m" FVCM
 SG_ Reserved_PMOI_Debug_Signal5_20 : 256|8@1+ (0.01,-1) [-1.00|1.55] "" FVCM
 SG_ Reserved_PMOI_Debug_Signal6_20 : 264|8@1+ (0.01,-1) [-1.00|1.55] "" FVCM
 SG_ RadarCrossSection_20 : 272|7@1+ (1,-60) [-60|67] "dBm²" FVCM
 SG_ Yaw_20 : 279|9@1+ (0.02,-3.142) [-3.142|7.078] "rad" FVCM
 SG_ YawSTD_20 : 288|9@1+ (0.02,0) [0.00|10.22] "rad" FVCM
 SG_ Height_20 : 297|6@1+ (0.1,0) [0|6.3] "m" FVCM
 SG_ HeightSTD_20 : 303|6@1+ (0.1,0) [0|6.3] "m" FVCM

BO_ 534 FDR_Object_21: 64 Vector__XXX
 SG_ OD_Info_CRC_21 : 0|16@1+ (1,0) [0|65535] "" FVCM
 SG_ OD_Info_ALIVE_21 : 16|8@1+ (1,0) [0|255] "" FVCM
 SG_ IsNew_21 : 24|2@1+ (1,0) [0|3] "" FVCM
 SG_ ClassificationType_21 : 26|3@1+ (1,0) [0|7] "" FVCM
 SG_ MeasurementStatus_21 : 29|3@1+ (1,0) [0|7] "" FVCM
 SG_ LongitudinalDistance_21 : 32|13@1+ (0.05,-50) [-50.00|359.55] "m" FVCM
 SG_ MovementStatus_21 : 45|3@1+ (1,0) [0|7] "" FVCM
 SG_ ObjectID_21 : 48|8@1+ (1,0) [0|255] "" FVCM
 SG_ ReferencePoint_21 : 56|4@1+ (1,0) [0|15] "" FVCM
 SG_ AbsLongVelocity_21 : 60|12@1+ (0.05,-100) [-100.00|104.75] "m/s" FVCM
 SG_ AbsLatAccSTD_21 : 72|9@1+ (0.008,0) [0.000|4.088] "m/s²" FVCM
 SG_ Reserved_PMOI_Debug_Signal1_21 : 81|8@1+ (0.01,-1) [-1.00|1.55] "" FVCM
 SG_ ExistenceProbability_21 : 89|7@1+ (1,0) [0|127] "%" FVCM
 SG_ AbsLatVeloSTD_21 : 96|9@1+ (0.02,0) [0.00|10.22] "m/s" FVCM
 SG_ ClassificationTypeProbability_21 : 105|7@1+ (1,0) [0|127] "%" FVCM
 SG_ AbsLongAccSTD_21 : 112|9@1+ (0.008,0) [0.000|4.088] "m/s²" FVCM
 SG_ AbsLongVelocitySTD_21 : 121|9@1+ (0.02,0) [0.00|10.22] "m/s" FVCM
 SG_ AbsLatVelocity_21 : 130|12@1+ (0.05,-100) [-100.00|104.75] "m/s" FVCM
 SG_ LengthSTD_21 : 142|7@1+ (0.1,0) [0|12.7] "m" FVCM
 SG_ AbsLatAcc_21 : 149|10@1+ (0.05,-25) [-25.00|26.15] "m/s²" FVCM
 SG_ AbsLongAcc__21 : 159|10@1+ (0.05,-25) [-25.00|26.15] "m/s²" FVCM
 SG_ Width_21 : 169|6@1+ (0.1,0) [0|6.3] "m" FVCM
 SG_ WidthSTD_21 : 175|6@1+ (0.1,0) [0|6.3] "m" FVCM
 SG_ Reserved_PMOI_Debug_Signal2_21 : 181|8@1+ (0.01,-1) [-1.00|1.55] "m/s" FVCM
 SG_ ObjectAge_21 : 189|13@1+ (0.06,0) [0.00|491.46] "s" FVCM
 SG_ Reserved_PMOI_Debug_Signal3_21 : 202|8@1+ (0.01,-1) [-1.00|1.55] "" FVCM
 SG_ Reserved_PMOI_Debug_Signal4_21 : 210|8@1+ (0.01,-1) [-1.00|1.55] "" FVCM
 SG_ LateralDistance_21 : 218|12@1+ (0.05,-100) [-100.00|104.75] "m" FVCM
 SG_ LateralDistanceSTD_21 : 230|9@1+ (0.05,0) [0.00|25.55] "m" FVCM
 SG_ LongitudinalDistanceSTD_21 : 239|9@1+ (0.05,0) [0.00|25.55] "m" FVCM
 SG_ Length_21 : 248|8@1+ (0.1,0) [0|25.5] "m" FVCM
 SG_ Reserved_PMOI_Debug_Signal5_21 : 256|8@1+ (0.01,-1) [-1.00|1.55] "" FVCM
 SG_ Reserved_PMOI_Debug_Signal6_21 : 264|8@1+ (0.01,-1) [-1.00|1.55] "" FVCM
 SG_ RadarCrossSection_21 : 272|7@1+ (1,-60) [-60|67] "dBm²" FVCM
 SG_ Yaw_21 : 279|9@1+ (0.02,-3.142) [-3.142|7.078] "rad" FVCM
 SG_ YawSTD_21 : 288|9@1+ (0.02,0) [0.00|10.22] "rad" FVCM
 SG_ Height_21 : 297|6@1+ (0.1,0) [0|6.3] "m" FVCM
 SG_ HeightSTD_21 : 303|6@1+ (0.1,0) [0|6.3] "m" FVCM

BO_ 535 FDR_Object_22: 64 Vector__XXX
 SG_ OD_Info_CRC_22 : 0|16@1+ (1,0) [0|65535] "" FVCM
 SG_ OD_Info_ALIVE_22 : 16|8@1+ (1,0) [0|255] "" FVCM
 SG_ IsNew_22 : 24|2@1+ (1,0) [0|3] "" FVCM
 SG_ ClassificationType_22 : 26|3@1+ (1,0) [0|7] "" FVCM
 SG_ MeasurementStatus_22 : 29|3@1+ (1,0) [0|7] "" FVCM
 SG_ LongitudinalDistance_22 : 32|13@1+ (0.05,-50) [-50.00|359.55] "m" FVCM
 SG_ MovementStatus_22 : 45|3@1+ (1,0) [0|7] "" FVCM
 SG_ ObjectID_22 : 48|8@1+ (1,0) [0|255] "" FVCM
 SG_ ReferencePoint_22 : 56|4@1+ (1,0) [0|15] "" FVCM
 SG_ AbsLongVelocity_22 : 60|12@1+ (0.05,-100) [-100.00|104.75] "m/s" FVCM
 SG_ AbsLatAccSTD_22 : 72|9@1+ (0.008,0) [0.000|4.088] "m/s²" FVCM
 SG_ Reserved_PMOI_Debug_Signal1_22 : 81|8@1+ (0.01,-1) [-1.00|1.55] "" FVCM
 SG_ ExistenceProbability_22 : 89|7@1+ (1,0) [0|127] "%" FVCM
 SG_ AbsLatVeloSTD_22 : 96|9@1+ (0.02,0) [0.00|10.22] "m/s" FVCM
 SG_ ClassificationTypeProbability_22 : 105|7@1+ (1,0) [0|127] "%" FVCM
 SG_ AbsLongAccSTD_22 : 112|9@1+ (0.008,0) [0.000|4.088] "m/s²" FVCM
 SG_ AbsLongVelocitySTD_22 : 121|9@1+ (0.02,0) [0.00|10.22] "m/s" FVCM
 SG_ AbsLatVelocity_22 : 130|12@1+ (0.05,-100) [-100.00|104.75] "m/s" FVCM
 SG_ LengthSTD_22 : 142|7@1+ (0.1,0) [0|12.7] "m" FVCM
 SG_ AbsLatAcc_22 : 149|10@1+ (0.05,-25) [-25.00|26.15] "m/s²" FVCM
 SG_ AbsLongAcc__22 : 159|10@1+ (0.05,-25) [-25.00|26.15] "m/s²" FVCM
 SG_ Width_22 : 169|6@1+ (0.1,0) [0|6.3] "m" FVCM
 SG_ WidthSTD_22 : 175|6@1+ (0.1,0) [0|6.3] "m" FVCM
 SG_ Reserved_PMOI_Debug_Signal2_22 : 181|8@1+ (0.01,-1) [-1.00|1.55] "m/s" FVCM
 SG_ ObjectAge_22 : 189|13@1+ (0.06,0) [0.00|491.46] "s" FVCM
 SG_ Reserved_PMOI_Debug_Signal3_22 : 202|8@1+ (0.01,-1) [-1.00|1.55] "" FVCM
 SG_ Reserved_PMOI_Debug_Signal4_22 : 210|8@1+ (0.01,-1) [-1.00|1.55] "" FVCM
 SG_ LateralDistance_22 : 218|12@1+ (0.05,-100) [-100.00|104.75] "m" FVCM
 SG_ LateralDistanceSTD_22 : 230|9@1+ (0.05,0) [0.00|25.55] "m" FVCM
 SG_ LongitudinalDistanceSTD_22 : 239|9@1+ (0.05,0) [0.00|25.55] "m" FVCM
 SG_ Length_22 : 248|8@1+ (0.1,0) [0|25.5] "m" FVCM
 SG_ Reserved_PMOI_Debug_Signal5_22 : 256|8@1+ (0.01,-1) [-1.00|1.55] "" FVCM
 SG_ Reserved_PMOI_Debug_Signal6_22 : 264|8@1+ (0.01,-1) [-1.00|1.55] "" FVCM
 SG_ RadarCrossSection_22 : 272|7@1+ (1,-60) [-60|67] "dBm²" FVCM
 SG_ Yaw_22 : 279|9@1+ (0.02,-3.142) [-3.142|7.078] "rad" FVCM
 SG_ YawSTD_22 : 288|9@1+ (0.02,0) [0.00|10.22] "rad" FVCM
 SG_ Height_22 : 297|6@1+ (0.1,0) [0|6.3] "m" FVCM
 SG_ HeightSTD_22 : 303|6@1+ (0.1,0) [0|6.3] "m" FVCM

BO_ 536 FDR_Object_23: 64 Vector__XXX
 SG_ OD_Info_CRC_23 : 0|16@1+ (1,0) [0|65535] "" FVCM
 SG_ OD_Info_ALIVE_23 : 16|8@1+ (1,0) [0|255] "" FVCM
 SG_ IsNew_23 : 24|2@1+ (1,0) [0|3] "" FVCM
 SG_ ClassificationType_23 : 26|3@1+ (1,0) [0|7] "" FVCM
 SG_ MeasurementStatus_23 : 29|3@1+ (1,0) [0|7] "" FVCM
 SG_ LongitudinalDistance_23 : 32|13@1+ (0.05,-50) [-50.00|359.55] "m" FVCM
 SG_ MovementStatus_23 : 45|3@1+ (1,0) [0|7] "" FVCM
 SG_ ObjectID_23 : 48|8@1+ (1,0) [0|255] "" FVCM
 SG_ ReferencePoint_23 : 56|4@1+ (1,0) [0|15] "" FVCM
 SG_ AbsLongVelocity_23 : 60|12@1+ (0.05,-100) [-100.00|104.75] "m/s" FVCM
 SG_ AbsLatAccSTD_23 : 72|9@1+ (0.008,0) [0.000|4.088] "m/s²" FVCM
 SG_ Reserved_PMOI_Debug_Signal1_23 : 81|8@1+ (0.01,-1) [-1.00|1.55] "" FVCM
 SG_ ExistenceProbability_23 : 89|7@1+ (1,0) [0|127] "%" FVCM
 SG_ AbsLatVeloSTD_23 : 96|9@1+ (0.02,0) [0.00|10.22] "m/s" FVCM
 SG_ ClassificationTypeProbability_23 : 105|7@1+ (1,0) [0|127] "%" FVCM
 SG_ AbsLongAccSTD_23 : 112|9@1+ (0.008,0) [0.000|4.088] "m/s²" FVCM
 SG_ AbsLongVelocitySTD_23 : 121|9@1+ (0.02,0) [0.00|10.22] "m/s" FVCM
 SG_ AbsLatVelocity_23 : 130|12@1+ (0.05,-100) [-100.00|104.75] "m/s" FVCM
 SG_ LengthSTD_23 : 142|7@1+ (0.1,0) [0|12.7] "m" FVCM
 SG_ AbsLatAcc_23 : 149|10@1+ (0.05,-25) [-25.00|26.15] "m/s²" FVCM
 SG_ AbsLongAcc__23 : 159|10@1+ (0.05,-25) [-25.00|26.15] "m/s²" FVCM
 SG_ Width_23 : 169|6@1+ (0.1,0) [0|6.3] "m" FVCM
 SG_ WidthSTD_23 : 175|6@1+ (0.1,0) [0|6.3] "m" FVCM
 SG_ Reserved_PMOI_Debug_Signal2_23 : 181|8@1+ (0.01,-1) [-1.00|1.55] "m/s" FVCM
 SG_ ObjectAge_23 : 189|13@1+ (0.06,0) [0.00|491.46] "s" FVCM
 SG_ Reserved_PMOI_Debug_Signal3_23 : 202|8@1+ (0.01,-1) [-1.00|1.55] "" FVCM
 SG_ Reserved_PMOI_Debug_Signal4_23 : 210|8@1+ (0.01,-1) [-1.00|1.55] "" FVCM
 SG_ LateralDistance_23 : 218|12@1+ (0.05,-100) [-100.00|104.75] "m" FVCM
 SG_ LateralDistanceSTD_23 : 230|9@1+ (0.05,0) [0.00|25.55] "m" FVCM
 SG_ LongitudinalDistanceSTD_23 : 239|9@1+ (0.05,0) [0.00|25.55] "m" FVCM
 SG_ Length_23 : 248|8@1+ (0.1,0) [0|25.5] "m" FVCM
 SG_ Reserved_PMOI_Debug_Signal5_23 : 256|8@1+ (0.01,-1) [-1.00|1.55] "" FVCM
 SG_ Reserved_PMOI_Debug_Signal6_23 : 264|8@1+ (0.01,-1) [-1.00|1.55] "" FVCM
 SG_ RadarCrossSection_23 : 272|7@1+ (1,-60) [-60|67] "dBm²" FVCM
 SG_ Yaw_23 : 279|9@1+ (0.02,-3.142) [-3.142|7.078] "rad" FVCM
 SG_ YawSTD_23 : 288|9@1+ (0.02,0) [0.00|10.22] "rad" FVCM
 SG_ Height_23 : 297|6@1+ (0.1,0) [0|6.3] "m" FVCM
 SG_ HeightSTD_23 : 303|6@1+ (0.1,0) [0|6.3] "m" FVCM

BO_ 537 FDR_Object_24: 64 Vector__XXX
 SG_ OD_Info_CRC_24 : 0|16@1+ (1,0) [0|65535] "" FVCM
 SG_ OD_Info_ALIVE_24 : 16|8@1+ (1,0) [0|255] "" FVCM
 SG_ IsNew_24 : 24|2@1+ (1,0) [0|3] "" FVCM
 SG_ ClassificationType_24 : 26|3@1+ (1,0) [0|7] "" FVCM
 SG_ MeasurementStatus_24 : 29|3@1+ (1,0) [0|7] "" FVCM
 SG_ LongitudinalDistance_24 : 32|13@1+ (0.05,-50) [-50.00|359.55] "m" FVCM
 SG_ MovementStatus_24 : 45|3@1+ (1,0) [0|7] "" FVCM
 SG_ ObjectID_24 : 48|8@1+ (1,0) [0|255] "" FVCM
 SG_ ReferencePoint_24 : 56|4@1+ (1,0) [0|15] "" FVCM
 SG_ AbsLongVelocity_24 : 60|12@1+ (0.05,-100) [-100.00|104.75] "m/s" FVCM
 SG_ AbsLatAccSTD_24 : 72|9@1+ (0.008,0) [0.000|4.088] "m/s²" FVCM
 SG_ Reserved_PMOI_Debug_Signal1_24 : 81|8@1+ (0.01,-1) [-1.00|1.55] "" FVCM
 SG_ ExistenceProbability_24 : 89|7@1+ (1,0) [0|127] "%" FVCM
 SG_ AbsLatVeloSTD_24 : 96|9@1+ (0.02,0) [0.00|10.22] "m/s" FVCM
 SG_ ClassificationTypeProbability_24 : 105|7@1+ (1,0) [0|127] "%" FVCM
 SG_ AbsLongAccSTD_24 : 112|9@1+ (0.008,0) [0.000|4.088] "m/s²" FVCM
 SG_ AbsLongVelocitySTD_24 : 121|9@1+ (0.02,0) [0.00|10.22] "m/s" FVCM
 SG_ AbsLatVelocity_24 : 130|12@1+ (0.05,-100) [-100.00|104.75] "m/s" FVCM
 SG_ LengthSTD_24 : 142|7@1+ (0.1,0) [0|12.7] "m" FVCM
 SG_ AbsLatAcc_24 : 149|10@1+ (0.05,-25) [-25.00|26.15] "m/s²" FVCM
 SG_ AbsLongAcc__24 : 159|10@1+ (0.05,-25) [-25.00|26.15] "m/s²" FVCM
 SG_ Width_24 : 169|6@1+ (0.1,0) [0|6.3] "m" FVCM
 SG_ WidthSTD_24 : 175|6@1+ (0.1,0) [0|6.3] "m" FVCM
 SG_ Reserved_PMOI_Debug_Signal2_24 : 181|8@1+ (0.01,-1) [-1.00|1.55] "m/s" FVCM
 SG_ ObjectAge_24 : 189|13@1+ (0.06,0) [0.00|491.46] "s" FVCM
 SG_ Reserved_PMOI_Debug_Signal3_24 : 202|8@1+ (0.01,-1) [-1.00|1.55] "" FVCM
 SG_ Reserved_PMOI_Debug_Signal4_24 : 210|8@1+ (0.01,-1) [-1.00|1.55] "" FVCM
 SG_ LateralDistance_24 : 218|12@1+ (0.05,-100) [-100.00|104.75] "m" FVCM
 SG_ LateralDistanceSTD_24 : 230|9@1+ (0.05,0) [0.00|25.55] "m" FVCM
 SG_ LongitudinalDistanceSTD_24 : 239|9@1+ (0.05,0) [0.00|25.55] "m" FVCM
 SG_ Length_24 : 248|8@1+ (0.1,0) [0|25.5] "m" FVCM
 SG_ Reserved_PMOI_Debug_Signal5_24 : 256|8@1+ (0.01,-1) [-1.00|1.55] "" FVCM
 SG_ Reserved_PMOI_Debug_Signal6_24 : 264|8@1+ (0.01,-1) [-1.00|1.55] "" FVCM
 SG_ RadarCrossSection_24 : 272|7@1+ (1,-60) [-60|67] "dBm²" FVCM
 SG_ Yaw_24 : 279|9@1+ (0.02,-3.142) [-3.142|7.078] "rad" FVCM
 SG_ YawSTD_24 : 288|9@1+ (0.02,0) [0.00|10.22] "rad" FVCM
 SG_ Height_24 : 297|6@1+ (0.1,0) [0|6.3] "m" FVCM
 SG_ HeightSTD_24 : 303|6@1+ (0.1,0) [0|6.3] "m" FVCM

BO_ 538 FDR_Object_25: 64 Vector__XXX
 SG_ OD_Info_CRC_25 : 0|16@1+ (1,0) [0|65535] "" FVCM
 SG_ OD_Info_ALIVE_25 : 16|8@1+ (1,0) [0|255] "" FVCM
 SG_ IsNew_25 : 24|2@1+ (1,0) [0|3] "" FVCM
 SG_ ClassificationType_25 : 26|3@1+ (1,0) [0|7] "" FVCM
 SG_ MeasurementStatus_25 : 29|3@1+ (1,0) [0|7] "" FVCM
 SG_ LongitudinalDistance_25 : 32|13@1+ (0.05,-50) [-50.00|359.55] "m" FVCM
 SG_ MovementStatus_25 : 45|3@1+ (1,0) [0|7] "" FVCM
 SG_ ObjectID_25 : 48|8@1+ (1,0) [0|255] "" FVCM
 SG_ ReferencePoint_25 : 56|4@1+ (1,0) [0|15] "" FVCM
 SG_ AbsLongVelocity_25 : 60|12@1+ (0.05,-100) [-100.00|104.75] "m/s" FVCM
 SG_ AbsLatAccSTD_25 : 72|9@1+ (0.008,0) [0.000|4.088] "m/s²" FVCM
 SG_ Reserved_PMOI_Debug_Signal1_25 : 81|8@1+ (0.01,-1) [-1.00|1.55] "" FVCM
 SG_ ExistenceProbability_25 : 89|7@1+ (1,0) [0|127] "%" FVCM
 SG_ AbsLatVeloSTD_25 : 96|9@1+ (0.02,0) [0.00|10.22] "m/s" FVCM
 SG_ ClassificationTypeProbability_25 : 105|7@1+ (1,0) [0|127] "%" FVCM
 SG_ AbsLongAccSTD_25 : 112|9@1+ (0.008,0) [0.000|4.088] "m/s²" FVCM
 SG_ AbsLongVelocitySTD_25 : 121|9@1+ (0.02,0) [0.00|10.22] "m/s" FVCM
 SG_ AbsLatVelocity_25 : 130|12@1+ (0.05,-100) [-100.00|104.75] "m/s" FVCM
 SG_ LengthSTD_25 : 142|7@1+ (0.1,0) [0|12.7] "m" FVCM
 SG_ AbsLatAcc_25 : 149|10@1+ (0.05,-25) [-25.00|26.15] "m/s²" FVCM
 SG_ AbsLongAcc__25 : 159|10@1+ (0.05,-25) [-25.00|26.15] "m/s²" FVCM
 SG_ Width_25 : 169|6@1+ (0.1,0) [0|6.3] "m" FVCM
 SG_ WidthSTD_25 : 175|6@1+ (0.1,0) [0|6.3] "m" FVCM
 SG_ Reserved_PMOI_Debug_Signal2_25 : 181|8@1+ (0.01,-1) [-1.00|1.55] "m/s" FVCM
 SG_ ObjectAge_25 : 189|13@1+ (0.06,0) [0.00|491.46] "s" FVCM
 SG_ Reserved_PMOI_Debug_Signal3_25 : 202|8@1+ (0.01,-1) [-1.00|1.55] "" FVCM
 SG_ Reserved_PMOI_Debug_Signal4_25 : 210|8@1+ (0.01,-1) [-1.00|1.55] "" FVCM
 SG_ LateralDistance_25 : 218|12@1+ (0.05,-100) [-100.00|104.75] "m" FVCM
 SG_ LateralDistanceSTD_25 : 230|9@1+ (0.05,0) [0.00|25.55] "m" FVCM
 SG_ LongitudinalDistanceSTD_25 : 239|9@1+ (0.05,0) [0.00|25.55] "m" FVCM
 SG_ Length_25 : 248|8@1+ (0.1,0) [0|25.5] "m" FVCM
 SG_ Reserved_PMOI_Debug_Signal5_25 : 256|8@1+ (0.01,-1) [-1.00|1.55] "" FVCM
 SG_ Reserved_PMOI_Debug_Signal6_25 : 264|8@1+ (0.01,-1) [-1.00|1.55] "" FVCM
 SG_ RadarCrossSection_25 : 272|7@1+ (1,-60) [-60|67] "dBm²" FVCM
 SG_ Yaw_25 : 279|9@1+ (0.02,-3.142) [-3.142|7.078] "rad" FVCM
 SG_ YawSTD_25 : 288|9@1+ (0.02,0) [0.00|10.22] "rad" FVCM
 SG_ Height_25 : 297|6@1+ (0.1,0) [0|6.3] "m" FVCM
 SG_ HeightSTD_25 : 303|6@1+ (0.1,0) [0|6.3] "m" FVCM

BO_ 539 FDR_Object_26: 64 Vector__XXX
 SG_ OD_Info_CRC_26 : 0|16@1+ (1,0) [0|65535] "" FVCM
 SG_ OD_Info_ALIVE_26 : 16|8@1+ (1,0) [0|255] "" FVCM
 SG_ IsNew_26 : 24|2@1+ (1,0) [0|3] "" FVCM
 SG_ ClassificationType_26 : 26|3@1+ (1,0) [0|7] "" FVCM
 SG_ MeasurementStatus_26 : 29|3@1+ (1,0) [0|7] "" FVCM
 SG_ LongitudinalDistance_26 : 32|13@1+ (0.05,-50) [-50.00|359.55] "m" FVCM
 SG_ MovementStatus_26 : 45|3@1+ (1,0) [0|7] "" FVCM
 SG_ ObjectID_26 : 48|8@1+ (1,0) [0|255] "" FVCM
 SG_ ReferencePoint_26 : 56|4@1+ (1,0) [0|15] "" FVCM
 SG_ AbsLongVelocity_26 : 60|12@1+ (0.05,-100) [-100.00|104.75] "m/s" FVCM
 SG_ AbsLatAccSTD_26 : 72|9@1+ (0.008,0) [0.000|4.088] "m/s²" FVCM
 SG_ Reserved_PMOI_Debug_Signal1_26 : 81|8@1+ (0.01,-1) [-1.00|1.55] "" FVCM
 SG_ ExistenceProbability_26 : 89|7@1+ (1,0) [0|127] "%" FVCM
 SG_ AbsLatVeloSTD_26 : 96|9@1+ (0.02,0) [0.00|10.22] "m/s" FVCM
 SG_ ClassificationTypeProbability_26 : 105|7@1+ (1,0) [0|127] "%" FVCM
 SG_ AbsLongAccSTD_26 : 112|9@1+ (0.008,0) [0.000|4.088] "m/s²" FVCM
 SG_ AbsLongVelocitySTD_26 : 121|9@1+ (0.02,0) [0.00|10.22] "m/s" FVCM
 SG_ AbsLatVelocity_26 : 130|12@1+ (0.05,-100) [-100.00|104.75] "m/s" FVCM
 SG_ LengthSTD_26 : 142|7@1+ (0.1,0) [0|12.7] "m" FVCM
 SG_ AbsLatAcc_26 : 149|10@1+ (0.05,-25) [-25.00|26.15] "m/s²" FVCM
 SG_ AbsLongAcc__26 : 159|10@1+ (0.05,-25) [-25.00|26.15] "m/s²" FVCM
 SG_ Width_26 : 169|6@1+ (0.1,0) [0|6.3] "m" FVCM
 SG_ WidthSTD_26 : 175|6@1+ (0.1,0) [0|6.3] "m" FVCM
 SG_ Reserved_PMOI_Debug_Signal2_26 : 181|8@1+ (0.01,-1) [-1.00|1.55] "m/s" FVCM
 SG_ ObjectAge_26 : 189|13@1+ (0.06,0) [0.00|491.46] "s" FVCM
 SG_ Reserved_PMOI_Debug_Signal3_26 : 202|8@1+ (0.01,-1) [-1.00|1.55] "" FVCM
 SG_ Reserved_PMOI_Debug_Signal4_26 : 210|8@1+ (0.01,-1) [-1.00|1.55] "" FVCM
 SG_ LateralDistance_26 : 218|12@1+ (0.05,-100) [-100.00|104.75] "m" FVCM
 SG_ LateralDistanceSTD_26 : 230|9@1+ (0.05,0) [0.00|25.55] "m" FVCM
 SG_ LongitudinalDistanceSTD_26 : 239|9@1+ (0.05,0) [0.00|25.55] "m" FVCM
 SG_ Length_26 : 248|8@1+ (0.1,0) [0|25.5] "m" FVCM
 SG_ Reserved_PMOI_Debug_Signal5_26 : 256|8@1+ (0.01,-1) [-1.00|1.55] "" FVCM
 SG_ Reserved_PMOI_Debug_Signal6_26 : 264|8@1+ (0.01,-1) [-1.00|1.55] "" FVCM
 SG_ RadarCrossSection_26 : 272|7@1+ (1,-60) [-60|67] "dBm²" FVCM
 SG_ Yaw_26 : 279|9@1+ (0.02,-3.142) [-3.142|7.078] "rad" FVCM
 SG_ YawSTD_26 : 288|9@1+ (0.02,0) [0.00|10.22] "rad" FVCM
 SG_ Height_26 : 297|6@1+ (0.1,0) [0|6.3] "m" FVCM
 SG_ HeightSTD_26 : 303|6@1+ (0.1,0) [0|6.3] "m" FVCM

BO_ 540 FDR_Object_27: 64 Vector__XXX
 SG_ OD_Info_CRC_27 : 0|16@1+ (1,0) [0|65535] "" FVCM
 SG_ OD_Info_ALIVE_27 : 16|8@1+ (1,0) [0|255] "" FVCM
 SG_ IsNew_27 : 24|2@1+ (1,0) [0|3] "" FVCM
 SG_ ClassificationType_27 : 26|3@1+ (1,0) [0|7] "" FVCM
 SG_ MeasurementStatus_27 : 29|3@1+ (1,0) [0|7] "" FVCM
 SG_ LongitudinalDistance_27 : 32|13@1+ (0.05,-50) [-50.00|359.55] "m" FVCM
 SG_ MovementStatus_27 : 45|3@1+ (1,0) [0|7] "" FVCM
 SG_ ObjectID_27 : 48|8@1+ (1,0) [0|255] "" FVCM
 SG_ ReferencePoint_27 : 56|4@1+ (1,0) [0|15] "" FVCM
 SG_ AbsLongVelocity_27 : 60|12@1+ (0.05,-100) [-100.00|104.75] "m/s" FVCM
 SG_ AbsLatAccSTD_27 : 72|9@1+ (0.008,0) [0.000|4.088] "m/s²" FVCM
 SG_ Reserved_PMOI_Debug_Signal1_27 : 81|8@1+ (0.01,-1) [-1.00|1.55] "" FVCM
 SG_ ExistenceProbability_27 : 89|7@1+ (1,0) [0|127] "%" FVCM
 SG_ AbsLatVeloSTD_27 : 96|9@1+ (0.02,0) [0.00|10.22] "m/s" FVCM
 SG_ ClassificationTypeProbability_27 : 105|7@1+ (1,0) [0|127] "%" FVCM
 SG_ AbsLongAccSTD_27 : 112|9@1+ (0.008,0) [0.000|4.088] "m/s²" FVCM
 SG_ AbsLongVelocitySTD_27 : 121|9@1+ (0.02,0) [0.00|10.22] "m/s" FVCM
 SG_ AbsLatVelocity_27 : 130|12@1+ (0.05,-100) [-100.00|104.75] "m/s" FVCM
 SG_ LengthSTD_27 : 142|7@1+ (0.1,0) [0|12.7] "m" FVCM
 SG_ AbsLatAcc_27 : 149|10@1+ (0.05,-25) [-25.00|26.15] "m/s²" FVCM
 SG_ AbsLongAcc__27 : 159|10@1+ (0.05,-25) [-25.00|26.15] "m/s²" FVCM
 SG_ Width_27 : 169|6@1+ (0.1,0) [0|6.3] "m" FVCM
 SG_ WidthSTD_27 : 175|6@1+ (0.1,0) [0|6.3] "m" FVCM
 SG_ Reserved_PMOI_Debug_Signal2_27 : 181|8@1+ (0.01,-1) [-1.00|1.55] "m/s" FVCM
 SG_ ObjectAge_27 : 189|13@1+ (0.06,0) [0.00|491.46] "s" FVCM
 SG_ Reserved_PMOI_Debug_Signal3_27 : 202|8@1+ (0.01,-1) [-1.00|1.55] "" FVCM
 SG_ Reserved_PMOI_Debug_Signal4_27 : 210|8@1+ (0.01,-1) [-1.00|1.55] "" FVCM
 SG_ LateralDistance_27 : 218|12@1+ (0.05,-100) [-100.00|104.75] "m" FVCM
 SG_ LateralDistanceSTD_27 : 230|9@1+ (0.05,0) [0.00|25.55] "m" FVCM
 SG_ LongitudinalDistanceSTD_27 : 239|9@1+ (0.05,0) [0.00|25.55] "m" FVCM
 SG_ Length_27 : 248|8@1+ (0.1,0) [0|25.5] "m" FVCM
 SG_ Reserved_PMOI_Debug_Signal5_27 : 256|8@1+ (0.01,-1) [-1.00|1.55] "" FVCM
 SG_ Reserved_PMOI_Debug_Signal6_27 : 264|8@1+ (0.01,-1) [-1.00|1.55] "" FVCM
 SG_ RadarCrossSection_27 : 272|7@1+ (1,-60) [-60|67] "dBm²" FVCM
 SG_ Yaw_27 : 279|9@1+ (0.02,-3.142) [-3.142|7.078] "rad" FVCM
 SG_ YawSTD_27 : 288|9@1+ (0.02,0) [0.00|10.22] "rad" FVCM
 SG_ Height_27 : 297|6@1+ (0.1,0) [0|6.3] "m" FVCM
 SG_ HeightSTD_27 : 303|6@1+ (0.1,0) [0|6.3] "m" FVCM

BO_ 541 FDR_Object_28: 64 Vector__XXX
 SG_ OD_Info_CRC_28 : 0|16@1+ (1,0) [0|65535] "" FVCM
 SG_ OD_Info_ALIVE_28 : 16|8@1+ (1,0) [0|255] "" FVCM
 SG_ IsNew_28 : 24|2@1+ (1,0) [0|3] "" FVCM
 SG_ ClassificationType_28 : 26|3@1+ (1,0) [0|7] "" FVCM
 SG_ MeasurementStatus_28 : 29|3@1+ (1,0) [0|7] "" FVCM
 SG_ LongitudinalDistance_28 : 32|13@1+ (0.05,-50) [-50.00|359.55] "m" FVCM
 SG_ MovementStatus_28 : 45|3@1+ (1,0) [0|7] "" FVCM
 SG_ ObjectID_28 : 48|8@1+ (1,0) [0|255] "" FVCM
 SG_ ReferencePoint_28 : 56|4@1+ (1,0) [0|15] "" FVCM
 SG_ AbsLongVelocity_28 : 60|12@1+ (0.05,-100) [-100.00|104.75] "m/s" FVCM
 SG_ AbsLatAccSTD_28 : 72|9@1+ (0.008,0) [0.000|4.088] "m/s²" FVCM
 SG_ Reserved_PMOI_Debug_Signal1_28 : 81|8@1+ (0.01,-1) [-1.00|1.55] "" FVCM
 SG_ ExistenceProbability_28 : 89|7@1+ (1,0) [0|127] "%" FVCM
 SG_ AbsLatVeloSTD_28 : 96|9@1+ (0.02,0) [0.00|10.22] "m/s" FVCM
 SG_ ClassificationTypeProbability_28 : 105|7@1+ (1,0) [0|127] "%" FVCM
 SG_ AbsLongAccSTD_28 : 112|9@1+ (0.008,0) [0.000|4.088] "m/s²" FVCM
 SG_ AbsLongVelocitySTD_28 : 121|9@1+ (0.02,0) [0.00|10.22] "m/s" FVCM
 SG_ AbsLatVelocity_28 : 130|12@1+ (0.05,-100) [-100.00|104.75] "m/s" FVCM
 SG_ LengthSTD_28 : 142|7@1+ (0.1,0) [0|12.7] "m" FVCM
 SG_ AbsLatAcc_28 : 149|10@1+ (0.05,-25) [-25.00|26.15] "m/s²" FVCM
 SG_ AbsLongAcc__28 : 159|10@1+ (0.05,-25) [-25.00|26.15] "m/s²" FVCM
 SG_ Width_28 : 169|6@1+ (0.1,0) [0|6.3] "m" FVCM
 SG_ WidthSTD_28 : 175|6@1+ (0.1,0) [0|6.3] "m" FVCM
 SG_ Reserved_PMOI_Debug_Signal2_28 : 181|8@1+ (0.01,-1) [-1.00|1.55] "m/s" FVCM
 SG_ ObjectAge_28 : 189|13@1+ (0.06,0) [0.00|491.46] "s" FVCM
 SG_ Reserved_PMOI_Debug_Signal3_28 : 202|8@1+ (0.01,-1) [-1.00|1.55] "" FVCM
 SG_ Reserved_PMOI_Debug_Signal4_28 : 210|8@1+ (0.01,-1) [-1.00|1.55] "" FVCM
 SG_ LateralDistance_28 : 218|12@1+ (0.05,-100) [-100.00|104.75] "m" FVCM
 SG_ LateralDistanceSTD_28 : 230|9@1+ (0.05,0) [0.00|25.55] "m" FVCM
 SG_ LongitudinalDistanceSTD_28 : 239|9@1+ (0.05,0) [0.00|25.55] "m" FVCM
 SG_ Length_28 : 248|8@1+ (0.1,0) [0|25.5] "m" FVCM
 SG_ Reserved_PMOI_Debug_Signal5_28 : 256|8@1+ (0.01,-1) [-1.00|1.55] "" FVCM
 SG_ Reserved_PMOI_Debug_Signal6_28 : 264|8@1+ (0.01,-1) [-1.00|1.55] "" FVCM
 SG_ RadarCrossSection_28 : 272|7@1+ (1,-60) [-60|67] "dBm²" FVCM
 SG_ Yaw_28 : 279|9@1+ (0.02,-3.142) [-3.142|7.078] "rad" FVCM
 SG_ YawSTD_28 : 288|9@1+ (0.02,0) [0.00|10.22] "rad" FVCM
 SG_ Height_28 : 297|6@1+ (0.1,0) [0|6.3] "m" FVCM
 SG_ HeightSTD_28 : 303|6@1+ (0.1,0) [0|6.3] "m" FVCM

BO_ 542 FDR_Object_29: 64 Vector__XXX
 SG_ OD_Info_CRC_29 : 0|16@1+ (1,0) [0|65535] "" FVCM
 SG_ OD_Info_ALIVE_29 : 16|8@1+ (1,0) [0|255] "" FVCM
 SG_ IsNew_29 : 24|2@1+ (1,0) [0|3] "" FVCM
 SG_ ClassificationType_29 : 26|3@1+ (1,0) [0|7] "" FVCM
 SG_ MeasurementStatus_29 : 29|3@1+ (1,0) [0|7] "" FVCM
 SG_ LongitudinalDistance_29 : 32|13@1+ (0.05,-50) [-50.00|359.55] "m" FVCM
 SG_ MovementStatus_29 : 45|3@1+ (1,0) [0|7] "" FVCM
 SG_ ObjectID_29 : 48|8@1+ (1,0) [0|255] "" FVCM
 SG_ ReferencePoint_29 : 56|4@1+ (1,0) [0|15] "" FVCM
 SG_ AbsLongVelocity_29 : 60|12@1+ (0.05,-100) [-100.00|104.75] "m/s" FVCM
 SG_ AbsLatAccSTD_29 : 72|9@1+ (0.008,0) [0.000|4.088] "m/s²" FVCM
 SG_ Reserved_PMOI_Debug_Signal1_29 : 81|8@1+ (0.01,-1) [-1.00|1.55] "" FVCM
 SG_ ExistenceProbability_29 : 89|7@1+ (1,0) [0|127] "%" FVCM
 SG_ AbsLatVeloSTD_29 : 96|9@1+ (0.02,0) [0.00|10.22] "m/s" FVCM
 SG_ ClassificationTypeProbability_29 : 105|7@1+ (1,0) [0|127] "%" FVCM
 SG_ AbsLongAccSTD_29 : 112|9@1+ (0.008,0) [0.000|4.088] "m/s²" FVCM
 SG_ AbsLongVelocitySTD_29 : 121|9@1+ (0.02,0) [0.00|10.22] "m/s" FVCM
 SG_ AbsLatVelocity_29 : 130|12@1+ (0.05,-100) [-100.00|104.75] "m/s" FVCM
 SG_ LengthSTD_29 : 142|7@1+ (0.1,0) [0|12.7] "m" FVCM
 SG_ AbsLatAcc_29 : 149|10@1+ (0.05,-25) [-25.00|26.15] "m/s²" FVCM
 SG_ AbsLongAcc__29 : 159|10@1+ (0.05,-25) [-25.00|26.15] "m/s²" FVCM
 SG_ Width_29 : 169|6@1+ (0.1,0) [0|6.3] "m" FVCM
 SG_ WidthSTD_29 : 175|6@1+ (0.1,0) [0|6.3] "m" FVCM
 SG_ Reserved_PMOI_Debug_Signal2_29 : 181|8@1+ (0.01,-1) [-1.00|1.55] "m/s" FVCM
 SG_ ObjectAge_29 : 189|13@1+ (0.06,0) [0.00|491.46] "s" FVCM
 SG_ Reserved_PMOI_Debug_Signal3_29 : 202|8@1+ (0.01,-1) [-1.00|1.55] "" FVCM
 SG_ Reserved_PMOI_Debug_Signal4_29 : 210|8@1+ (0.01,-1) [-1.00|1.55] "" FVCM
 SG_ LateralDistance_29 : 218|12@1+ (0.05,-100) [-100.00|104.75] "m" FVCM
 SG_ LateralDistanceSTD_29 : 230|9@1+ (0.05,0) [0.00|25.55] "m" FVCM
 SG_ LongitudinalDistanceSTD_29 : 239|9@1+ (0.05,0) [0.00|25.55] "m" FVCM
 SG_ Length_29 : 248|8@1+ (0.1,0) [0|25.5] "m" FVCM
 SG_ Reserved_PMOI_Debug_Signal5_29 : 256|8@1+ (0.01,-1) [-1.00|1.55] "" FVCM
 SG_ Reserved_PMOI_Debug_Signal6_29 : 264|8@1+ (0.01,-1) [-1.00|1.55] "" FVCM
 SG_ RadarCrossSection_29 : 272|7@1+ (1,-60) [-60|67] "dBm²" FVCM
 SG_ Yaw_29 : 279|9@1+ (0.02,-3.142) [-3.142|7.078] "rad" FVCM
 SG_ YawSTD_29 : 288|9@1+ (0.02,0) [0.00|10.22] "rad" FVCM
 SG_ Height_29 : 297|6@1+ (0.1,0) [0|6.3] "m" FVCM
 SG_ HeightSTD_29 : 303|6@1+ (0.1,0) [0|6.3] "m" FVCM

BO_ 516 FDR_Object_3: 64 Vector__XXX
 SG_ OD_Info_CRC_03 : 0|16@1+ (1,0) [0|65535] "" FVCM
 SG_ OD_Info_ALIVE_03 : 16|8@1+ (1,0) [0|255] "" FVCM
 SG_ IsNew_03 : 24|2@1+ (1,0) [0|3] "" FVCM
 SG_ ClassificationType_03 : 26|3@1+ (1,0) [0|7] "" FVCM
 SG_ MeasurementStatus_03 : 29|3@1+ (1,0) [0|7] "" FVCM
 SG_ LongitudinalDistance_03 : 32|13@1+ (0.05,-50) [-50.00|359.55] "m" FVCM
 SG_ MovementStatus_03 : 45|3@1+ (1,0) [0|7] "" FVCM
 SG_ ObjectID_03 : 48|8@1+ (1,0) [0|255] "" FVCM
 SG_ ReferencePoint_03 : 56|4@1+ (1,0) [0|15] "" FVCM
 SG_ AbsLongVelocity_03 : 60|12@1+ (0.05,-100) [-100.00|104.75] "m/s" FVCM
 SG_ AbsLatAccSTD_03 : 72|9@1+ (0.008,0) [0.000|4.088] "m/s²" FVCM
 SG_ Reserved_PMOI_Debug_Signal1_03 : 81|8@1+ (0.01,-1) [-1.00|1.55] "" FVCM
 SG_ ExistenceProbability_03 : 89|7@1+ (1,0) [0|127] "%" FVCM
 SG_ AbsLatVeloSTD_03 : 96|9@1+ (0.02,0) [0.00|10.22] "m/s" FVCM
 SG_ ClassificationTypeProbability_03 : 105|7@1+ (1,0) [0|127] "%" FVCM
 SG_ AbsLongAccSTD_03 : 112|9@1+ (0.008,0) [0.000|4.088] "m/s²" FVCM
 SG_ AbsLongVelocitySTD_03 : 121|9@1+ (0.02,0) [0.00|10.22] "m/s" FVCM
 SG_ AbsLatVelocity_03 : 130|12@1+ (0.05,-100) [-100.00|104.75] "m/s" FVCM
 SG_ LengthSTD_03 : 142|7@1+ (0.1,0) [0|12.7] "m" FVCM
 SG_ AbsLatAcc_03 : 149|10@1+ (0.05,-25) [-25.00|26.15] "m/s²" FVCM
 SG_ AbsLongAcc__03 : 159|10@1+ (0.05,-25) [-25.00|26.15] "m/s²" FVCM
 SG_ Width_03 : 169|6@1+ (0.1,0) [0|6.3] "m" FVCM
 SG_ WidthSTD_03 : 175|6@1+ (0.1,0) [0|6.3] "m" FVCM
 SG_ Reserved_PMOI_Debug_Signal2_03 : 181|8@1+ (0.01,-1) [-1.00|1.55] "m/s" FVCM
 SG_ ObjectAge_03 : 189|13@1+ (0.06,0) [0.00|491.46] "s" FVCM
 SG_ Reserved_PMOI_Debug_Signal3_03 : 202|8@1+ (0.01,-1) [-1.00|1.55] "" FVCM
 SG_ Reserved_PMOI_Debug_Signal4_03 : 210|8@1+ (0.01,-1) [-1.00|1.55] "" FVCM
 SG_ LateralDistance_03 : 218|12@1+ (0.05,-100) [-100.00|104.75] "m" FVCM
 SG_ LateralDistanceSTD_03 : 230|9@1+ (0.05,0) [0.00|25.55] "m" FVCM
 SG_ LongitudinalDistanceSTD_03 : 239|9@1+ (0.05,0) [0.00|25.55] "m" FVCM
 SG_ Length_03 : 248|8@1+ (0.1,0) [0|25.5] "m" FVCM
 SG_ Reserved_PMOI_Debug_Signal5_03 : 256|8@1+ (0.01,-1) [-1.00|1.55] "" FVCM
 SG_ Reserved_PMOI_Debug_Signal6_03 : 264|8@1+ (0.01,-1) [-1.00|1.55] "" FVCM
 SG_ RadarCrossSection_03 : 272|7@1+ (1,-60) [-60|67] "dBm²" FVCM
 SG_ Yaw_03 : 279|9@1+ (0.02,-3.142) [-3.142|7.078] "rad" FVCM
 SG_ YawSTD_03 : 288|9@1+ (0.02,0) [0.00|10.22] "rad" FVCM
 SG_ Height_03 : 297|6@1+ (0.1,0) [0|6.3] "m" FVCM
 SG_ HeightSTD_03 : 303|6@1+ (0.1,0) [0|6.3] "m" FVCM

BO_ 543 FDR_Object_30: 64 Vector__XXX
 SG_ OD_Info_CRC_30 : 0|16@1+ (1,0) [0|65535] "" FVCM
 SG_ OD_Info_ALIVE_30 : 16|8@1+ (1,0) [0|255] "" FVCM
 SG_ IsNew_30 : 24|2@1+ (1,0) [0|3] "" FVCM
 SG_ ClassificationType_30 : 26|3@1+ (1,0) [0|7] "" FVCM
 SG_ MeasurementStatus_30 : 29|3@1+ (1,0) [0|7] "" FVCM
 SG_ LongitudinalDistance_30 : 32|13@1+ (0.05,-50) [-50.00|359.55] "m" FVCM
 SG_ MovementStatus_30 : 45|3@1+ (1,0) [0|7] "" FVCM
 SG_ ObjectID_30 : 48|8@1+ (1,0) [0|255] "" FVCM
 SG_ ReferencePoint_30 : 56|4@1+ (1,0) [0|15] "" FVCM
 SG_ AbsLongVelocity_30 : 60|12@1+ (0.05,-100) [-100.00|104.75] "m/s" FVCM
 SG_ AbsLatAccSTD_30 : 72|9@1+ (0.008,0) [0.000|4.088] "m/s²" FVCM
 SG_ Reserved_PMOI_Debug_Signal1_30 : 81|8@1+ (0.01,-1) [-1.00|1.55] "" FVCM
 SG_ ExistenceProbability_30 : 89|7@1+ (1,0) [0|127] "%" FVCM
 SG_ AbsLatVeloSTD_30 : 96|9@1+ (0.02,0) [0.00|10.22] "m/s" FVCM
 SG_ ClassificationTypeProbability_30 : 105|7@1+ (1,0) [0|127] "%" FVCM
 SG_ AbsLongAccSTD_30 : 112|9@1+ (0.008,0) [0.000|4.088] "m/s²" FVCM
 SG_ AbsLongVelocitySTD_30 : 121|9@1+ (0.02,0) [0.00|10.22] "m/s" FVCM
 SG_ AbsLatVelocity_30 : 130|12@1+ (0.05,-100) [-100.00|104.75] "m/s" FVCM
 SG_ LengthSTD_30 : 142|7@1+ (0.1,0) [0|12.7] "m" FVCM
 SG_ AbsLatAcc_30 : 149|10@1+ (0.05,-25) [-25.00|26.15] "m/s²" FVCM
 SG_ AbsLongAcc__30 : 159|10@1+ (0.05,-25) [-25.00|26.15] "m/s²" FVCM
 SG_ Width_30 : 169|6@1+ (0.1,0) [0|6.3] "m" FVCM
 SG_ WidthSTD_30 : 175|6@1+ (0.1,0) [0|6.3] "m" FVCM
 SG_ Reserved_PMOI_Debug_Signal2_30 : 181|8@1+ (0.01,-1) [-1.00|1.55] "m/s" FVCM
 SG_ ObjectAge_30 : 189|13@1+ (0.06,0) [0.00|491.46] "s" FVCM
 SG_ Reserved_PMOI_Debug_Signal3_30 : 202|8@1+ (0.01,-1) [-1.00|1.55] "" FVCM
 SG_ Reserved_PMOI_Debug_Signal4_30 : 210|8@1+ (0.01,-1) [-1.00|1.55] "" FVCM
 SG_ LateralDistance_30 : 218|12@1+ (0.05,-100) [-100.00|104.75] "m" FVCM
 SG_ LateralDistanceSTD_30 : 230|9@1+ (0.05,0) [0.00|25.55] "m" FVCM
 SG_ LongitudinalDistanceSTD_30 : 239|9@1+ (0.05,0) [0.00|25.55] "m" FVCM
 SG_ Length_30 : 248|8@1+ (0.1,0) [0|25.5] "m" FVCM
 SG_ Reserved_PMOI_Debug_Signal5_30 : 256|8@1+ (0.01,-1) [-1.00|1.55] "" FVCM
 SG_ Reserved_PMOI_Debug_Signal6_30 : 264|8@1+ (0.01,-1) [-1.00|1.55] "" FVCM
 SG_ RadarCrossSection_30 : 272|7@1+ (1,-60) [-60|67] "dBm²" FVCM
 SG_ Yaw_30 : 279|9@1+ (0.02,-3.142) [-3.142|7.078] "rad" FVCM
 SG_ YawSTD_30 : 288|9@1+ (0.02,0) [0.00|10.22] "rad" FVCM
 SG_ Height_30 : 297|6@1+ (0.1,0) [0|6.3] "m" FVCM
 SG_ HeightSTD_30 : 303|6@1+ (0.1,0) [0|6.3] "m" FVCM

BO_ 544 FDR_Object_31: 64 Vector__XXX
 SG_ OD_Info_CRC_31 : 0|16@1+ (1,0) [0|65535] "" FVCM
 SG_ OD_Info_ALIVE_31 : 16|8@1+ (1,0) [0|255] "" FVCM
 SG_ IsNew_31 : 24|2@1+ (1,0) [0|3] "" FVCM
 SG_ ClassificationType_31 : 26|3@1+ (1,0) [0|7] "" FVCM
 SG_ MeasurementStatus_31 : 29|3@1+ (1,0) [0|7] "" FVCM
 SG_ LongitudinalDistance_31 : 32|13@1+ (0.05,-50) [-50.00|359.55] "m" FVCM
 SG_ MovementStatus_31 : 45|3@1+ (1,0) [0|7] "" FVCM
 SG_ ObjectID_31 : 48|8@1+ (1,0) [0|255] "" FVCM
 SG_ ReferencePoint_31 : 56|4@1+ (1,0) [0|15] "" FVCM
 SG_ AbsLongVelocity_31 : 60|12@1+ (0.05,-100) [-100.00|104.75] "m/s" FVCM
 SG_ AbsLatAccSTD_31 : 72|9@1+ (0.008,0) [0.000|4.088] "m/s²" FVCM
 SG_ Reserved_PMOI_Debug_Signal1_31 : 81|8@1+ (0.01,-1) [-1.00|1.55] "" FVCM
 SG_ ExistenceProbability_31 : 89|7@1+ (1,0) [0|127] "%" FVCM
 SG_ AbsLatVeloSTD_31 : 96|9@1+ (0.02,0) [0.00|10.22] "m/s" FVCM
 SG_ ClassificationTypeProbability_31 : 105|7@1+ (1,0) [0|127] "%" FVCM
 SG_ AbsLongAccSTD_31 : 112|9@1+ (0.008,0) [0.000|4.088] "m/s²" FVCM
 SG_ AbsLongVelocitySTD_31 : 121|9@1+ (0.02,0) [0.00|10.22] "m/s" FVCM
 SG_ AbsLatVelocity_31 : 130|12@1+ (0.05,-100) [-100.00|104.75] "m/s" FVCM
 SG_ LengthSTD_31 : 142|7@1+ (0.1,0) [0|12.7] "m" FVCM
 SG_ AbsLatAcc_31 : 149|10@1+ (0.05,-25) [-25.00|26.15] "m/s²" FVCM
 SG_ AbsLongAcc__31 : 159|10@1+ (0.05,-25) [-25.00|26.15] "m/s²" FVCM
 SG_ Width_31 : 169|6@1+ (0.1,0) [0|6.3] "m" FVCM
 SG_ WidthSTD_31 : 175|6@1+ (0.1,0) [0|6.3] "m" FVCM
 SG_ Reserved_PMOI_Debug_Signal2_31 : 181|8@1+ (0.01,-1) [-1.00|1.55] "m/s" FVCM
 SG_ ObjectAge_31 : 189|13@1+ (0.06,0) [0.00|491.46] "s" FVCM
 SG_ Reserved_PMOI_Debug_Signal3_31 : 202|8@1+ (0.01,-1) [-1.00|1.55] "" FVCM
 SG_ Reserved_PMOI_Debug_Signal4_31 : 210|8@1+ (0.01,-1) [-1.00|1.55] "" FVCM
 SG_ LateralDistance_31 : 218|12@1+ (0.05,-100) [-100.00|104.75] "m" FVCM
 SG_ LateralDistanceSTD_31 : 230|9@1+ (0.05,0) [0.00|25.55] "m" FVCM
 SG_ LongitudinalDistanceSTD_31 : 239|9@1+ (0.05,0) [0.00|25.55] "m" FVCM
 SG_ Length_31 : 248|8@1+ (0.1,0) [0|25.5] "m" FVCM
 SG_ Reserved_PMOI_Debug_Signal5_31 : 256|8@1+ (0.01,-1) [-1.00|1.55] "" FVCM
 SG_ Reserved_PMOI_Debug_Signal6_31 : 264|8@1+ (0.01,-1) [-1.00|1.55] "" FVCM
 SG_ RadarCrossSection_31 : 272|7@1+ (1,-60) [-60|67] "dBm²" FVCM
 SG_ Yaw_31 : 279|9@1+ (0.02,-3.142) [-3.142|7.078] "rad" FVCM
 SG_ YawSTD_31 : 288|9@1+ (0.02,0) [0.00|10.22] "rad" FVCM
 SG_ Height_31 : 297|6@1+ (0.1,0) [0|6.3] "m" FVCM
 SG_ HeightSTD_31 : 303|6@1+ (0.1,0) [0|6.3] "m" FVCM

BO_ 545 FDR_Object_32: 64 Vector__XXX
 SG_ OD_Info_CRC_32 : 0|16@1+ (1,0) [0|65535] "" FVCM
 SG_ OD_Info_ALIVE_32 : 16|8@1+ (1,0) [0|255] "" FVCM
 SG_ IsNew_32 : 24|2@1+ (1,0) [0|3] "" FVCM
 SG_ ClassificationType_32 : 26|3@1+ (1,0) [0|7] "" FVCM
 SG_ MeasurementStatus_32 : 29|3@1+ (1,0) [0|7] "" FVCM
 SG_ LongitudinalDistance_32 : 32|13@1+ (0.05,-50) [-50.00|359.55] "m" FVCM
 SG_ MovementStatus_32 : 45|3@1+ (1,0) [0|7] "" FVCM
 SG_ ObjectID_32 : 48|8@1+ (1,0) [0|255] "" FVCM
 SG_ ReferencePoint_32 : 56|4@1+ (1,0) [0|15] "" FVCM
 SG_ AbsLongVelocity_32 : 60|12@1+ (0.05,-100) [-100.00|104.75] "m/s" FVCM
 SG_ AbsLatAccSTD_32 : 72|9@1+ (0.008,0) [0.000|4.088] "m/s²" FVCM
 SG_ Reserved_PMOI_Debug_Signal1_32 : 81|8@1+ (0.01,-1) [-1.00|1.55] "" FVCM
 SG_ ExistenceProbability_32 : 89|7@1+ (1,0) [0|127] "%" FVCM
 SG_ AbsLatVeloSTD_32 : 96|9@1+ (0.02,0) [0.00|10.22] "m/s" FVCM
 SG_ ClassificationTypeProbability_32 : 105|7@1+ (1,0) [0|127] "%" FVCM
 SG_ AbsLongAccSTD_32 : 112|9@1+ (0.008,0) [0.000|4.088] "m/s²" FVCM
 SG_ AbsLongVelocitySTD_32 : 121|9@1+ (0.02,0) [0.00|10.22] "m/s" FVCM
 SG_ AbsLatVelocity_32 : 130|12@1+ (0.05,-100) [-100.00|104.75] "m/s" FVCM
 SG_ LengthSTD_32 : 142|7@1+ (0.1,0) [0|12.7] "m" FVCM
 SG_ AbsLatAcc_32 : 149|10@1+ (0.05,-25) [-25.00|26.15] "m/s²" FVCM
 SG_ AbsLongAcc__32 : 159|10@1+ (0.05,-25) [-25.00|26.15] "m/s²" FVCM
 SG_ Width_32 : 169|6@1+ (0.1,0) [0|6.3] "m" FVCM
 SG_ WidthSTD_32 : 175|6@1+ (0.1,0) [0|6.3] "m" FVCM
 SG_ Reserved_PMOI_Debug_Signal2_32 : 181|8@1+ (0.01,-1) [-1.00|1.55] "m/s" FVCM
 SG_ ObjectAge_32 : 189|13@1+ (0.06,0) [0.00|491.46] "s" FVCM
 SG_ Reserved_PMOI_Debug_Signal3_32 : 202|8@1+ (0.01,-1) [-1.00|1.55] "" FVCM
 SG_ Reserved_PMOI_Debug_Signal4_32 : 210|8@1+ (0.01,-1) [-1.00|1.55] "" FVCM
 SG_ LateralDistance_32 : 218|12@1+ (0.05,-100) [-100.00|104.75] "m" FVCM
 SG_ LateralDistanceSTD_32 : 230|9@1+ (0.05,0) [0.00|25.55] "m" FVCM
 SG_ LongitudinalDistanceSTD_32 : 239|9@1+ (0.05,0) [0.00|25.55] "m" FVCM
 SG_ Length_32 : 248|8@1+ (0.1,0) [0|25.5] "m" FVCM
 SG_ Reserved_PMOI_Debug_Signal5_32 : 256|8@1+ (0.01,-1) [-1.00|1.55] "" FVCM
 SG_ Reserved_PMOI_Debug_Signal6_32 : 264|8@1+ (0.01,-1) [-1.00|1.55] "" FVCM
 SG_ RadarCrossSection_32 : 272|7@1+ (1,-60) [-60|67] "dBm²" FVCM
 SG_ Yaw_32 : 279|9@1+ (0.02,-3.142) [-3.142|7.078] "rad" FVCM
 SG_ YawSTD_32 : 288|9@1+ (0.02,0) [0.00|10.22] "rad" FVCM
 SG_ Height_32 : 297|6@1+ (0.1,0) [0|6.3] "m" FVCM
 SG_ HeightSTD_32 : 303|6@1+ (0.1,0) [0|6.3] "m" FVCM

BO_ 546 FDR_Object_33: 64 Vector__XXX
 SG_ OD_Info_CRC_33 : 0|16@1+ (1,0) [0|65535] "" FVCM
 SG_ OD_Info_ALIVE_33 : 16|8@1+ (1,0) [0|255] "" FVCM
 SG_ IsNew_33 : 24|2@1+ (1,0) [0|3] "" FVCM
 SG_ ClassificationType_33 : 26|3@1+ (1,0) [0|7] "" FVCM
 SG_ MeasurementStatus_33 : 29|3@1+ (1,0) [0|7] "" FVCM
 SG_ LongitudinalDistance_33 : 32|13@1+ (0.05,-50) [-50.00|359.55] "m" FVCM
 SG_ MovementStatus_33 : 45|3@1+ (1,0) [0|7] "" FVCM
 SG_ ObjectID_33 : 48|8@1+ (1,0) [0|255] "" FVCM
 SG_ ReferencePoint_33 : 56|4@1+ (1,0) [0|15] "" FVCM
 SG_ AbsLongVelocity_33 : 60|12@1+ (0.05,-100) [-100.00|104.75] "m/s" FVCM
 SG_ AbsLatAccSTD_33 : 72|9@1+ (0.008,0) [0.000|4.088] "m/s²" FVCM
 SG_ Reserved_PMOI_Debug_Signal1_33 : 81|8@1+ (0.01,-1) [-1.00|1.55] "" FVCM
 SG_ ExistenceProbability_33 : 89|7@1+ (1,0) [0|127] "%" FVCM
 SG_ AbsLatVeloSTD_33 : 96|9@1+ (0.02,0) [0.00|10.22] "m/s" FVCM
 SG_ ClassificationTypeProbability_33 : 105|7@1+ (1,0) [0|127] "%" FVCM
 SG_ AbsLongAccSTD_33 : 112|9@1+ (0.008,0) [0.000|4.088] "m/s²" FVCM
 SG_ AbsLongVelocitySTD_33 : 121|9@1+ (0.02,0) [0.00|10.22] "m/s" FVCM
 SG_ AbsLatVelocity_33 : 130|12@1+ (0.05,-100) [-100.00|104.75] "m/s" FVCM
 SG_ LengthSTD_33 : 142|7@1+ (0.1,0) [0|12.7] "m" FVCM
 SG_ AbsLatAcc_33 : 149|10@1+ (0.05,-25) [-25.00|26.15] "m/s²" FVCM
 SG_ AbsLongAcc__33 : 159|10@1+ (0.05,-25) [-25.00|26.15] "m/s²" FVCM
 SG_ Width_33 : 169|6@1+ (0.1,0) [0|6.3] "m" FVCM
 SG_ WidthSTD_33 : 175|6@1+ (0.1,0) [0|6.3] "m" FVCM
 SG_ Reserved_PMOI_Debug_Signal2_33 : 181|8@1+ (0.01,-1) [-1.00|1.55] "m/s" FVCM
 SG_ ObjectAge_33 : 189|13@1+ (0.06,0) [0.00|491.46] "s" FVCM
 SG_ Reserved_PMOI_Debug_Signal3_33 : 202|8@1+ (0.01,-1) [-1.00|1.55] "" FVCM
 SG_ Reserved_PMOI_Debug_Signal4_33 : 210|8@1+ (0.01,-1) [-1.00|1.55] "" FVCM
 SG_ LateralDistance_33 : 218|12@1+ (0.05,-100) [-100.00|104.75] "m" FVCM
 SG_ LateralDistanceSTD_33 : 230|9@1+ (0.05,0) [0.00|25.55] "m" FVCM
 SG_ LongitudinalDistanceSTD_33 : 239|9@1+ (0.05,0) [0.00|25.55] "m" FVCM
 SG_ Length_33 : 248|8@1+ (0.1,0) [0|25.5] "m" FVCM
 SG_ Reserved_PMOI_Debug_Signal5_33 : 256|8@1+ (0.01,-1) [-1.00|1.55] "" FVCM
 SG_ Reserved_PMOI_Debug_Signal6_33 : 264|8@1+ (0.01,-1) [-1.00|1.55] "" FVCM
 SG_ RadarCrossSection_33 : 272|7@1+ (1,-60) [-60|67] "dBm²" FVCM
 SG_ Yaw_33 : 279|9@1+ (0.02,-3.142) [-3.142|7.078] "rad" FVCM
 SG_ YawSTD_33 : 288|9@1+ (0.02,0) [0.00|10.22] "rad" FVCM
 SG_ Height_33 : 297|6@1+ (0.1,0) [0|6.3] "m" FVCM
 SG_ HeightSTD_33 : 303|6@1+ (0.1,0) [0|6.3] "m" FVCM

BO_ 547 FDR_Object_34: 64 Vector__XXX
 SG_ OD_Info_CRC_34 : 0|16@1+ (1,0) [0|65535] "" FVCM
 SG_ OD_Info_ALIVE_34 : 16|8@1+ (1,0) [0|255] "" FVCM
 SG_ IsNew_34 : 24|2@1+ (1,0) [0|3] "" FVCM
 SG_ ClassificationType_34 : 26|3@1+ (1,0) [0|7] "" FVCM
 SG_ MeasurementStatus_34 : 29|3@1+ (1,0) [0|7] "" FVCM
 SG_ LongitudinalDistance_34 : 32|13@1+ (0.05,-50) [-50.00|359.55] "m" FVCM
 SG_ MovementStatus_34 : 45|3@1+ (1,0) [0|7] "" FVCM
 SG_ ObjectID_34 : 48|8@1+ (1,0) [0|255] "" FVCM
 SG_ ReferencePoint_34 : 56|4@1+ (1,0) [0|15] "" FVCM
 SG_ AbsLongVelocity_34 : 60|12@1+ (0.05,-100) [-100.00|104.75] "m/s" FVCM
 SG_ AbsLatAccSTD_34 : 72|9@1+ (0.008,0) [0.000|4.088] "m/s²" FVCM
 SG_ Reserved_PMOI_Debug_Signal1_34 : 81|8@1+ (0.01,-1) [-1.00|1.55] "" FVCM
 SG_ ExistenceProbability_34 : 89|7@1+ (1,0) [0|127] "%" FVCM
 SG_ AbsLatVeloSTD_34 : 96|9@1+ (0.02,0) [0.00|10.22] "m/s" FVCM
 SG_ ClassificationTypeProbability_34 : 105|7@1+ (1,0) [0|127] "%" FVCM
 SG_ AbsLongAccSTD_34 : 112|9@1+ (0.008,0) [0.000|4.088] "m/s²" FVCM
 SG_ AbsLongVelocitySTD_34 : 121|9@1+ (0.02,0) [0.00|10.22] "m/s" FVCM
 SG_ AbsLatVelocity_34 : 130|12@1+ (0.05,-100) [-100.00|104.75] "m/s" FVCM
 SG_ LengthSTD_34 : 142|7@1+ (0.1,0) [0|12.7] "m" FVCM
 SG_ AbsLatAcc_34 : 149|10@1+ (0.05,-25) [-25.00|26.15] "m/s²" FVCM
 SG_ AbsLongAcc__34 : 159|10@1+ (0.05,-25) [-25.00|26.15] "m/s²" FVCM
 SG_ Width_34 : 169|6@1+ (0.1,0) [0|6.3] "m" FVCM
 SG_ WidthSTD_34 : 175|6@1+ (0.1,0) [0|6.3] "m" FVCM
 SG_ Reserved_PMOI_Debug_Signal2_34 : 181|8@1+ (0.01,-1) [-1.00|1.55] "m/s" FVCM
 SG_ ObjectAge_34 : 189|13@1+ (0.06,0) [0.00|491.46] "s" FVCM
 SG_ Reserved_PMOI_Debug_Signal3_34 : 202|8@1+ (0.01,-1) [-1.00|1.55] "" FVCM
 SG_ Reserved_PMOI_Debug_Signal4_34 : 210|8@1+ (0.01,-1) [-1.00|1.55] "" FVCM
 SG_ LateralDistance_34 : 218|12@1+ (0.05,-100) [-100.00|104.75] "m" FVCM
 SG_ LateralDistanceSTD_34 : 230|9@1+ (0.05,0) [0.00|25.55] "m" FVCM
 SG_ LongitudinalDistanceSTD_34 : 239|9@1+ (0.05,0) [0.00|25.55] "m" FVCM
 SG_ Length_34 : 248|8@1+ (0.1,0) [0|25.5] "m" FVCM
 SG_ Reserved_PMOI_Debug_Signal5_34 : 256|8@1+ (0.01,-1) [-1.00|1.55] "" FVCM
 SG_ Reserved_PMOI_Debug_Signal6_34 : 264|8@1+ (0.01,-1) [-1.00|1.55] "" FVCM
 SG_ RadarCrossSection_34 : 272|7@1+ (1,-60) [-60|67] "dBm²" FVCM
 SG_ Yaw_34 : 279|9@1+ (0.02,-3.142) [-3.142|7.078] "rad" FVCM
 SG_ YawSTD_34 : 288|9@1+ (0.02,0) [0.00|10.22] "rad" FVCM
 SG_ Height_34 : 297|6@1+ (0.1,0) [0|6.3] "m" FVCM
 SG_ HeightSTD_34 : 303|6@1+ (0.1,0) [0|6.3] "m" FVCM

BO_ 548 FDR_Object_35: 64 Vector__XXX
 SG_ OD_Info_CRC_35 : 0|16@1+ (1,0) [0|65535] "" FVCM
 SG_ OD_Info_ALIVE_35 : 16|8@1+ (1,0) [0|255] "" FVCM
 SG_ IsNew_35 : 24|2@1+ (1,0) [0|3] "" FVCM
 SG_ ClassificationType_35 : 26|3@1+ (1,0) [0|7] "" FVCM
 SG_ MeasurementStatus_35 : 29|3@1+ (1,0) [0|7] "" FVCM
 SG_ LongitudinalDistance_35 : 32|13@1+ (0.05,-50) [-50.00|359.55] "m" FVCM
 SG_ MovementStatus_35 : 45|3@1+ (1,0) [0|7] "" FVCM
 SG_ ObjectID_35 : 48|8@1+ (1,0) [0|255] "" FVCM
 SG_ ReferencePoint_35 : 56|4@1+ (1,0) [0|15] "" FVCM
 SG_ AbsLongVelocity_35 : 60|12@1+ (0.05,-100) [-100.00|104.75] "m/s" FVCM
 SG_ AbsLatAccSTD_35 : 72|9@1+ (0.008,0) [0.000|4.088] "m/s²" FVCM
 SG_ Reserved_PMOI_Debug_Signal1_35 : 81|8@1+ (0.01,-1) [-1.00|1.55] "" FVCM
 SG_ ExistenceProbability_35 : 89|7@1+ (1,0) [0|127] "%" FVCM
 SG_ AbsLatVeloSTD_35 : 96|9@1+ (0.02,0) [0.00|10.22] "m/s" FVCM
 SG_ ClassificationTypeProbability_35 : 105|7@1+ (1,0) [0|127] "%" FVCM
 SG_ AbsLongAccSTD_35 : 112|9@1+ (0.008,0) [0.000|4.088] "m/s²" FVCM
 SG_ AbsLongVelocitySTD_35 : 121|9@1+ (0.02,0) [0.00|10.22] "m/s" FVCM
 SG_ AbsLatVelocity_35 : 130|12@1+ (0.05,-100) [-100.00|104.75] "m/s" FVCM
 SG_ LengthSTD_35 : 142|7@1+ (0.1,0) [0|12.7] "m" FVCM
 SG_ AbsLatAcc_35 : 149|10@1+ (0.05,-25) [-25.00|26.15] "m/s²" FVCM
 SG_ AbsLongAcc__35 : 159|10@1+ (0.05,-25) [-25.00|26.15] "m/s²" FVCM
 SG_ Width_35 : 169|6@1+ (0.1,0) [0|6.3] "m" FVCM
 SG_ WidthSTD_35 : 175|6@1+ (0.1,0) [0|6.3] "m" FVCM
 SG_ Reserved_PMOI_Debug_Signal2_35 : 181|8@1+ (0.01,-1) [-1.00|1.55] "m/s" FVCM
 SG_ ObjectAge_35 : 189|13@1+ (0.06,0) [0.00|491.46] "s" FVCM
 SG_ Reserved_PMOI_Debug_Signal3_35 : 202|8@1+ (0.01,-1) [-1.00|1.55] "" FVCM
 SG_ Reserved_PMOI_Debug_Signal4_35 : 210|8@1+ (0.01,-1) [-1.00|1.55] "" FVCM
 SG_ LateralDistance_35 : 218|12@1+ (0.05,-100) [-100.00|104.75] "m" FVCM
 SG_ LateralDistanceSTD_35 : 230|9@1+ (0.05,0) [0.00|25.55] "m" FVCM
 SG_ LongitudinalDistanceSTD_35 : 239|9@1+ (0.05,0) [0.00|25.55] "m" FVCM
 SG_ Length_35 : 248|8@1+ (0.1,0) [0|25.5] "m" FVCM
 SG_ Reserved_PMOI_Debug_Signal5_35 : 256|8@1+ (0.01,-1) [-1.00|1.55] "" FVCM
 SG_ Reserved_PMOI_Debug_Signal6_35 : 264|8@1+ (0.01,-1) [-1.00|1.55] "" FVCM
 SG_ RadarCrossSection_35 : 272|7@1+ (1,-60) [-60|67] "dBm²" FVCM
 SG_ Yaw_35 : 279|9@1+ (0.02,-3.142) [-3.142|7.078] "rad" FVCM
 SG_ YawSTD_35 : 288|9@1+ (0.02,0) [0.00|10.22] "rad" FVCM
 SG_ Height_35 : 297|6@1+ (0.1,0) [0|6.3] "m" FVCM
 SG_ HeightSTD_35 : 303|6@1+ (0.1,0) [0|6.3] "m" FVCM

BO_ 549 FDR_Object_36: 64 Vector__XXX
 SG_ OD_Info_CRC_36 : 0|16@1+ (1,0) [0|65535] "" FVCM
 SG_ OD_Info_ALIVE_36 : 16|8@1+ (1,0) [0|255] "" FVCM
 SG_ IsNew_36 : 24|2@1+ (1,0) [0|3] "" FVCM
 SG_ ClassificationType_36 : 26|3@1+ (1,0) [0|7] "" FVCM
 SG_ MeasurementStatus_36 : 29|3@1+ (1,0) [0|7] "" FVCM
 SG_ LongitudinalDistance_36 : 32|13@1+ (0.05,-50) [-50.00|359.55] "m" FVCM
 SG_ MovementStatus_36 : 45|3@1+ (1,0) [0|7] "" FVCM
 SG_ ObjectID_36 : 48|8@1+ (1,0) [0|255] "" FVCM
 SG_ ReferencePoint_36 : 56|4@1+ (1,0) [0|15] "" FVCM
 SG_ AbsLongVelocity_36 : 60|12@1+ (0.05,-100) [-100.00|104.75] "m/s" FVCM
 SG_ AbsLatAccSTD_36 : 72|9@1+ (0.008,0) [0.000|4.088] "m/s²" FVCM
 SG_ Reserved_PMOI_Debug_Signal1_36 : 81|8@1+ (0.01,-1) [-1.00|1.55] "" FVCM
 SG_ ExistenceProbability_36 : 89|7@1+ (1,0) [0|127] "%" FVCM
 SG_ AbsLatVeloSTD_36 : 96|9@1+ (0.02,0) [0.00|10.22] "m/s" FVCM
 SG_ ClassificationTypeProbability_36 : 105|7@1+ (1,0) [0|127] "%" FVCM
 SG_ AbsLongAccSTD_36 : 112|9@1+ (0.008,0) [0.000|4.088] "m/s²" FVCM
 SG_ AbsLongVelocitySTD_36 : 121|9@1+ (0.02,0) [0.00|10.22] "m/s" FVCM
 SG_ AbsLatVelocity_36 : 130|12@1+ (0.05,-100) [-100.00|104.75] "m/s" FVCM
 SG_ LengthSTD_36 : 142|7@1+ (0.1,0) [0|12.7] "m" FVCM
 SG_ AbsLatAcc_36 : 149|10@1+ (0.05,-25) [-25.00|26.15] "m/s²" FVCM
 SG_ AbsLongAcc__36 : 159|10@1+ (0.05,-25) [-25.00|26.15] "m/s²" FVCM
 SG_ Width_36 : 169|6@1+ (0.1,0) [0|6.3] "m" FVCM
 SG_ WidthSTD_36 : 175|6@1+ (0.1,0) [0|6.3] "m" FVCM
 SG_ Reserved_PMOI_Debug_Signal2_36 : 181|8@1+ (0.01,-1) [-1.00|1.55] "m/s" FVCM
 SG_ ObjectAge_36 : 189|13@1+ (0.06,0) [0.00|491.46] "s" FVCM
 SG_ Reserved_PMOI_Debug_Signal3_36 : 202|8@1+ (0.01,-1) [-1.00|1.55] "" FVCM
 SG_ Reserved_PMOI_Debug_Signal4_36 : 210|8@1+ (0.01,-1) [-1.00|1.55] "" FVCM
 SG_ LateralDistance_36 : 218|12@1+ (0.05,-100) [-100.00|104.75] "m" FVCM
 SG_ LateralDistanceSTD_36 : 230|9@1+ (0.05,0) [0.00|25.55] "m" FVCM
 SG_ LongitudinalDistanceSTD_36 : 239|9@1+ (0.05,0) [0.00|25.55] "m" FVCM
 SG_ Length_36 : 248|8@1+ (0.1,0) [0|25.5] "m" FVCM
 SG_ Reserved_PMOI_Debug_Signal5_36 : 256|8@1+ (0.01,-1) [-1.00|1.55] "" FVCM
 SG_ Reserved_PMOI_Debug_Signal6_36 : 264|8@1+ (0.01,-1) [-1.00|1.55] "" FVCM
 SG_ RadarCrossSection_36 : 272|7@1+ (1,-60) [-60|67] "dBm²" FVCM
 SG_ Yaw_36 : 279|9@1+ (0.02,-3.142) [-3.142|7.078] "rad" FVCM
 SG_ YawSTD_36 : 288|9@1+ (0.02,0) [0.00|10.22] "rad" FVCM
 SG_ Height_36 : 297|6@1+ (0.1,0) [0|6.3] "m" FVCM
 SG_ HeightSTD_36 : 303|6@1+ (0.1,0) [0|6.3] "m" FVCM

BO_ 550 FDR_Object_37: 64 Vector__XXX
 SG_ OD_Info_CRC_37 : 0|16@1+ (1,0) [0|65535] "" FVCM
 SG_ OD_Info_ALIVE_37 : 16|8@1+ (1,0) [0|255] "" FVCM
 SG_ IsNew_37 : 24|2@1+ (1,0) [0|3] "" FVCM
 SG_ ClassificationType_37 : 26|3@1+ (1,0) [0|7] "" FVCM
 SG_ MeasurementStatus_37 : 29|3@1+ (1,0) [0|7] "" FVCM
 SG_ LongitudinalDistance_37 : 32|13@1+ (0.05,-50) [-50.00|359.55] "m" FVCM
 SG_ MovementStatus_37 : 45|3@1+ (1,0) [0|7] "" FVCM
 SG_ ObjectID_37 : 48|8@1+ (1,0) [0|255] "" FVCM
 SG_ ReferencePoint_37 : 56|4@1+ (1,0) [0|15] "" FVCM
 SG_ AbsLongVelocity_37 : 60|12@1+ (0.05,-100) [-100.00|104.75] "m/s" FVCM
 SG_ AbsLatAccSTD_37 : 72|9@1+ (0.008,0) [0.000|4.088] "m/s²" FVCM
 SG_ Reserved_PMOI_Debug_Signal1_37 : 81|8@1+ (0.01,-1) [-1.00|1.55] "" FVCM
 SG_ ExistenceProbability_37 : 89|7@1+ (1,0) [0|127] "%" FVCM
 SG_ AbsLatVeloSTD_37 : 96|9@1+ (0.02,0) [0.00|10.22] "m/s" FVCM
 SG_ ClassificationTypeProbability_37 : 105|7@1+ (1,0) [0|127] "%" FVCM
 SG_ AbsLongAccSTD_37 : 112|9@1+ (0.008,0) [0.000|4.088] "m/s²" FVCM
 SG_ AbsLongVelocitySTD_37 : 121|9@1+ (0.02,0) [0.00|10.22] "m/s" FVCM
 SG_ AbsLatVelocity_37 : 130|12@1+ (0.05,-100) [-100.00|104.75] "m/s" FVCM
 SG_ LengthSTD_37 : 142|7@1+ (0.1,0) [0|12.7] "m" FVCM
 SG_ AbsLatAcc_37 : 149|10@1+ (0.05,-25) [-25.00|26.15] "m/s²" FVCM
 SG_ AbsLongAcc__37 : 159|10@1+ (0.05,-25) [-25.00|26.15] "m/s²" FVCM
 SG_ Width_37 : 169|6@1+ (0.1,0) [0|6.3] "m" FVCM
 SG_ WidthSTD_37 : 175|6@1+ (0.1,0) [0|6.3] "m" FVCM
 SG_ Reserved_PMOI_Debug_Signal2_37 : 181|8@1+ (0.01,-1) [-1.00|1.55] "m/s" FVCM
 SG_ ObjectAge_37 : 189|13@1+ (0.06,0) [0.00|491.46] "s" FVCM
 SG_ Reserved_PMOI_Debug_Signal3_37 : 202|8@1+ (0.01,-1) [-1.00|1.55] "" FVCM
 SG_ Reserved_PMOI_Debug_Signal4_37 : 210|8@1+ (0.01,-1) [-1.00|1.55] "" FVCM
 SG_ LateralDistance_37 : 218|12@1+ (0.05,-100) [-100.00|104.75] "m" FVCM
 SG_ LateralDistanceSTD_37 : 230|9@1+ (0.05,0) [0.00|25.55] "m" FVCM
 SG_ LongitudinalDistanceSTD_37 : 239|9@1+ (0.05,0) [0.00|25.55] "m" FVCM
 SG_ Length_37 : 248|8@1+ (0.1,0) [0|25.5] "m" FVCM
 SG_ Reserved_PMOI_Debug_Signal5_37 : 256|8@1+ (0.01,-1) [-1.00|1.55] "" FVCM
 SG_ Reserved_PMOI_Debug_Signal6_37 : 264|8@1+ (0.01,-1) [-1.00|1.55] "" FVCM
 SG_ RadarCrossSection_37 : 272|7@1+ (1,-60) [-60|67] "dBm²" FVCM
 SG_ Yaw_37 : 279|9@1+ (0.02,-3.142) [-3.142|7.078] "rad" FVCM
 SG_ YawSTD_37 : 288|9@1+ (0.02,0) [0.00|10.22] "rad" FVCM
 SG_ Height_37 : 297|6@1+ (0.1,0) [0|6.3] "m" FVCM
 SG_ HeightSTD_37 : 303|6@1+ (0.1,0) [0|6.3] "m" FVCM

BO_ 551 FDR_Object_38: 64 Vector__XXX
 SG_ OD_Info_CRC_38 : 0|16@1+ (1,0) [0|65535] "" FVCM
 SG_ OD_Info_ALIVE_38 : 16|8@1+ (1,0) [0|255] "" FVCM
 SG_ IsNew_38 : 24|2@1+ (1,0) [0|3] "" FVCM
 SG_ ClassificationType_38 : 26|3@1+ (1,0) [0|7] "" FVCM
 SG_ MeasurementStatus_38 : 29|3@1+ (1,0) [0|7] "" FVCM
 SG_ LongitudinalDistance_38 : 32|13@1+ (0.05,-50) [-50.00|359.55] "m" FVCM
 SG_ MovementStatus_38 : 45|3@1+ (1,0) [0|7] "" FVCM
 SG_ ObjectID_38 : 48|8@1+ (1,0) [0|255] "" FVCM
 SG_ ReferencePoint_38 : 56|4@1+ (1,0) [0|15] "" FVCM
 SG_ AbsLongVelocity_38 : 60|12@1+ (0.05,-100) [-100.00|104.75] "m/s" FVCM
 SG_ AbsLatAccSTD_38 : 72|9@1+ (0.008,0) [0.000|4.088] "m/s²" FVCM
 SG_ Reserved_PMOI_Debug_Signal1_38 : 81|8@1+ (0.01,-1) [-1.00|1.55] "" FVCM
 SG_ ExistenceProbability_38 : 89|7@1+ (1,0) [0|127] "%" FVCM
 SG_ AbsLatVeloSTD_38 : 96|9@1+ (0.02,0) [0.00|10.22] "m/s" FVCM
 SG_ ClassificationTypeProbability_38 : 105|7@1+ (1,0) [0|127] "%" FVCM
 SG_ AbsLongAccSTD_38 : 112|9@1+ (0.008,0) [0.000|4.088] "m/s²" FVCM
 SG_ AbsLongVelocitySTD_38 : 121|9@1+ (0.02,0) [0.00|10.22] "m/s" FVCM
 SG_ AbsLatVelocity_38 : 130|12@1+ (0.05,-100) [-100.00|104.75] "m/s" FVCM
 SG_ LengthSTD_38 : 142|7@1+ (0.1,0) [0|12.7] "m" FVCM
 SG_ AbsLatAcc_38 : 149|10@1+ (0.05,-25) [-25.00|26.15] "m/s²" FVCM
 SG_ AbsLongAcc__38 : 159|10@1+ (0.05,-25) [-25.00|26.15] "m/s²" FVCM
 SG_ Width_38 : 169|6@1+ (0.1,0) [0|6.3] "m" FVCM
 SG_ WidthSTD_38 : 175|6@1+ (0.1,0) [0|6.3] "m" FVCM
 SG_ Reserved_PMOI_Debug_Signal2_38 : 181|8@1+ (0.01,-1) [-1.00|1.55] "m/s" FVCM
 SG_ ObjectAge_38 : 189|13@1+ (0.06,0) [0.00|491.46] "s" FVCM
 SG_ Reserved_PMOI_Debug_Signal3_38 : 202|8@1+ (0.01,-1) [-1.00|1.55] "" FVCM
 SG_ Reserved_PMOI_Debug_Signal4_38 : 210|8@1+ (0.01,-1) [-1.00|1.55] "" FVCM
 SG_ LateralDistance_38 : 218|12@1+ (0.05,-100) [-100.00|104.75] "m" FVCM
 SG_ LateralDistanceSTD_38 : 230|9@1+ (0.05,0) [0.00|25.55] "m" FVCM
 SG_ LongitudinalDistanceSTD_38 : 239|9@1+ (0.05,0) [0.00|25.55] "m" FVCM
 SG_ Length_38 : 248|8@1+ (0.1,0) [0|25.5] "m" FVCM
 SG_ Reserved_PMOI_Debug_Signal5_38 : 256|8@1+ (0.01,-1) [-1.00|1.55] "" FVCM
 SG_ Reserved_PMOI_Debug_Signal6_38 : 264|8@1+ (0.01,-1) [-1.00|1.55] "" FVCM
 SG_ RadarCrossSection_38 : 272|7@1+ (1,-60) [-60|67] "dBm²" FVCM
 SG_ Yaw_38 : 279|9@1+ (0.02,-3.142) [-3.142|7.078] "rad" FVCM
 SG_ YawSTD_38 : 288|9@1+ (0.02,0) [0.00|10.22] "rad" FVCM
 SG_ Height_38 : 297|6@1+ (0.1,0) [0|6.3] "m" FVCM
 SG_ HeightSTD_38 : 303|6@1+ (0.1,0) [0|6.3] "m" FVCM

BO_ 552 FDR_Object_39: 64 Vector__XXX
 SG_ OD_Info_CRC_39 : 0|16@1+ (1,0) [0|65535] "" FVCM
 SG_ OD_Info_ALIVE_39 : 16|8@1+ (1,0) [0|255] "" FVCM
 SG_ IsNew_39 : 24|2@1+ (1,0) [0|3] "" FVCM
 SG_ ClassificationType_39 : 26|3@1+ (1,0) [0|7] "" FVCM
 SG_ MeasurementStatus_39 : 29|3@1+ (1,0) [0|7] "" FVCM
 SG_ LongitudinalDistance_39 : 32|13@1+ (0.05,-50) [-50.00|359.55] "m" FVCM
 SG_ MovementStatus_39 : 45|3@1+ (1,0) [0|7] "" FVCM
 SG_ ObjectID_39 : 48|8@1+ (1,0) [0|255] "" FVCM
 SG_ ReferencePoint_39 : 56|4@1+ (1,0) [0|15] "" FVCM
 SG_ AbsLongVelocity_39 : 60|12@1+ (0.05,-100) [-100.00|104.75] "m/s" FVCM
 SG_ AbsLatAccSTD_39 : 72|9@1+ (0.008,0) [0.000|4.088] "m/s²" FVCM
 SG_ Reserved_PMOI_Debug_Signal1_39 : 81|8@1+ (0.01,-1) [-1.00|1.55] "" FVCM
 SG_ ExistenceProbability_39 : 89|7@1+ (1,0) [0|127] "%" FVCM
 SG_ AbsLatVeloSTD_39 : 96|9@1+ (0.02,0) [0.00|10.22] "m/s" FVCM
 SG_ ClassificationTypeProbability_39 : 105|7@1+ (1,0) [0|127] "%" FVCM
 SG_ AbsLongAccSTD_39 : 112|9@1+ (0.008,0) [0.000|4.088] "m/s²" FVCM
 SG_ AbsLongVelocitySTD_39 : 121|9@1+ (0.02,0) [0.00|10.22] "m/s" FVCM
 SG_ AbsLatVelocity_39 : 130|12@1+ (0.05,-100) [-100.00|104.75] "m/s" FVCM
 SG_ LengthSTD_39 : 142|7@1+ (0.1,0) [0|12.7] "m" FVCM
 SG_ AbsLatAcc_39 : 149|10@1+ (0.05,-25) [-25.00|26.15] "m/s²" FVCM
 SG_ AbsLongAcc__39 : 159|10@1+ (0.05,-25) [-25.00|26.15] "m/s²" FVCM
 SG_ Width_39 : 169|6@1+ (0.1,0) [0|6.3] "m" FVCM
 SG_ WidthSTD_39 : 175|6@1+ (0.1,0) [0|6.3] "m" FVCM
 SG_ Reserved_PMOI_Debug_Signal2_39 : 181|8@1+ (0.01,-1) [-1.00|1.55] "m/s" FVCM
 SG_ ObjectAge_39 : 189|13@1+ (0.06,0) [0.00|491.46] "s" FVCM
 SG_ Reserved_PMOI_Debug_Signal3_39 : 202|8@1+ (0.01,-1) [-1.00|1.55] "" FVCM
 SG_ Reserved_PMOI_Debug_Signal4_39 : 210|8@1+ (0.01,-1) [-1.00|1.55] "" FVCM
 SG_ LateralDistance_39 : 218|12@1+ (0.05,-100) [-100.00|104.75] "m" FVCM
 SG_ LateralDistanceSTD_39 : 230|9@1+ (0.05,0) [0.00|25.55] "m" FVCM
 SG_ LongitudinalDistanceSTD_39 : 239|9@1+ (0.05,0) [0.00|25.55] "m" FVCM
 SG_ Length_39 : 248|8@1+ (0.1,0) [0|25.5] "m" FVCM
 SG_ Reserved_PMOI_Debug_Signal5_39 : 256|8@1+ (0.01,-1) [-1.00|1.55] "" FVCM
 SG_ Reserved_PMOI_Debug_Signal6_39 : 264|8@1+ (0.01,-1) [-1.00|1.55] "" FVCM
 SG_ RadarCrossSection_39 : 272|7@1+ (1,-60) [-60|67] "dBm²" FVCM
 SG_ Yaw_39 : 279|9@1+ (0.02,-3.142) [-3.142|7.078] "rad" FVCM
 SG_ YawSTD_39 : 288|9@1+ (0.02,0) [0.00|10.22] "rad" FVCM
 SG_ Height_39 : 297|6@1+ (0.1,0) [0|6.3] "m" FVCM
 SG_ HeightSTD_39 : 303|6@1+ (0.1,0) [0|6.3] "m" FVCM

BO_ 517 FDR_Object_4: 64 Vector__XXX
 SG_ OD_Info_CRC_04 : 0|16@1+ (1,0) [0|65535] "" FVCM
 SG_ OD_Info_ALIVE_04 : 16|8@1+ (1,0) [0|255] "" FVCM
 SG_ IsNew_04 : 24|2@1+ (1,0) [0|3] "" FVCM
 SG_ ClassificationType_04 : 26|3@1+ (1,0) [0|7] "" FVCM
 SG_ MeasurementStatus_04 : 29|3@1+ (1,0) [0|7] "" FVCM
 SG_ LongitudinalDistance_04 : 32|13@1+ (0.05,-50) [-50.00|359.55] "m" FVCM
 SG_ MovementStatus_04 : 45|3@1+ (1,0) [0|7] "" FVCM
 SG_ ObjectID_04 : 48|8@1+ (1,0) [0|255] "" FVCM
 SG_ ReferencePoint_04 : 56|4@1+ (1,0) [0|15] "" FVCM
 SG_ AbsLongVelocity_04 : 60|12@1+ (0.05,-100) [-100.00|104.75] "m/s" FVCM
 SG_ AbsLatAccSTD_04 : 72|9@1+ (0.008,0) [0.000|4.088] "m/s²" FVCM
 SG_ Reserved_PMOI_Debug_Signal1_04 : 81|8@1+ (0.01,-1) [-1.00|1.55] "" FVCM
 SG_ ExistenceProbability_04 : 89|7@1+ (1,0) [0|127] "%" FVCM
 SG_ AbsLatVeloSTD_04 : 96|9@1+ (0.02,0) [0.00|10.22] "m/s" FVCM
 SG_ ClassificationTypeProbability_04 : 105|7@1+ (1,0) [0|127] "%" FVCM
 SG_ AbsLongAccSTD_04 : 112|9@1+ (0.008,0) [0.000|4.088] "m/s²" FVCM
 SG_ AbsLongVelocitySTD_04 : 121|9@1+ (0.02,0) [0.00|10.22] "m/s" FVCM
 SG_ AbsLatVelocity_04 : 130|12@1+ (0.05,-100) [-100.00|104.75] "m/s" FVCM
 SG_ LengthSTD_04 : 142|7@1+ (0.1,0) [0|12.7] "m" FVCM
 SG_ AbsLatAcc_04 : 149|10@1+ (0.05,-25) [-25.00|26.15] "m/s²" FVCM
 SG_ AbsLongAcc__04 : 159|10@1+ (0.05,-25) [-25.00|26.15] "m/s²" FVCM
 SG_ Width_04 : 169|6@1+ (0.1,0) [0|6.3] "m" FVCM
 SG_ WidthSTD_04 : 175|6@1+ (0.1,0) [0|6.3] "m" FVCM
 SG_ Reserved_PMOI_Debug_Signal2_04 : 181|8@1+ (0.01,-1) [-1.00|1.55] "m/s" FVCM
 SG_ ObjectAge_04 : 189|13@1+ (0.06,0) [0.00|491.46] "s" FVCM
 SG_ Reserved_PMOI_Debug_Signal3_04 : 202|8@1+ (0.01,-1) [-1.00|1.55] "" FVCM
 SG_ Reserved_PMOI_Debug_Signal4_04 : 210|8@1+ (0.01,-1) [-1.00|1.55] "" FVCM
 SG_ LateralDistance_04 : 218|12@1+ (0.05,-100) [-100.00|104.75] "m" FVCM
 SG_ LateralDistanceSTD_04 : 230|9@1+ (0.05,0) [0.00|25.55] "m" FVCM
 SG_ LongitudinalDistanceSTD_04 : 239|9@1+ (0.05,0) [0.00|25.55] "m" FVCM
 SG_ Length_04 : 248|8@1+ (0.1,0) [0|25.5] "m" FVCM
 SG_ Reserved_PMOI_Debug_Signal5_04 : 256|8@1+ (0.01,-1) [-1.00|1.55] "" FVCM
 SG_ Reserved_PMOI_Debug_Signal6_04 : 264|8@1+ (0.01,-1) [-1.00|1.55] "" FVCM
 SG_ RadarCrossSection_04 : 272|7@1+ (1,-60) [-60|67] "dBm²" FVCM
 SG_ Yaw_04 : 279|9@1+ (0.02,-3.142) [-3.142|7.078] "rad" FVCM
 SG_ YawSTD_04 : 288|9@1+ (0.02,0) [0.00|10.22] "rad" FVCM
 SG_ Height_04 : 297|6@1+ (0.1,0) [0|6.3] "m" FVCM
 SG_ HeightSTD_04 : 303|6@1+ (0.1,0) [0|6.3] "m" FVCM

BO_ 518 FDR_Object_5: 64 Vector__XXX
 SG_ OD_Info_CRC_05 : 0|16@1+ (1,0) [0|65535] "" FVCM
 SG_ OD_Info_ALIVE_05 : 16|8@1+ (1,0) [0|255] "" FVCM
 SG_ IsNew_05 : 24|2@1+ (1,0) [0|3] "" FVCM
 SG_ ClassificationType_05 : 26|3@1+ (1,0) [0|7] "" FVCM
 SG_ MeasurementStatus_05 : 29|3@1+ (1,0) [0|7] "" FVCM
 SG_ LongitudinalDistance_05 : 32|13@1+ (0.05,-50) [-50.00|359.55] "m" FVCM
 SG_ MovementStatus_05 : 45|3@1+ (1,0) [0|7] "" FVCM
 SG_ ObjectID_05 : 48|8@1+ (1,0) [0|255] "" FVCM
 SG_ ReferencePoint_05 : 56|4@1+ (1,0) [0|15] "" FVCM
 SG_ AbsLongVelocity_05 : 60|12@1+ (0.05,-100) [-100.00|104.75] "m/s" FVCM
 SG_ AbsLatAccSTD_05 : 72|9@1+ (0.008,0) [0.000|4.088] "m/s²" FVCM
 SG_ Reserved_PMOI_Debug_Signal1_05 : 81|8@1+ (0.01,-1) [-1.00|1.55] "" FVCM
 SG_ ExistenceProbability_05 : 89|7@1+ (1,0) [0|127] "%" FVCM
 SG_ AbsLatVeloSTD_05 : 96|9@1+ (0.02,0) [0.00|10.22] "m/s" FVCM
 SG_ ClassificationTypeProbability_05 : 105|7@1+ (1,0) [0|127] "%" FVCM
 SG_ AbsLongAccSTD_05 : 112|9@1+ (0.008,0) [0.000|4.088] "m/s²" FVCM
 SG_ AbsLongVelocitySTD_05 : 121|9@1+ (0.02,0) [0.00|10.22] "m/s" FVCM
 SG_ AbsLatVelocity_05 : 130|12@1+ (0.05,-100) [-100.00|104.75] "m/s" FVCM
 SG_ LengthSTD_05 : 142|7@1+ (0.1,0) [0|12.7] "m" FVCM
 SG_ AbsLatAcc_05 : 149|10@1+ (0.05,-25) [-25.00|26.15] "m/s²" FVCM
 SG_ AbsLongAcc__05 : 159|10@1+ (0.05,-25) [-25.00|26.15] "m/s²" FVCM
 SG_ Width_05 : 169|6@1+ (0.1,0) [0|6.3] "m" FVCM
 SG_ WidthSTD_05 : 175|6@1+ (0.1,0) [0|6.3] "m" FVCM
 SG_ Reserved_PMOI_Debug_Signal2_05 : 181|8@1+ (0.01,-1) [-1.00|1.55] "m/s" FVCM
 SG_ ObjectAge_05 : 189|13@1+ (0.06,0) [0.00|491.46] "s" FVCM
 SG_ Reserved_PMOI_Debug_Signal3_05 : 202|8@1+ (0.01,-1) [-1.00|1.55] "" FVCM
 SG_ Reserved_PMOI_Debug_Signal4_05 : 210|8@1+ (0.01,-1) [-1.00|1.55] "" FVCM
 SG_ LateralDistance_05 : 218|12@1+ (0.05,-100) [-100.00|104.75] "m" FVCM
 SG_ LateralDistanceSTD_05 : 230|9@1+ (0.05,0) [0.00|25.55] "m" FVCM
 SG_ LongitudinalDistanceSTD_05 : 239|9@1+ (0.05,0) [0.00|25.55] "m" FVCM
 SG_ Length_05 : 248|8@1+ (0.1,0) [0|25.5] "m" FVCM
 SG_ Reserved_PMOI_Debug_Signal5_05 : 256|8@1+ (0.01,-1) [-1.00|1.55] "" FVCM
 SG_ Reserved_PMOI_Debug_Signal6_05 : 264|8@1+ (0.01,-1) [-1.00|1.55] "" FVCM
 SG_ RadarCrossSection_05 : 272|7@1+ (1,-60) [-60|67] "dBm²" FVCM
 SG_ Yaw_05 : 279|9@1+ (0.02,-3.142) [-3.142|7.078] "rad" FVCM
 SG_ YawSTD_05 : 288|9@1+ (0.02,0) [0.00|10.22] "rad" FVCM
 SG_ Height_05 : 297|6@1+ (0.1,0) [0|6.3] "m" FVCM
 SG_ HeightSTD_05 : 303|6@1+ (0.1,0) [0|6.3] "m" FVCM

BO_ 519 FDR_Object_6: 64 Vector__XXX
 SG_ OD_Info_CRC_06 : 0|16@1+ (1,0) [0|65535] "" FVCM
 SG_ OD_Info_ALIVE_06 : 16|8@1+ (1,0) [0|255] "" FVCM
 SG_ IsNew_06 : 24|2@1+ (1,0) [0|3] "" FVCM
 SG_ ClassificationType_06 : 26|3@1+ (1,0) [0|7] "" FVCM
 SG_ MeasurementStatus_06 : 29|3@1+ (1,0) [0|7] "" FVCM
 SG_ LongitudinalDistance_06 : 32|13@1+ (0.05,-50) [-50.00|359.55] "m" FVCM
 SG_ MovementStatus_06 : 45|3@1+ (1,0) [0|7] "" FVCM
 SG_ ObjectID_06 : 48|8@1+ (1,0) [0|255] "" FVCM
 SG_ ReferencePoint_06 : 56|4@1+ (1,0) [0|15] "" FVCM
 SG_ AbsLongVelocity_06 : 60|12@1+ (0.05,-100) [-100.00|104.75] "m/s" FVCM
 SG_ AbsLatAccSTD_06 : 72|9@1+ (0.008,0) [0.000|4.088] "m/s²" FVCM
 SG_ Reserved_PMOI_Debug_Signal1_06 : 81|8@1+ (0.01,-1) [-1.00|1.55] "" FVCM
 SG_ ExistenceProbability_06 : 89|7@1+ (1,0) [0|127] "%" FVCM
 SG_ AbsLatVeloSTD_06 : 96|9@1+ (0.02,0) [0.00|10.22] "m/s" FVCM
 SG_ ClassificationTypeProbability_06 : 105|7@1+ (1,0) [0|127] "%" FVCM
 SG_ AbsLongAccSTD_06 : 112|9@1+ (0.008,0) [0.000|4.088] "m/s²" FVCM
 SG_ AbsLongVelocitySTD_06 : 121|9@1+ (0.02,0) [0.00|10.22] "m/s" FVCM
 SG_ AbsLatVelocity_06 : 130|12@1+ (0.05,-100) [-100.00|104.75] "m/s" FVCM
 SG_ LengthSTD_06 : 142|7@1+ (0.1,0) [0|12.7] "m" FVCM
 SG_ AbsLatAcc_06 : 149|10@1+ (0.05,-25) [-25.00|26.15] "m/s²" FVCM
 SG_ AbsLongAcc__06 : 159|10@1+ (0.05,-25) [-25.00|26.15] "m/s²" FVCM
 SG_ Width_06 : 169|6@1+ (0.1,0) [0|6.3] "m" FVCM
 SG_ WidthSTD_06 : 175|6@1+ (0.1,0) [0|6.3] "m" FVCM
 SG_ Reserved_PMOI_Debug_Signal2_06 : 181|8@1+ (0.01,-1) [-1.00|1.55] "m/s" FVCM
 SG_ ObjectAge_06 : 189|13@1+ (0.06,0) [0.00|491.46] "s" FVCM
 SG_ Reserved_PMOI_Debug_Signal3_06 : 202|8@1+ (0.01,-1) [-1.00|1.55] "" FVCM
 SG_ Reserved_PMOI_Debug_Signal4_06 : 210|8@1+ (0.01,-1) [-1.00|1.55] "" FVCM
 SG_ LateralDistance_06 : 218|12@1+ (0.05,-100) [-100.00|104.75] "m" FVCM
 SG_ LateralDistanceSTD_06 : 230|9@1+ (0.05,0) [0.00|25.55] "m" FVCM
 SG_ LongitudinalDistanceSTD_06 : 239|9@1+ (0.05,0) [0.00|25.55] "m" FVCM
 SG_ Length_06 : 248|8@1+ (0.1,0) [0|25.5] "m" FVCM
 SG_ Reserved_PMOI_Debug_Signal5_06 : 256|8@1+ (0.01,-1) [-1.00|1.55] "" FVCM
 SG_ Reserved_PMOI_Debug_Signal6_06 : 264|8@1+ (0.01,-1) [-1.00|1.55] "" FVCM
 SG_ RadarCrossSection_06 : 272|7@1+ (1,-60) [-60|67] "dBm²" FVCM
 SG_ Yaw_06 : 279|9@1+ (0.02,-3.142) [-3.142|7.078] "rad" FVCM
 SG_ YawSTD_06 : 288|9@1+ (0.02,0) [0.00|10.22] "rad" FVCM
 SG_ Height_06 : 297|6@1+ (0.1,0) [0|6.3] "m" FVCM
 SG_ HeightSTD_06 : 303|6@1+ (0.1,0) [0|6.3] "m" FVCM

BO_ 520 FDR_Object_7: 64 Vector__XXX
 SG_ OD_Info_CRC_07 : 0|16@1+ (1,0) [0|65535] "" FVCM
 SG_ OD_Info_ALIVE_07 : 16|8@1+ (1,0) [0|255] "" FVCM
 SG_ IsNew_07 : 24|2@1+ (1,0) [0|3] "" FVCM
 SG_ ClassificationType_07 : 26|3@1+ (1,0) [0|7] "" FVCM
 SG_ MeasurementStatus_07 : 29|3@1+ (1,0) [0|7] "" FVCM
 SG_ LongitudinalDistance_07 : 32|13@1+ (0.05,-50) [-50.00|359.55] "m" FVCM
 SG_ MovementStatus_07 : 45|3@1+ (1,0) [0|7] "" FVCM
 SG_ ObjectID_07 : 48|8@1+ (1,0) [0|255] "" FVCM
 SG_ ReferencePoint_07 : 56|4@1+ (1,0) [0|15] "" FVCM
 SG_ AbsLongVelocity_07 : 60|12@1+ (0.05,-100) [-100.00|104.75] "m/s" FVCM
 SG_ AbsLatAccSTD_07 : 72|9@1+ (0.008,0) [0.000|4.088] "m/s²" FVCM
 SG_ Reserved_PMOI_Debug_Signal1_07 : 81|8@1+ (0.01,-1) [-1.00|1.55] "" FVCM
 SG_ ExistenceProbability_07 : 89|7@1+ (1,0) [0|127] "%" FVCM
 SG_ AbsLatVeloSTD_07 : 96|9@1+ (0.02,0) [0.00|10.22] "m/s" FVCM
 SG_ ClassificationTypeProbability_07 : 105|7@1+ (1,0) [0|127] "%" FVCM
 SG_ AbsLongAccSTD_07 : 112|9@1+ (0.008,0) [0.000|4.088] "m/s²" FVCM
 SG_ AbsLongVelocitySTD_07 : 121|9@1+ (0.02,0) [0.00|10.22] "m/s" FVCM
 SG_ AbsLatVelocity_07 : 130|12@1+ (0.05,-100) [-100.00|104.75] "m/s" FVCM
 SG_ LengthSTD_07 : 142|7@1+ (0.1,0) [0|12.7] "m" FVCM
 SG_ AbsLatAcc_07 : 149|10@1+ (0.05,-25) [-25.00|26.15] "m/s²" FVCM
 SG_ AbsLongAcc__07 : 159|10@1+ (0.05,-25) [-25.00|26.15] "m/s²" FVCM
 SG_ Width_07 : 169|6@1+ (0.1,0) [0|6.3] "m" FVCM
 SG_ WidthSTD_07 : 175|6@1+ (0.1,0) [0|6.3] "m" FVCM
 SG_ Reserved_PMOI_Debug_Signal2_07 : 181|8@1+ (0.01,-1) [-1.00|1.55] "m/s" FVCM
 SG_ ObjectAge_07 : 189|13@1+ (0.06,0) [0.00|491.46] "s" FVCM
 SG_ Reserved_PMOI_Debug_Signal3_07 : 202|8@1+ (0.01,-1) [-1.00|1.55] "" FVCM
 SG_ Reserved_PMOI_Debug_Signal4_07 : 210|8@1+ (0.01,-1) [-1.00|1.55] "" FVCM
 SG_ LateralDistance_07 : 218|12@1+ (0.05,-100) [-100.00|104.75] "m" FVCM
 SG_ LateralDistanceSTD_07 : 230|9@1+ (0.05,0) [0.00|25.55] "m" FVCM
 SG_ LongitudinalDistanceSTD_07 : 239|9@1+ (0.05,0) [0.00|25.55] "m" FVCM
 SG_ Length_07 : 248|8@1+ (0.1,0) [0|25.5] "m" FVCM
 SG_ Reserved_PMOI_Debug_Signal5_07 : 256|8@1+ (0.01,-1) [-1.00|1.55] "" FVCM
 SG_ Reserved_PMOI_Debug_Signal6_07 : 264|8@1+ (0.01,-1) [-1.00|1.55] "" FVCM
 SG_ RadarCrossSection_07 : 272|7@1+ (1,-60) [-60|67] "dBm²" FVCM
 SG_ Yaw_07 : 279|9@1+ (0.02,-3.142) [-3.142|7.078] "rad" FVCM
 SG_ YawSTD_07 : 288|9@1+ (0.02,0) [0.00|10.22] "rad" FVCM
 SG_ Height_07 : 297|6@1+ (0.1,0) [0|6.3] "m" FVCM
 SG_ HeightSTD_07 : 303|6@1+ (0.1,0) [0|6.3] "m" FVCM

BO_ 521 FDR_Object_8: 64 Vector__XXX
 SG_ OD_Info_CRC_08 : 0|16@1+ (1,0) [0|65535] "" FVCM
 SG_ OD_Info_ALIVE_08 : 16|8@1+ (1,0) [0|255] "" FVCM
 SG_ IsNew_08 : 24|2@1+ (1,0) [0|3] "" FVCM
 SG_ ClassificationType_08 : 26|3@1+ (1,0) [0|7] "" FVCM
 SG_ MeasurementStatus_08 : 29|3@1+ (1,0) [0|7] "" FVCM
 SG_ LongitudinalDistance_08 : 32|13@1+ (0.05,-50) [-50.00|359.55] "m" FVCM
 SG_ MovementStatus_08 : 45|3@1+ (1,0) [0|7] "" FVCM
 SG_ ObjectID_08 : 48|8@1+ (1,0) [0|255] "" FVCM
 SG_ ReferencePoint_08 : 56|4@1+ (1,0) [0|15] "" FVCM
 SG_ AbsLongVelocity_08 : 60|12@1+ (0.05,-100) [-100.00|104.75] "m/s" FVCM
 SG_ AbsLatAccSTD_08 : 72|9@1+ (0.008,0) [0.000|4.088] "m/s²" FVCM
 SG_ Reserved_PMOI_Debug_Signal1_08 : 81|8@1+ (0.01,-1) [-1.00|1.55] "" FVCM
 SG_ ExistenceProbability_08 : 89|7@1+ (1,0) [0|127] "%" FVCM
 SG_ AbsLatVeloSTD_08 : 96|9@1+ (0.02,0) [0.00|10.22] "m/s" FVCM
 SG_ ClassificationTypeProbability_08 : 105|7@1+ (1,0) [0|127] "%" FVCM
 SG_ AbsLongAccSTD_08 : 112|9@1+ (0.008,0) [0.000|4.088] "m/s²" FVCM
 SG_ AbsLongVelocitySTD_08 : 121|9@1+ (0.02,0) [0.00|10.22] "m/s" FVCM
 SG_ AbsLatVelocity_08 : 130|12@1+ (0.05,-100) [-100.00|104.75] "m/s" FVCM
 SG_ LengthSTD_08 : 142|7@1+ (0.1,0) [0|12.7] "m" FVCM
 SG_ AbsLatAcc_08 : 149|10@1+ (0.05,-25) [-25.00|26.15] "m/s²" FVCM
 SG_ AbsLongAcc__08 : 159|10@1+ (0.05,-25) [-25.00|26.15] "m/s²" FVCM
 SG_ Width_08 : 169|6@1+ (0.1,0) [0|6.3] "m" FVCM
 SG_ WidthSTD_08 : 175|6@1+ (0.1,0) [0|6.3] "m" FVCM
 SG_ Reserved_PMOI_Debug_Signal2_08 : 181|8@1+ (0.01,-1) [-1.00|1.55] "m/s" FVCM
 SG_ ObjectAge_08 : 189|13@1+ (0.06,0) [0.00|491.46] "s" FVCM
 SG_ Reserved_PMOI_Debug_Signal3_08 : 202|8@1+ (0.01,-1) [-1.00|1.55] "" FVCM
 SG_ Reserved_PMOI_Debug_Signal4_08 : 210|8@1+ (0.01,-1) [-1.00|1.55] "" FVCM
 SG_ LateralDistance_08 : 218|12@1+ (0.05,-100) [-100.00|104.75] "m" FVCM
 SG_ LateralDistanceSTD_08 : 230|9@1+ (0.05,0) [0.00|25.55] "m" FVCM
 SG_ LongitudinalDistanceSTD_08 : 239|9@1+ (0.05,0) [0.00|25.55] "m" FVCM
 SG_ Length_08 : 248|8@1+ (0.1,0) [0|25.5] "m" FVCM
 SG_ Reserved_PMOI_Debug_Signal5_08 : 256|8@1+ (0.01,-1) [-1.00|1.55] "" FVCM
 SG_ Reserved_PMOI_Debug_Signal6_08 : 264|8@1+ (0.01,-1) [-1.00|1.55] "" FVCM
 SG_ RadarCrossSection_08 : 272|7@1+ (1,-60) [-60|67] "dBm²" FVCM
 SG_ Yaw_08 : 279|9@1+ (0.02,-3.142) [-3.142|7.078] "rad" FVCM
 SG_ YawSTD_08 : 288|9@1+ (0.02,0) [0.00|10.22] "rad" FVCM
 SG_ Height_08 : 297|6@1+ (0.1,0) [0|6.3] "m" FVCM
 SG_ HeightSTD_08 : 303|6@1+ (0.1,0) [0|6.3] "m" FVCM

BO_ 522 FDR_Object_9: 64 Vector__XXX
 SG_ OD_Info_CRC_09 : 0|16@1+ (1,0) [0|65535] "" FVCM
 SG_ OD_Info_ALIVE_09 : 16|8@1+ (1,0) [0|255] "" FVCM
 SG_ IsNew_09 : 24|2@1+ (1,0) [0|3] "" FVCM
 SG_ ClassificationType_09 : 26|3@1+ (1,0) [0|7] "" FVCM
 SG_ MeasurementStatus_09 : 29|3@1+ (1,0) [0|7] "" FVCM
 SG_ LongitudinalDistance_09 : 32|13@1+ (0.05,-50) [-50.00|359.55] "m" FVCM
 SG_ MovementStatus_09 : 45|3@1+ (1,0) [0|7] "" FVCM
 SG_ ObjectID_09 : 48|8@1+ (1,0) [0|255] "" FVCM
 SG_ ReferencePoint_09 : 56|4@1+ (1,0) [0|15] "" FVCM
 SG_ AbsLongVelocity_09 : 60|12@1+ (0.05,-100) [-100.00|104.75] "m/s" FVCM
 SG_ AbsLatAccSTD_09 : 72|9@1+ (0.008,0) [0.000|4.088] "m/s²" FVCM
 SG_ Reserved_PMOI_Debug_Signal1_09 : 81|8@1+ (0.01,-1) [-1.00|1.55] "" FVCM
 SG_ ExistenceProbability_09 : 89|7@1+ (1,0) [0|127] "%" FVCM
 SG_ AbsLatVeloSTD_09 : 96|9@1+ (0.02,0) [0.00|10.22] "m/s" FVCM
 SG_ ClassificationTypeProbability_09 : 105|7@1+ (1,0) [0|127] "%" FVCM
 SG_ AbsLongAccSTD_09 : 112|9@1+ (0.008,0) [0.000|4.088] "m/s²" FVCM
 SG_ AbsLongVelocitySTD_09 : 121|9@1+ (0.02,0) [0.00|10.22] "m/s" FVCM
 SG_ AbsLatVelocity_09 : 130|12@1+ (0.05,-100) [-100.00|104.75] "m/s" FVCM
 SG_ LengthSTD_09 : 142|7@1+ (0.1,0) [0|12.7] "m" FVCM
 SG_ AbsLatAcc_09 : 149|10@1+ (0.05,-25) [-25.00|26.15] "m/s²" FVCM
 SG_ AbsLongAcc__09 : 159|10@1+ (0.05,-25) [-25.00|26.15] "m/s²" FVCM
 SG_ Width_09 : 169|6@1+ (0.1,0) [0|6.3] "m" FVCM
 SG_ WidthSTD_09 : 175|6@1+ (0.1,0) [0|6.3] "m" FVCM
 SG_ Reserved_PMOI_Debug_Signal2_09 : 181|8@1+ (0.01,-1) [-1.00|1.55] "m/s" FVCM
 SG_ ObjectAge_09 : 189|13@1+ (0.06,0) [0.00|491.46] "s" FVCM
 SG_ Reserved_PMOI_Debug_Signal3_09 : 202|8@1+ (0.01,-1) [-1.00|1.55] "" FVCM
 SG_ Reserved_PMOI_Debug_Signal4_09 : 210|8@1+ (0.01,-1) [-1.00|1.55] "" FVCM
 SG_ LateralDistance_09 : 218|12@1+ (0.05,-100) [-100.00|104.75] "m" FVCM
 SG_ LateralDistanceSTD_09 : 230|9@1+ (0.05,0) [0.00|25.55] "m" FVCM
 SG_ LongitudinalDistanceSTD_09 : 239|9@1+ (0.05,0) [0.00|25.55] "m" FVCM
 SG_ Length_09 : 248|8@1+ (0.1,0) [0|25.5] "m" FVCM
 SG_ Reserved_PMOI_Debug_Signal5_09 : 256|8@1+ (0.01,-1) [-1.00|1.55] "" FVCM
 SG_ Reserved_PMOI_Debug_Signal6_09 : 264|8@1+ (0.01,-1) [-1.00|1.55] "" FVCM
 SG_ RadarCrossSection_09 : 272|7@1+ (1,-60) [-60|67] "dBm²" FVCM
 SG_ Yaw_09 : 279|9@1+ (0.02,-3.142) [-3.142|7.078] "rad" FVCM
 SG_ YawSTD_09 : 288|9@1+ (0.02,0) [0.00|10.22] "rad" FVCM
 SG_ Height_09 : 297|6@1+ (0.1,0) [0|6.3] "m" FVCM
 SG_ HeightSTD_09 : 303|6@1+ (0.1,0) [0|6.3] "m" FVCM

BO_ 512 FDR_Object_Header: 64 Vector__XXX
 SG_ SWVersionID : 0|24@1+ (1,0) [0|16777215] "" FVCM
 SG_ SensorID : 24|16@1+ (1,0) [0|65535] "" FVCM
 SG_ InterfaceID : 40|8@1+ (1,0) [0|255] "" FVCM
 SG_ Timestamp : 48|64@1+ (0.1,0) [0|1844674407370955161.5] "" FVCM
 SG_ CycleCounter : 112|32@1+ (1,0) [0|4294967295] "" FVCM
 SG_ ObjectListQualifier : 144|8@1+ (1,0) [0|255] "" FVCM
 SG_ NumberOfPMO : 152|8@1+ (1,0) [0|255] "" FVCM
 SG_ OD_Head_CRC : 160|16@1+ (1,0) [0|65535] "" FVCM
 SG_ OD_Head_ALIVE : 176|8@1+ (1,0) [0|255] "" FVCM

BO_ 300 FVCM_FS: 64 FVCM
 SG_ FS_Head_CRC : 0|16@1+ (1,0) [0|65535] "" Vector__XXX
 SG_ FS_Head_ALIVE : 16|8@1+ (1,0) [0|255] "" Vector__XXX
 SG_ FS_TSR_Out_OF_Calib : 24|8@1+ (1,0) [0|255] "" Vector__XXX
 SG_ FS_Out_Of_Calib : 32|3@1+ (1,0) [0|7] "" Vector__XXX
 SG_ FS_Rain : 35|3@1+ (1,0) [0|7] "" Vector__XXX
 SG_ FS_Fog : 38|3@1+ (1,0) [0|7] "" Vector__XXX
 SG_ FS_Splashes : 41|3@1+ (1,0) [0|7] "" Vector__XXX
 SG_ FS_Sun_Ray : 44|3@1+ (1,0) [0|7] "" Vector__XXX
 SG_ FS_Low_Sun : 47|3@1+ (1,0) [0|7] "" Vector__XXX
 SG_ FS_Blur_Image : 50|3@1+ (1,0) [0|7] "" Vector__XXX
 SG_ FS_Partial_Blockage : 53|3@1+ (1,0) [0|7] "" Vector__XXX
 SG_ FS_Full_Blockage : 56|3@1+ (1,0) [0|7] "" Vector__XXX
 SG_ FS_Frozen_Windshield_Lens : 59|3@1+ (1,0) [0|7] "" Vector__XXX
 SG_ FS_Out_Of_Focus : 62|3@1+ (1,0) [0|7] "" Vector__XXX

BO_ 305 FVCM_LAP_A: 64 FVCM
 SG_ LAP_A_CRC : 0|16@1+ (1,0) [0|65535] "" Vector__XXX
 SG_ LAP_A_ALIVE : 16|8@1+ (1,0) [0|255] "" Vector__XXX
 SG_ LAP_A_Head_SyncCounter : 24|8@1+ (1,0) [0|255] "" Vector__XXX
 SG_ LAP_INTP_ID_0 : 32|8@1+ (1,0) [0|255] "" Vector__XXX
 SG_ LAP_INTP_Distance_Age_0 : 40|12@1+ (1,0) [0|4095] "m" Vector__XXX
 SG_ LAP_INTP_Confidence_0 : 52|7@1+ (0.01,0) [0.00|1.27] "" Vector__XXX
 SG_ LAP_INTP_Is_Valid_0 : 59|1@1+ (1,0) [0|1] "" Vector__XXX
 SG_ LAP_INTP_Type_0 : 60|1@1+ (1,0) [0|1] "" Vector__XXX
 SG_ LAP_INTP_Is_Start_0 : 61|1@1+ (1,0) [0|1] "" Vector__XXX
 SG_ LAP_INTP_Lat_Distance_0 : 62|14@1+ (0.01,-50) [-50.00|113.83] "m" Vector__XXX
 SG_ LAP_INTP_Long_Distance_0 : 76|15@1+ (0.01,0) [0.00|327.67] "m" Vector__XXX
 SG_ LAP_INTP_SRD_0 : 91|4@1+ (1,0) [0|15] "" Vector__XXX
 SG_ LAP_INTP_Role_0 : 95|4@1+ (1,0) [0|15] "" Vector__XXX
 SG_ LAP_INTP_ID_1 : 99|8@1+ (1,0) [0|255] "" Vector__XXX
 SG_ LAP_INTP_Distance_Age_1 : 107|12@1+ (1,0) [0|4095] "m" Vector__XXX
 SG_ LAP_INTP_Confidence_1 : 119|7@1+ (0.01,0) [0.00|1.27] "" Vector__XXX
 SG_ LAP_INTP_Is_Valid_1 : 126|1@1+ (1,0) [0|1] "" Vector__XXX
 SG_ LAP_INTP_Type_1 : 127|1@1+ (1,0) [0|1] "" Vector__XXX
 SG_ LAP_INTP_Is_Start_1 : 128|1@1+ (1,0) [0|1] "" Vector__XXX
 SG_ LAP_INTP_Lat_Distance_1 : 129|14@1+ (0.01,-50) [-50.00|113.83] "m" Vector__XXX
 SG_ LAP_INTP_Long_Distance_1 : 143|15@1+ (0.01,0) [0.00|327.67] "m" Vector__XXX
 SG_ LAP_INTP_SRD_1 : 158|4@1+ (1,0) [0|15] "" Vector__XXX
 SG_ LAP_INTP_Role_1 : 162|4@1+ (1,0) [0|15] "" Vector__XXX
 SG_ LAP_INTP_ID_2 : 166|8@1+ (1,0) [0|255] "" Vector__XXX
 SG_ LAP_INTP_Distance_Age_2 : 174|12@1+ (1,0) [0|4095] "m" Vector__XXX
 SG_ LAP_INTP_Confidence_2 : 186|7@1+ (0.01,0) [0.00|1.27] "" Vector__XXX
 SG_ LAP_INTP_Is_Valid_2 : 193|1@1+ (1,0) [0|1] "" Vector__XXX
 SG_ LAP_INTP_Type_2 : 194|1@1+ (1,0) [0|1] "" Vector__XXX
 SG_ LAP_INTP_Is_Start_2 : 195|1@1+ (1,0) [0|1] "" Vector__XXX
 SG_ LAP_INTP_Lat_Distance_2 : 196|14@1+ (0.01,-50) [-50.00|113.83] "m" Vector__XXX
 SG_ LAP_INTP_Long_Distance_2 : 210|15@1+ (0.01,0) [0.00|327.67] "m" Vector__XXX
 SG_ LAP_INTP_SRD_2 : 225|4@1+ (1,0) [0|15] "" Vector__XXX
 SG_ LAP_INTP_Role_2 : 229|4@1+ (1,0) [0|15] "" Vector__XXX
 SG_ LAP_INTP_ID_3 : 233|8@1+ (1,0) [0|255] "" Vector__XXX
 SG_ LAP_INTP_Distance_Age_3 : 241|12@1+ (1,0) [0|4095] "m" Vector__XXX
 SG_ LAP_INTP_Confidence_3 : 253|7@1+ (0.01,0) [0.00|1.27] "" Vector__XXX
 SG_ LAP_INTP_Is_Valid_3 : 260|1@1+ (1,0) [0|1] "" Vector__XXX
 SG_ LAP_INTP_Type_3 : 261|1@1+ (1,0) [0|1] "" Vector__XXX
 SG_ LAP_INTP_Is_Start_3 : 262|1@1+ (1,0) [0|1] "" Vector__XXX
 SG_ LAP_INTP_Lat_Distance_3 : 263|14@1+ (0.01,-50) [-50.00|113.83] "m" Vector__XXX
 SG_ LAP_INTP_Long_Distance_3 : 277|15@1+ (0.01,0) [0.00|327.67] "m" Vector__XXX
 SG_ LAP_INTP_SRD_3 : 292|4@1+ (1,0) [0|15] "" Vector__XXX
 SG_ LAP_INTP_Role_3 : 296|4@1+ (1,0) [0|15] "" Vector__XXX
 SG_ LAP_INTP_ID_4 : 300|8@1+ (1,0) [0|255] "" Vector__XXX
 SG_ LAP_INTP_Distance_Age_4 : 308|12@1+ (1,0) [0|4095] "m" Vector__XXX
 SG_ LAP_INTP_Confidence_4 : 320|7@1+ (0.01,0) [0.00|1.27] "" Vector__XXX
 SG_ LAP_INTP_Is_Valid_4 : 327|1@1+ (1,0) [0|1] "" Vector__XXX
 SG_ LAP_INTP_Type_4 : 328|1@1+ (1,0) [0|1] "" Vector__XXX
 SG_ LAP_INTP_Is_Start_4 : 329|1@1+ (1,0) [0|1] "" Vector__XXX
 SG_ LAP_INTP_Lat_Distance_4 : 330|14@1+ (0.01,-50) [-50.00|113.83] "m" Vector__XXX
 SG_ LAP_INTP_Long_Distance_4 : 344|15@1+ (0.01,0) [0.00|327.67] "m" Vector__XXX
 SG_ LAP_INTP_SRD_4 : 359|4@1+ (1,0) [0|15] "" Vector__XXX
 SG_ LAP_INTP_Role_4 : 363|4@1+ (1,0) [0|15] "" Vector__XXX
 SG_ LAP_INTP_ID_5 : 367|8@1+ (1,0) [0|255] "" Vector__XXX
 SG_ LAP_INTP_Distance_Age_5 : 375|12@1+ (1,0) [0|4095] "m" Vector__XXX
 SG_ LAP_INTP_Confidence_5 : 387|7@1+ (0.01,0) [0.00|1.27] "" Vector__XXX
 SG_ LAP_INTP_Is_Valid_5 : 394|1@1+ (1,0) [0|1] "" Vector__XXX
 SG_ LAP_INTP_Type_5 : 395|1@1+ (1,0) [0|1] "" Vector__XXX
 SG_ LAP_INTP_Is_Start_5 : 396|1@1+ (1,0) [0|1] "" Vector__XXX
 SG_ LAP_INTP_Lat_Distance_5 : 397|14@1+ (0.01,-50) [-50.00|113.83] "m" Vector__XXX
 SG_ LAP_INTP_Long_Distance_5 : 411|15@1+ (0.01,0) [0.00|327.67] "m" Vector__XXX
 SG_ LAP_INTP_SRD_5 : 426|4@1+ (1,0) [0|15] "" Vector__XXX
 SG_ LAP_INTP_Role_5 : 430|4@1+ (1,0) [0|15] "" Vector__XXX

BO_ 306 FVCM_LAP_B: 64 FVCM
 SG_ LAP_B_CRC : 0|16@1+ (1,0) [0|65535] "" Vector__XXX
 SG_ LAP_B_ALIVE : 16|8@1+ (1,0) [0|255] "" Vector__XXX
 SG_ LAP_B_Head_SyncCounter : 24|8@1+ (1,0) [0|255] "" Vector__XXX
 SG_ LAP_INTP_ID_6 : 32|8@1+ (1,0) [0|255] "" Vector__XXX
 SG_ LAP_INTP_Distance_Age_6 : 40|12@1+ (1,0) [0|4095] "m" Vector__XXX
 SG_ LAP_INTP_Confidence_6 : 52|7@1+ (0.01,0) [0.00|1.27] "" Vector__XXX
 SG_ LAP_INTP_Is_Valid_6 : 59|1@1+ (1,0) [0|1] "" Vector__XXX
 SG_ LAP_INTP_Type_6 : 60|1@1+ (1,0) [0|1] "" Vector__XXX
 SG_ LAP_INTP_Is_Start_6 : 61|1@1+ (1,0) [0|1] "" Vector__XXX
 SG_ LAP_INTP_Lat_Distance_6 : 62|14@1+ (0.01,-50) [-50.00|113.83] "m" Vector__XXX
 SG_ LAP_INTP_Long_Distance_6 : 76|15@1+ (0.01,0) [0.00|327.67] "m" Vector__XXX
 SG_ LAP_INTP_SRD_6 : 91|4@1+ (1,0) [0|15] "" Vector__XXX
 SG_ LAP_INTP_Role_6 : 95|4@1+ (1,0) [0|15] "" Vector__XXX
 SG_ LAP_INTP_ID_7 : 99|8@1+ (1,0) [0|255] "" Vector__XXX
 SG_ LAP_INTP_Distance_Age_7 : 107|12@1+ (1,0) [0|4095] "m" Vector__XXX
 SG_ LAP_INTP_Confidence_7 : 119|7@1+ (0.01,0) [0.00|1.27] "" Vector__XXX
 SG_ LAP_INTP_Is_Valid_7 : 126|1@1+ (1,0) [0|1] "" Vector__XXX
 SG_ LAP_INTP_Type_7 : 127|1@1+ (1,0) [0|1] "" Vector__XXX
 SG_ LAP_INTP_Is_Start_7 : 128|1@1+ (1,0) [0|1] "" Vector__XXX
 SG_ LAP_INTP_Lat_Distance_7 : 129|14@1+ (0.01,-50) [-50.00|113.83] "m" Vector__XXX
 SG_ LAP_INTP_Long_Distance_7 : 143|15@1+ (0.01,0) [0.00|327.67] "m" Vector__XXX
 SG_ LAP_INTP_SRD_7 : 158|4@1+ (1,0) [0|15] "" Vector__XXX
 SG_ LAP_INTP_Role_7 : 162|4@1+ (1,0) [0|15] "" Vector__XXX
 SG_ LAP_INTP_ID_8 : 166|8@1+ (1,0) [0|255] "" Vector__XXX
 SG_ LAP_INTP_Distance_Age_8 : 174|12@1+ (1,0) [0|4095] "m" Vector__XXX
 SG_ LAP_INTP_Confidence_8 : 186|7@1+ (0.01,0) [0.00|1.27] "" Vector__XXX
 SG_ LAP_INTP_Is_Valid_8 : 193|1@1+ (1,0) [0|1] "" Vector__XXX
 SG_ LAP_INTP_Type_8 : 194|1@1+ (1,0) [0|1] "" Vector__XXX
 SG_ LAP_INTP_Is_Start_8 : 195|1@1+ (1,0) [0|1] "" Vector__XXX
 SG_ LAP_INTP_Lat_Distance_8 : 196|14@1+ (0.01,-50) [-50.00|113.83] "m" Vector__XXX
 SG_ LAP_INTP_Long_Distance_8 : 210|15@1+ (0.01,0) [0.00|327.67] "m" Vector__XXX
 SG_ LAP_INTP_SRD_8 : 225|4@1+ (1,0) [0|15] "" Vector__XXX
 SG_ LAP_INTP_Role_8 : 229|4@1+ (1,0) [0|15] "" Vector__XXX
 SG_ LAP_INTP_ID_9 : 233|8@1+ (1,0) [0|255] "" Vector__XXX
 SG_ LAP_INTP_Distance_Age_9 : 241|12@1+ (1,0) [0|4095] "m" Vector__XXX
 SG_ LAP_INTP_Confidence_9 : 253|7@1+ (0.01,0) [0.00|1.27] "" Vector__XXX
 SG_ LAP_INTP_Is_Valid_9 : 260|1@1+ (1,0) [0|1] "" Vector__XXX
 SG_ LAP_INTP_Type_9 : 261|1@1+ (1,0) [0|1] "" Vector__XXX
 SG_ LAP_INTP_Is_Start_9 : 262|1@1+ (1,0) [0|1] "" Vector__XXX
 SG_ LAP_INTP_Lat_Distance_9 : 263|14@1+ (0.01,-50) [-50.00|113.83] "m" Vector__XXX
 SG_ LAP_INTP_Long_Distance_9 : 277|15@1+ (0.01,0) [0.00|327.67] "m" Vector__XXX
 SG_ LAP_INTP_SRD_9 : 292|4@1+ (1,0) [0|15] "" Vector__XXX
 SG_ LAP_INTP_Role_9 : 296|4@1+ (1,0) [0|15] "" Vector__XXX
 SG_ LAP_INTP_ID_10 : 300|8@1+ (1,0) [0|255] "" Vector__XXX
 SG_ LAP_INTP_Distance_Age_10 : 308|12@1+ (1,0) [0|4095] "m" Vector__XXX
 SG_ LAP_INTP_Confidence_10 : 320|7@1+ (0.01,0) [0.00|1.27] "" Vector__XXX
 SG_ LAP_INTP_Is_Valid_10 : 327|1@1+ (1,0) [0|1] "" Vector__XXX
 SG_ LAP_INTP_Type_10 : 328|1@1+ (1,0) [0|1] "" Vector__XXX
 SG_ LAP_INTP_Is_Start_10 : 329|1@1+ (1,0) [0|1] "" Vector__XXX
 SG_ LAP_INTP_Lat_Distance_10 : 330|14@1+ (0.01,-50) [-50.00|113.83] "m" Vector__XXX
 SG_ LAP_INTP_Long_Distance_10 : 344|15@1+ (0.01,0) [0.00|327.67] "m" Vector__XXX
 SG_ LAP_INTP_SRD_10 : 359|4@1+ (1,0) [0|15] "" Vector__XXX
 SG_ LAP_INTP_Role_10 : 363|4@1+ (1,0) [0|15] "" Vector__XXX
 SG_ LAP_INTP_ID_11 : 367|8@1+ (1,0) [0|255] "" Vector__XXX
 SG_ LAP_INTP_Distance_Age_11 : 375|12@1+ (1,0) [0|4095] "m" Vector__XXX
 SG_ LAP_INTP_Confidence_11 : 387|7@1+ (0.01,0) [0.00|1.27] "" Vector__XXX
 SG_ LAP_INTP_Is_Valid_11 : 394|1@1+ (1,0) [0|1] "" Vector__XXX
 SG_ LAP_INTP_Type_11 : 395|1@1+ (1,0) [0|1] "" Vector__XXX
 SG_ LAP_INTP_Is_Start_11 : 396|1@1+ (1,0) [0|1] "" Vector__XXX
 SG_ LAP_INTP_Lat_Distance_11 : 397|14@1+ (0.01,-50) [-50.00|113.83] "m" Vector__XXX
 SG_ LAP_INTP_Long_Distance_11 : 411|15@1+ (0.01,0) [0.00|327.67] "m" Vector__XXX
 SG_ LAP_INTP_SRD_11 : 426|4@1+ (1,0) [0|15] "" Vector__XXX
 SG_ LAP_INTP_Role_11 : 430|4@1+ (1,0) [0|15] "" Vector__XXX

BO_ 304 FVCM_LAP_General_Information: 64 FVCM
 SG_ LAP_Head_CRC : 0|16@1+ (1,0) [0|65535] "" Vector__XXX
 SG_ LAP_Head_ALIVE : 16|8@1+ (1,0) [0|255] "" Vector__XXX
 SG_ LAP_Head_SyncCounter : 24|8@1+ (1,0) [0|255] "" Vector__XXX
 SG_ LAP_Is_Construction_Area : 32|1@1+ (1,0) [0|1] "" Vector__XXX
 SG_ LAP_Is_Construction_Area_Rear : 33|1@1+ (1,0) [0|1] "" Vector__XXX
 SG_ LAP_Snow_On_Road : 34|7@1+ (1,0) [0|127] "" Vector__XXX
 SG_ LAP_INTP_Available : 41|1@1+ (1,0) [0|1] "" Vector__XXX
 SG_ LAP_INTP_Count : 42|4@1+ (1,0) [0|15] "" Vector__XXX
 SG_ LAP_Exit_Merge_Available : 46|1@1+ (1,0) [0|1] "" Vector__XXX
 SG_ LAP_Is_Highway_Merge_Left : 47|1@1+ (1,0) [0|1] "" Vector__XXX
 SG_ LAP_Is_Highway_Merge_Right : 48|1@1+ (1,0) [0|1] "" Vector__XXX
 SG_ LAP_Is_Highway_Exit_Left : 49|1@1+ (1,0) [0|1] "" Vector__XXX
 SG_ LAP_Is_Highway_Exit_Right : 50|1@1+ (1,0) [0|1] "" Vector__XXX
 SG_ LAP_Vertical_Surface_Available : 51|1@1+ (1,0) [0|1] "" Vector__XXX
 SG_ LAP_Vertical_Surface_VR_End : 52|15@1+ (0.01,0) [0.00|327.67] "m" Vector__XXX
 SG_ LAP_Vertical_Surface_C0 : 67|32@1- (1,0) [-2147483648|2147483647] "m" Vector__XXX
 SG_ LAP_Vertical_Surface_C1 : 99|32@1- (1,0) [-2147483648|2147483647] "rad" Vector__XXX
 SG_ LAP_Vertical_Surface_C2 : 131|32@1- (1,0) [-2147483648|2147483647] "1/m" Vector__XXX
 SG_ LAP_Vertical_Surface_C3 : 163|32@1- (1,0) [-2147483648|2147483647] "1/m2" Vector__XXX
 SG_ LAP_Path_Pred_Available : 195|1@1+ (1,0) [0|1] "" Vector__XXX
 SG_ LAP_Path_Pred_First_Valid : 196|1@1+ (1,0) [0|1] "" Vector__XXX
 SG_ LAP_Path_Pred_Second_Valid : 197|1@1+ (1,0) [0|1] "" Vector__XXX
 SG_ LAP_Path_Pred_Half_Width : 198|9@1+ (0.01,0) [0.00|5.11] "m" Vector__XXX
 SG_ LAP_Path_Pred_Conf : 207|7@1+ (0.01,0) [0.00|1.27] "" Vector__XXX
 SG_ LAP_Path_Pred_First_VR_End : 214|15@1+ (0.01,0) [0.00|327.67] "m" Vector__XXX
 SG_ LAP_Path_Pred_second_VR_End : 229|15@1+ (0.01,0) [0.00|327.67] "m" Vector__XXX
 SG_ LAP_Path_Pred_First_C0 : 244|32@1- (1,0) [-2147483648|2147483647] "m" Vector__XXX
 SG_ LAP_Path_Pred_First_C1 : 276|32@1- (1,0) [-2147483648|2147483647] "rad" Vector__XXX
 SG_ LAP_Path_Pred_First_C2 : 308|32@1- (1,0) [-2147483648|2147483647] "1/m" Vector__XXX
 SG_ LAP_Path_Pred_First_C3 : 340|32@1- (1,0) [-2147483648|2147483647] "1/m2" Vector__XXX
 SG_ LAP_Path_Pred_Second_C0 : 372|32@1- (1,0) [-2147483648|2147483647] "m" Vector__XXX
 SG_ LAP_Path_Pred_Second_C1 : 404|32@1- (1,0) [-2147483648|2147483647] "rad" Vector__XXX
 SG_ LAP_Path_Pred_Second_C2 : 436|32@1- (1,0) [-2147483648|2147483647] "m" Vector__XXX
 SG_ LAP_Path_Pred_Second_C3 : 468|32@1- (1,0) [-2147483648|2147483647] "1/m2" Vector__XXX

BO_ 297 FVCM_Lane_A: 64 FVCM
 SG_ Lane_A_Head_CRC : 0|16@1+ (1,0) [0|65535] "" Vector__XXX
 SG_ Lane_A_Head_ALIVE : 16|8@1+ (1,0) [0|255] "" Vector__XXX
 SG_ Lane_A_Head_SyncCounter : 24|8@1+ (1,0) [0|255] "" Vector__XXX
 SG_ LaneIsBlockedLeft : 32|1@1+ (1,0) [0|1] "" Vector__XXX
 SG_ LaneIsBlockedRight : 33|1@1+ (1,0) [0|1] "" Vector__XXX
 SG_ Lane0_C1 : 34|9@1+ (0.01,-2) [-2.00|3.11] "rad" Vector__XXX
 SG_ Lane0_C2 : 43|15@1+ (0.000016,-0.25) [-0.250000|0.274272] "1/m" Vector__XXX
 SG_ Lane0_C3 : 58|20@1+ (5.0E-008,-0.024) [-0.024000000|0.028428750] "1/m2" Vector__XXX
 SG_ Lane0_MarkerColor : 78|3@1+ (1,0) [0|7] "" Vector__XXX
 SG_ Lane0_ViewRangeEnd : 81|15@1+ (0.01,0) [0.00|327.67] "m" Vector__XXX
 SG_ Lane0_ViewRangeStart : 96|15@1+ (0.01,0) [0.00|327.67] "m" Vector__XXX
 SG_ Lane0_C0 : 111|13@1+ (0.01,-30) [-30.00|51.91] "m" Vector__XXX
 SG_ Lane0_ExistProb : 124|6@1+ (0.02,0) [0.00|1.26] "" Vector__XXX
 SG_ Lane0_ID : 130|8@1+ (1,0) [0|255] "" Vector__XXX
 SG_ Lane0_LineWidth : 138|7@1+ (0.01,0) [0.00|1.27] "m" Vector__XXX
 SG_ Lane0_MeasureType : 145|2@1+ (1,0) [0|3] "" Vector__XXX
 SG_ Lane0_MarkerType : 147|4@1+ (1,0) [0|15] "" Vector__XXX
 SG_ Lane0_TypeConf : 151|7@1+ (0.01,0) [0.00|1.27] "" Vector__XXX
 SG_ Lane1_C1 : 158|9@1+ (0.01,-2) [-2.00|3.11] "rad" Vector__XXX
 SG_ Lane1_C2 : 167|15@1+ (0.000016,-0.25) [-0.250000|0.274272] "1/m" Vector__XXX
 SG_ Lane1_C3 : 182|20@1+ (5.0E-008,-0.024) [-0.024000000|0.028428750] "1/m2" Vector__XXX
 SG_ Lane1_MarkerColor : 202|3@1+ (1,0) [0|7] "" Vector__XXX
 SG_ Lane1_ViewRangeEnd : 205|15@1+ (0.01,0) [0.00|327.67] "m" Vector__XXX
 SG_ Lane1_ViewRangeStart : 220|15@1+ (0.01,0) [0.00|327.67] "m" Vector__XXX
 SG_ Lane1_C0 : 235|13@1+ (0.01,-30) [-30.00|51.91] "m" Vector__XXX
 SG_ Lane1_ExistProb : 248|6@1+ (0.02,0) [0.00|1.26] "" Vector__XXX
 SG_ Lane1_ID : 254|8@1+ (1,0) [0|255] "" Vector__XXX
 SG_ Lane1_LineWidth : 262|7@1+ (0.01,0) [0.00|1.27] "m" Vector__XXX
 SG_ Lane1_MeasureType : 269|2@1+ (1,0) [0|3] "" Vector__XXX
 SG_ Lane1_MarkerType : 271|4@1+ (1,0) [0|15] "" Vector__XXX
 SG_ Lane1_TypeConf : 275|7@1+ (0.01,0) [0.00|1.27] "" Vector__XXX

BO_ 298 FVCM_Lane_B: 64 FVCM
 SG_ Lane_B_Head_CRC : 0|16@1+ (1,0) [0|65535] "" Vector__XXX
 SG_ Lane_B_Head_ALIVE : 16|8@1+ (1,0) [0|255] "" Vector__XXX
 SG_ Lane_B_Head_SyncCounter : 24|8@1+ (1,0) [0|255] "" Vector__XXX
 SG_ Lane2_C1 : 32|9@1+ (0.01,-2) [-2.00|3.11] "rad" Vector__XXX
 SG_ Lane2_C2 : 41|15@1+ (0.000016,-0.25) [-0.250000|0.274272] "1/m" Vector__XXX
 SG_ Lane2_C3 : 56|20@1+ (5.0E-008,-0.024) [-0.024000000|0.028428750] "1/m2" Vector__XXX
 SG_ Lane2_MarkerColor : 76|3@1+ (1,0) [0|7] "" Vector__XXX
 SG_ Lane2_ViewRangeEnd : 79|15@1+ (0.01,0) [0.00|327.67] "m" Vector__XXX
 SG_ Lane2_ViewRangeStart : 94|15@1+ (0.01,0) [0.00|327.67] "m" Vector__XXX
 SG_ Lane2_C0 : 109|13@1+ (0.01,-30) [-30.00|51.91] "m" Vector__XXX
 SG_ Lane2_ExistProb : 122|6@1+ (0.02,0) [0.00|1.26] "" Vector__XXX
 SG_ Lane2_ID : 128|8@1+ (1,0) [0|255] "" Vector__XXX
 SG_ Lane2_LineWidth : 136|7@1+ (0.01,0) [0.00|1.27] "m" Vector__XXX
 SG_ Lane2_MeasureType : 143|2@1+ (1,0) [0|3] "" Vector__XXX
 SG_ Lane2_MarkerType : 145|4@1+ (1,0) [0|15] "" Vector__XXX
 SG_ Lane2_TypeConf : 149|7@1+ (0.01,0) [0.00|1.27] "" Vector__XXX
 SG_ Lane3_C1 : 156|9@1+ (0.01,-2) [-2.00|3.11] "rad" Vector__XXX
 SG_ Lane3_C2 : 165|15@1+ (0.000016,-0.25) [-0.250000|0.274272] "1/m" Vector__XXX
 SG_ Lane3_C3 : 180|20@1+ (5.0E-008,-0.024) [-0.024000000|0.028428750] "1/m2" Vector__XXX
 SG_ Lane3_MarkerColor : 200|3@1+ (1,0) [0|7] "" Vector__XXX
 SG_ Lane3_ViewRangeEnd : 203|15@1+ (0.01,0) [0.00|327.67] "m" Vector__XXX
 SG_ Lane3_ViewRangeStart : 218|15@1+ (0.01,0) [0.00|327.67] "m" Vector__XXX
 SG_ Lane3_C0 : 233|13@1+ (0.01,-30) [-30.00|51.91] "m" Vector__XXX
 SG_ Lane3_ExistProb : 246|6@1+ (0.02,0) [0.00|1.26] "" Vector__XXX
 SG_ Lane3_ID : 252|8@1+ (1,0) [0|255] "" Vector__XXX
 SG_ Lane3_LineWidth : 260|7@1+ (0.01,0) [0.00|1.27] "m" Vector__XXX
 SG_ Lane3_MeasureType : 267|2@1+ (1,0) [0|3] "" Vector__XXX
 SG_ Lane3_MarkerType : 269|4@1+ (1,0) [0|15] "" Vector__XXX
 SG_ Lane3_TypeConf : 273|7@1+ (0.01,0) [0.00|1.27] "" Vector__XXX

BO_ 257 FVCM_Obj00_A: 64 FVCM
 SG_ OD_00_A_Head_CRC : 0|16@1+ (1,0) [0|65535] "" Vector__XXX
 SG_ OD_00_A_Head_ALIVE : 16|8@1+ (1,0) [0|255] "" Vector__XXX
 SG_ Obj_00_Id_A : 24|8@1+ (1,0) [0|255] "" Vector__XXX
 SG_ Obj_00_SyncCounter_A : 32|8@1+ (1,0) [0|255] "" Vector__XXX
 SG_ Obj_00_ExistPrblty : 40|8@1+ (0.01,0) [0.00|2.55] "" Vector__XXX
 SG_ Obj_00_MotionCategory : 48|4@1+ (1,0) [0|15] "" Vector__XXX
 SG_ Obj_00_Age : 52|11@1+ (1,0) [0|2047] "" Vector__XXX
 SG_ Obj_00_MeasSts : 63|3@1+ (1,0) [0|7] "" Vector__XXX
 SG_ Obj_00_Typ : 66|4@1+ (1,0) [0|15] "" Vector__XXX
 SG_ Obj_00_ClassProbability : 70|7@1+ (0.01,0) [0.00|1.27] "" Vector__XXX
 SG_ Obj_00_MotionSts : 77|3@1+ (1,0) [0|7] "" Vector__XXX
 SG_ Obj_00_MotionOrientation : 80|4@1+ (1,0) [0|15] "" Vector__XXX
 SG_ Obj_00_BrakeLight : 84|1@1+ (1,0) [0|1] "" Vector__XXX
 SG_ Obj_00_TurnIndicatorRight : 85|1@1+ (1,0) [0|1] "" Vector__XXX
 SG_ Obj_00_TurnIndicatorLeft : 86|1@1+ (1,0) [0|1] "" Vector__XXX
 SG_ Obj_00_LightIndicatorValidity : 87|1@1+ (1,0) [0|1] "" Vector__XXX
 SG_ Obj_00_LaneAssignment : 88|3@1+ (1,0) [0|7] "" Vector__XXX
 SG_ Obj_00_LaneAssignmentV : 91|1@1+ (1,0) [0|1] "" Vector__XXX
 SG_ Obj_00_Width : 92|9@1+ (0.01,0.4) [0.40|5.51] "m" Vector__XXX
 SG_ Obj_00_WidthV : 101|1@1+ (1,0) [0|1] "" Vector__XXX
 SG_ Obj_00_WidthSTD : 102|11@1+ (0.001,0) [0.000|2.047] "m" Vector__XXX
 SG_ Obj_00_WidthSTDV : 113|1@1+ (1,0) [0|1] "" Vector__XXX
 SG_ Obj_00_Length : 114|9@1+ (0.05,1.2) [1.20|26.75] "m" Vector__XXX
 SG_ Obj_00_LengthV : 123|1@1+ (1,0) [0|1] "" Vector__XXX
 SG_ Obj_00_LengthSTD : 124|10@1+ (0.01,0) [0.00|10.23] "m" Vector__XXX
 SG_ Obj_00_LengthSTDV : 134|1@1+ (1,0) [0|1] "" Vector__XXX
 SG_ Obj_00_RadarID : 135|8@1+ (1,0) [0|255] "" Vector__XXX
 SG_ Obj_00_Height : 143|9@1+ (0.01,0) [0.00|5.11] "m" Vector__XXX
 SG_ Obj_00_HeightV : 152|1@1+ (1,0) [0|1] "" Vector__XXX
 SG_ Obj_00_HeightSTD : 153|11@1+ (0.001,0) [0.000|2.047] "m" Vector__XXX
 SG_ Obj_00_HeightSTDV : 164|1@1+ (1,0) [0|1] "" Vector__XXX
 SG_ Obj_00_Heading : 165|10@1+ (0.01,-3.14) [-3.14|7.09] "rad" Vector__XXX
 SG_ Obj_00_HeadingV : 175|1@1+ (1,0) [0|1] "" Vector__XXX
 SG_ Obj_00_HeadingSTD : 176|15@1+ (0.00010,0) [0.00000|3.27670] "rad" Vector__XXX
 SG_ Obj_00_HeadingSTDV : 191|1@1+ (1,0) [0|1] "" Vector__XXX
 SG_ Obj_00_AngleRateSTD : 192|15@1+ (0.00010,0) [0.00000|3.27670] "RPS" Vector__XXX
 SG_ Obj_00_AngleRateSTDV : 207|1@1+ (1,0) [0|1] "" Vector__XXX
 SG_ Obj_00_AngleRate : 208|12@1+ (0.002,-2.234) [-2.234|5.956] "RPS" Vector__XXX
 SG_ Obj_00_AngleRateV : 220|1@1+ (1,0) [0|1] "" Vector__XXX
 SG_ Obj_00_AngleRight : 221|14@1+ (0.00020,-1.571) [-1.57100|1.70560] "rad" Vector__XXX
 SG_ Obj_00_AngleRightV : 235|1@1+ (1,0) [0|1] "" Vector__XXX
 SG_ Obj_00_AngleRightSTD : 236|14@1+ (0.00010,0) [0.00000|1.63830] "rad" Vector__XXX
 SG_ Obj_00_AngleRightSTDV : 250|1@1+ (1,0) [0|1] "" Vector__XXX
 SG_ Obj_00_AngleLeft : 251|14@1+ (0.00020,-1.571) [-1.57100|1.70560] "rad" Vector__XXX
 SG_ Obj_00_AngleLeftV : 265|1@1+ (1,0) [0|1] "" Vector__XXX
 SG_ Obj_00_AngleLeftSTD : 266|14@1+ (0.00010,0) [0.00000|1.63830] "rad" Vector__XXX
 SG_ Obj_00_AngleLeftSTDV : 280|1@1+ (1,0) [0|1] "" Vector__XXX
 SG_ Obj_00_AngleSide : 281|14@1+ (0.00020,-1.571) [-1.57100|1.70560] "rad" Vector__XXX
 SG_ Obj_00_AngleSideV : 295|1@1+ (1,0) [0|1] "" Vector__XXX
 SG_ Obj_00_AngleSideSTD : 296|14@1+ (0.00010,0) [0.00000|1.63830] "rad" Vector__XXX
 SG_ Obj_00_AngleSideSTDV : 310|1@1+ (1,0) [0|1] "" Vector__XXX
 SG_ Obj_00_AngleBottomV : 311|1@1+ (1,0) [0|1] "" Vector__XXX
 SG_ Obj_00_AngleBottom : 312|14@1+ (0.00020,-1.571) [-1.57100|1.70560] "rad" Vector__XXX
 SG_ Obj_00_AngleBottomSTD : 326|14@1+ (0.00010,0) [0.00000|1.63830] "rad" Vector__XXX
 SG_ Obj_00_AngleBottomSTDV : 340|1@1+ (1,0) [0|1] "" Vector__XXX

BO_ 258 FVCM_Obj00_B: 64 FVCM
 SG_ OD_00_B_Head_CRC : 0|16@1+ (1,0) [0|65535] "" Vector__XXX
 SG_ OD_00_B_Head_ALIVE : 16|8@1+ (1,0) [0|255] "" Vector__XXX
 SG_ Obj_00_Id_B : 24|8@1+ (1,0) [0|255] "" Vector__XXX
 SG_ Obj_00_SyncCounter_B : 32|8@1+ (1,0) [0|255] "" Vector__XXX
 SG_ Obj_00_AbsLongVelocity : 40|12@1+ (0.05,-100) [-100.00|104.75] "m/s" Vector__XXX
 SG_ Obj_00_AbsLongVelocityV : 52|1@1+ (1,0) [0|1] "" Vector__XXX
 SG_ Obj_00_AbsLongVelocitySTD : 53|13@1+ (0.01,0) [0.00|81.91] "m/s" Vector__XXX
 SG_ Obj_00_AbsLongVelSTDV : 66|1@1+ (1,0) [0|1] "" Vector__XXX
 SG_ Obj_00_AbsLatVelocity : 67|11@1+ (0.05,-50) [-50.00|52.35] "m/s" Vector__XXX
 SG_ Obj_00_AbsLatVelocityV : 78|1@1+ (1,0) [0|1] "" Vector__XXX
 SG_ Obj_00_AbsLatVelocitySTD : 79|13@1+ (0.01,0) [0.00|81.91] "m/s" Vector__XXX
 SG_ Obj_00_AbsLatVelSTDV : 92|1@1+ (1,0) [0|1] "" Vector__XXX
 SG_ Obj_00_AbsLongAcc : 93|9@1+ (0.05,-10) [-10.00|15.55] "m/s²" Vector__XXX
 SG_ Obj_00_AbsLongAccV : 102|1@1+ (1,0) [0|1] "" Vector__XXX
 SG_ Obj_00_AbsLongAccSTD : 103|10@1+ (0.01,0) [0.00|10.23] "m/s²" Vector__XXX
 SG_ Obj_00_AbsLongAccSTDV : 113|1@1+ (1,0) [0|1] "" Vector__XXX
 SG_ Obj_00_AbsLatAcc : 114|9@1+ (0.05,-10) [-10.00|15.55] "m/s²" Vector__XXX
 SG_ Obj_00_AbsLatAccV : 123|1@1+ (1,0) [0|1] "" Vector__XXX
 SG_ Obj_00_AbsLatAccSTD : 124|10@1+ (0.01,0) [0.00|10.23] "m/s²" Vector__XXX
 SG_ Obj_00_AbsLatAccSTDV : 134|1@1+ (1,0) [0|1] "" Vector__XXX
 SG_ Obj_00_AbsAcceleration : 135|9@1+ (0.05,-12.7) [-12.70|12.85] "m/s²" Vector__XXX
 SG_ Obj_00_AbsAccelerationV : 144|1@1+ (1,0) [0|1] "" Vector__XXX
 SG_ Obj_00_AbsAccSTD : 145|10@1+ (0.01,0) [0.00|10.23] "m/s²" Vector__XXX
 SG_ Obj_00_AbsAccSTDV : 155|1@1+ (1,0) [0|1] "" Vector__XXX
 SG_ Obj_00_InvTTC : 156|11@1+ (0.01,-8) [-8.00|12.47] "1/s" Vector__XXX
 SG_ Obj_00_InvTTCV : 167|1@1+ (1,0) [0|1] "" Vector__XXX
 SG_ Obj_00_InvTTCSTD : 168|12@1+ (0.001,0) [0.000|4.095] "1/s" Vector__XXX
 SG_ Obj_00_InvTTCSTDV : 180|1@1+ (1,0) [0|1] "" Vector__XXX
 SG_ Obj_00_RelativeLongAcc : 181|10@1+ (0.05,-20) [-20.00|31.15] "m/s²" Vector__XXX
 SG_ Obj_00_RelativeLongAccV : 191|1@1+ (1,0) [0|1] "" Vector__XXX
 SG_ Obj_00_RelativeLongAccSTD : 192|10@1+ (0.01,0) [0.00|10.23] "m/s²" Vector__XXX
 SG_ Obj_00_RelLongAccSTDV : 202|1@1+ (1,0) [0|1] "" Vector__XXX
 SG_ Obj_00_LongtRltvSpd : 203|13@1+ (0.05,-120) [-120.00|289.55] "m/s" Vector__XXX
 SG_ Obj_00_LongtRltvSpdV : 216|1@1+ (1,0) [0|1] "" Vector__XXX
 SG_ Obj_00_LongtRltvSpdSTD : 217|14@1+ (0.01,0) [0.00|163.83] "m/s" Vector__XXX
 SG_ Obj_00_LongtRltvSpdSTDV : 231|1@1+ (1,0) [0|1] "" Vector__XXX
 SG_ Obj_00_RelativeLatVelocity : 232|11@1+ (0.05,-50) [-50.00|52.35] "m/s" Vector__XXX
 SG_ Obj_00_RelativeLatVelocityV : 243|1@1+ (1,0) [0|1] "" Vector__XXX
 SG_ Obj_00_RelativeLatVelocitySTD : 244|13@1+ (0.01,0) [0.00|81.91] "m/s" Vector__XXX
 SG_ Obj_00_RelLatVelSTDV : 257|1@1+ (1,0) [0|1] "" Vector__XXX
 SG_ Obj_00_LongtRltvDist : 258|14@1+ (0.05,-200) [-200.00|619.15] "m" Vector__XXX
 SG_ Obj_00_LongDistanceV : 272|1@1+ (1,0) [0|1] "" Vector__XXX
 SG_ Obj_00_LongDistanceSTD : 273|15@1+ (0.01,0) [0.00|327.67] "m" Vector__XXX
 SG_ Obj_00_LongDistanceSTDV : 288|1@1+ (1,0) [0|1] "" Vector__XXX
 SG_ Obj_00_LatRltvDist : 289|12@1+ (0.05,-100) [-100.00|104.75] "m" Vector__XXX
 SG_ Obj_00_LatDistanceV : 301|1@1+ (1,0) [0|1] "" Vector__XXX
 SG_ Obj_00_LatDistanceSTD : 302|14@1+ (0.01,0) [0.00|163.83] "m" Vector__XXX
 SG_ Obj_00_LatDistanceSTDV : 316|1@1+ (1,0) [0|1] "" Vector__XXX
 SG_ Obj_00_AbsoluteSpeed : 317|12@1+ (0.05,-65) [-65.00|139.75] "m/s" Vector__XXX
 SG_ Obj_00_AbsoluteSpeedV : 329|1@1+ (1,0) [0|1] "" Vector__XXX
 SG_ Obj_00_AbsoluteSpeedSTD : 330|13@1+ (0.01,0) [0.00|81.91] "m/s" Vector__XXX
 SG_ Obj_00_AbsoluteSpeedSTDV : 343|1@1+ (1,0) [0|1] "" Vector__XXX

BO_ 259 FVCM_Obj01_A: 64 FVCM
 SG_ OD_01_A_Head_CRC : 0|16@1+ (1,0) [0|65535] "" Vector__XXX
 SG_ OD_01_A_Head_ALIVE : 16|8@1+ (1,0) [0|255] "" Vector__XXX
 SG_ Obj_01_Id_A : 24|8@1+ (1,0) [0|255] "" Vector__XXX
 SG_ Obj_01_SyncCounter_A : 32|8@1+ (1,0) [0|255] "" Vector__XXX
 SG_ Obj_01_ExistPrblty : 40|8@1+ (0.01,0) [0.00|2.55] "" Vector__XXX
 SG_ Obj_01_MotionCategory : 48|4@1+ (1,0) [0|15] "" Vector__XXX
 SG_ Obj_01_Age : 52|11@1+ (1,0) [0|2047] "" Vector__XXX
 SG_ Obj_01_MeasSts : 63|3@1+ (1,0) [0|7] "" Vector__XXX
 SG_ Obj_01_Typ : 66|4@1+ (1,0) [0|15] "" Vector__XXX
 SG_ Obj_01_ClassProbability : 70|7@1+ (0.01,0) [0.00|1.27] "" Vector__XXX
 SG_ Obj_01_MotionSts : 77|3@1+ (1,0) [0|7] "" Vector__XXX
 SG_ Obj_01_MotionOrientation : 80|4@1+ (1,0) [0|15] "" Vector__XXX
 SG_ Obj_01_BrakeLight : 84|1@1+ (1,0) [0|1] "" Vector__XXX
 SG_ Obj_01_TurnIndicatorRight : 85|1@1+ (1,0) [0|1] "" Vector__XXX
 SG_ Obj_01_TurnIndicatorLeft : 86|1@1+ (1,0) [0|1] "" Vector__XXX
 SG_ Obj_01_LightIndicatorValidity : 87|1@1+ (1,0) [0|1] "" Vector__XXX
 SG_ Obj_01_LaneAssignment : 88|3@1+ (1,0) [0|7] "" Vector__XXX
 SG_ Obj_01_LaneAssignmentV : 91|1@1+ (1,0) [0|1] "" Vector__XXX
 SG_ Obj_01_Width : 92|9@1+ (0.01,0.4) [0.40|5.51] "m" Vector__XXX
 SG_ Obj_01_WidthV : 101|1@1+ (1,0) [0|1] "" Vector__XXX
 SG_ Obj_01_WidthSTD : 102|11@1+ (0.001,0) [0.000|2.047] "m" Vector__XXX
 SG_ Obj_01_WidthSTDV : 113|1@1+ (1,0) [0|1] "" Vector__XXX
 SG_ Obj_01_Length : 114|9@1+ (0.05,1.2) [1.20|26.75] "m" Vector__XXX
 SG_ Obj_01_LengthV : 123|1@1+ (1,0) [0|1] "" Vector__XXX
 SG_ Obj_01_LengthSTD : 124|10@1+ (0.01,0) [0.00|10.23] "m" Vector__XXX
 SG_ Obj_01_LengthSTDV : 134|1@1+ (1,0) [0|1] "" Vector__XXX
 SG_ Obj_01_RadarID : 135|8@1+ (1,0) [0|255] "" Vector__XXX
 SG_ Obj_01_Height : 143|9@1+ (0.01,0) [0.00|5.11] "m" Vector__XXX
 SG_ Obj_01_HeightV : 152|1@1+ (1,0) [0|1] "" Vector__XXX
 SG_ Obj_01_HeightSTD : 153|11@1+ (0.001,0) [0.000|2.047] "m" Vector__XXX
 SG_ Obj_01_HeightSTDV : 164|1@1+ (1,0) [0|1] "" Vector__XXX
 SG_ Obj_01_Heading : 165|10@1+ (0.01,-3.14) [-3.14|7.09] "rad" Vector__XXX
 SG_ Obj_01_HeadingV : 175|1@1+ (1,0) [0|1] "" Vector__XXX
 SG_ Obj_01_HeadingSTD : 176|15@1+ (0.00010,0) [0.00000|3.27670] "rad" Vector__XXX
 SG_ Obj_01_HeadingSTDV : 191|1@1+ (1,0) [0|1] "" Vector__XXX
 SG_ Obj_01_AngleRateSTD : 192|15@1+ (0.00010,0) [0.00000|3.27670] "RPS" Vector__XXX
 SG_ Obj_01_AngleRateSTDV : 207|1@1+ (1,0) [0|1] "" Vector__XXX
 SG_ Obj_01_AngleRate : 208|12@1+ (0.002,-2.234) [-2.234|5.956] "RPS" Vector__XXX
 SG_ Obj_01_AngleRateV : 220|1@1+ (1,0) [0|1] "" Vector__XXX
 SG_ Obj_01_AngleRight : 221|14@1+ (0.00020,-1.571) [-1.57100|1.70560] "rad" Vector__XXX
 SG_ Obj_01_AngleRightV : 235|1@1+ (1,0) [0|1] "" Vector__XXX
 SG_ Obj_01_AngleRightSTD : 236|14@1+ (0.00010,0) [0.00000|1.63830] "rad" Vector__XXX
 SG_ Obj_01_AngleRightSTDV : 250|1@1+ (1,0) [0|1] "" Vector__XXX
 SG_ Obj_01_AngleLeft : 251|14@1+ (0.00020,-1.571) [-1.57100|1.70560] "rad" Vector__XXX
 SG_ Obj_01_AngleLeftV : 265|1@1+ (1,0) [0|1] "" Vector__XXX
 SG_ Obj_01_AngleLeftSTD : 266|14@1+ (0.00010,0) [0.00000|1.63830] "rad" Vector__XXX
 SG_ Obj_01_AngleLeftSTDV : 280|1@1+ (1,0) [0|1] "" Vector__XXX
 SG_ Obj_01_AngleSide : 281|14@1+ (0.00020,-1.571) [-1.57100|1.70560] "rad" Vector__XXX
 SG_ Obj_01_AngleSideV : 295|1@1+ (1,0) [0|1] "" Vector__XXX
 SG_ Obj_01_AngleSideSTD : 296|14@1+ (0.00010,0) [0.00000|1.63830] "rad" Vector__XXX
 SG_ Obj_01_AngleSideSTDV : 310|1@1+ (1,0) [0|1] "" Vector__XXX
 SG_ Obj_01_AngleBottomV : 311|1@1+ (1,0) [0|1] "" Vector__XXX
 SG_ Obj_01_AngleBottom : 312|14@1+ (0.00020,-1.571) [-1.57100|1.70560] "rad" Vector__XXX
 SG_ Obj_01_AngleBottomSTD : 326|14@1+ (0.00010,0) [0.00000|1.63830] "rad" Vector__XXX
 SG_ Obj_01_AngleBottomSTDV : 340|1@1+ (1,0) [0|1] "" Vector__XXX

BO_ 260 FVCM_Obj01_B: 64 FVCM
 SG_ OD_01_B_Head_CRC : 0|16@1+ (1,0) [0|65535] "" Vector__XXX
 SG_ OD_01_B_Head_ALIVE : 16|8@1+ (1,0) [0|255] "" Vector__XXX
 SG_ Obj_01_Id_B : 24|8@1+ (1,0) [0|255] "" Vector__XXX
 SG_ Obj_01_SyncCounter_B : 32|8@1+ (1,0) [0|255] "" Vector__XXX
 SG_ Obj_01_AbsLongVelocity : 40|12@1+ (0.05,-100) [-100.00|104.75] "m/s" Vector__XXX
 SG_ Obj_01_AbsLongVelocityV : 52|1@1+ (1,0) [0|1] "" Vector__XXX
 SG_ Obj_01_AbsLongVelocitySTD : 53|13@1+ (0.01,0) [0.00|81.91] "m/s" Vector__XXX
 SG_ Obj_01_AbsLongVelSTDV : 66|1@1+ (1,0) [0|1] "" Vector__XXX
 SG_ Obj_01_AbsLatVelocity : 67|11@1+ (0.05,-50) [-50.00|52.35] "m/s" Vector__XXX
 SG_ Obj_01_AbsLatVelocityV : 78|1@1+ (1,0) [0|1] "" Vector__XXX
 SG_ Obj_01_AbsLatVelocitySTD : 79|13@1+ (0.01,0) [0.00|81.91] "m/s" Vector__XXX
 SG_ Obj_01_AbsLatVelSTDV : 92|1@1+ (1,0) [0|1] "" Vector__XXX
 SG_ Obj_01_AbsLongAcc : 93|9@1+ (0.05,-10) [-10.00|15.55] "m/s²" Vector__XXX
 SG_ Obj_01_AbsLongAccV : 102|1@1+ (1,0) [0|1] "" Vector__XXX
 SG_ Obj_01_AbsLongAccSTD : 103|10@1+ (0.01,0) [0.00|10.23] "m/s²" Vector__XXX
 SG_ Obj_01_AbsLongAccSTDV : 113|1@1+ (1,0) [0|1] "" Vector__XXX
 SG_ Obj_01_AbsLatAcc : 114|9@1+ (0.05,-10) [-10.00|15.55] "m/s²" Vector__XXX
 SG_ Obj_01_AbsLatAccV : 123|1@1+ (1,0) [0|1] "" Vector__XXX
 SG_ Obj_01_AbsLatAccSTD : 124|10@1+ (0.01,0) [0.00|10.23] "m/s²" Vector__XXX
 SG_ Obj_01_AbsLatAccSTDV : 134|1@1+ (1,0) [0|1] "" Vector__XXX
 SG_ Obj_01_AbsAcceleration : 135|9@1+ (0.05,-12.7) [-12.70|12.85] "m/s²" Vector__XXX
 SG_ Obj_01_AbsAccelerationV : 144|1@1+ (1,0) [0|1] "" Vector__XXX
 SG_ Obj_01_AbsAccSTD : 145|10@1+ (0.01,0) [0.00|10.23] "m/s²" Vector__XXX
 SG_ Obj_01_AbsAccSTDV : 155|1@1+ (1,0) [0|1] "" Vector__XXX
 SG_ Obj_01_InvTTC : 156|11@1+ (0.01,-8) [-8.00|12.47] "1/s" Vector__XXX
 SG_ Obj_01_InvTTCV : 167|1@1+ (1,0) [0|1] "" Vector__XXX
 SG_ Obj_01_InvTTCSTD : 168|12@1+ (0.001,0) [0.000|4.095] "1/s" Vector__XXX
 SG_ Obj_01_InvTTCSTDV : 180|1@1+ (1,0) [0|1] "" Vector__XXX
 SG_ Obj_01_RelativeLongAcc : 181|10@1+ (0.05,-20) [-20.00|31.15] "m/s²" Vector__XXX
 SG_ Obj_01_RelativeLongAccV : 191|1@1+ (1,0) [0|1] "" Vector__XXX
 SG_ Obj_01_RelativeLongAccSTD : 192|10@1+ (0.01,0) [0.00|10.23] "m/s²" Vector__XXX
 SG_ Obj_01_RelLongAccSTDV : 202|1@1+ (1,0) [0|1] "" Vector__XXX
 SG_ Obj_01_LongtRltvSpd : 203|13@1+ (0.05,-120) [-120.00|289.55] "m/s" Vector__XXX
 SG_ Obj_01_LongtRltvSpdV : 216|1@1+ (1,0) [0|1] "" Vector__XXX
 SG_ Obj_01_LongtRltvSpdSTD : 217|14@1+ (0.01,0) [0.00|163.83] "m/s" Vector__XXX
 SG_ Obj_01_LongtRltvSpdSTDV : 231|1@1+ (1,0) [0|1] "" Vector__XXX
 SG_ Obj_01_RelativeLatVelocity : 232|11@1+ (0.05,-50) [-50.00|52.35] "m/s" Vector__XXX
 SG_ Obj_01_RelativeLatVelocityV : 243|1@1+ (1,0) [0|1] "" Vector__XXX
 SG_ Obj_01_RelativeLatVelocitySTD : 244|13@1+ (0.01,0) [0.00|81.91] "m/s" Vector__XXX
 SG_ Obj_01_RelLatVelSTDV : 257|1@1+ (1,0) [0|1] "" Vector__XXX
 SG_ Obj_01_LongtRltvDist : 258|14@1+ (0.05,-200) [-200.00|619.15] "m" Vector__XXX
 SG_ Obj_01_LongDistanceV : 272|1@1+ (1,0) [0|1] "" Vector__XXX
 SG_ Obj_01_LongDistanceSTD : 273|15@1+ (0.01,0) [0.00|327.67] "m" Vector__XXX
 SG_ Obj_01_LongDistanceSTDV : 288|1@1+ (1,0) [0|1] "" Vector__XXX
 SG_ Obj_01_LatRltvDist : 289|12@1+ (0.05,-100) [-100.00|104.75] "m" Vector__XXX
 SG_ Obj_01_LatDistanceV : 301|1@1+ (1,0) [0|1] "" Vector__XXX
 SG_ Obj_01_LatDistanceSTD : 302|14@1+ (0.01,0) [0.00|163.83] "m" Vector__XXX
 SG_ Obj_01_LatDistanceSTDV : 316|1@1+ (1,0) [0|1] "" Vector__XXX
 SG_ Obj_01_AbsoluteSpeed : 317|12@1+ (0.05,-65) [-65.00|139.75] "m/s" Vector__XXX
 SG_ Obj_01_AbsoluteSpeedV : 329|1@1+ (1,0) [0|1] "" Vector__XXX
 SG_ Obj_01_AbsoluteSpeedSTD : 330|13@1+ (0.01,0) [0.00|81.91] "m/s" Vector__XXX
 SG_ Obj_01_AbsoluteSpeedSTDV : 343|1@1+ (1,0) [0|1] "" Vector__XXX

BO_ 261 FVCM_Obj02_A: 64 FVCM
 SG_ OD_02_A_Head_CRC : 0|16@1+ (1,0) [0|65535] "" Vector__XXX
 SG_ OD_02_A_Head_ALIVE : 16|8@1+ (1,0) [0|255] "" Vector__XXX
 SG_ Obj_02_Id_A : 24|8@1+ (1,0) [0|255] "" Vector__XXX
 SG_ Obj_02_SyncCounter_A : 32|8@1+ (1,0) [0|255] "" Vector__XXX
 SG_ Obj_02_ExistPrblty : 40|8@1+ (0.01,0) [0.00|2.55] "" Vector__XXX
 SG_ Obj_02_MotionCategory : 48|4@1+ (1,0) [0|15] "" Vector__XXX
 SG_ Obj_02_Age : 52|11@1+ (1,0) [0|2047] "" Vector__XXX
 SG_ Obj_02_MeasSts : 63|3@1+ (1,0) [0|7] "" Vector__XXX
 SG_ Obj_02_Typ : 66|4@1+ (1,0) [0|15] "" Vector__XXX
 SG_ Obj_02_ClassProbability : 70|7@1+ (0.01,0) [0.00|1.27] "" Vector__XXX
 SG_ Obj_02_MotionSts : 77|3@1+ (1,0) [0|7] "" Vector__XXX
 SG_ Obj_02_MotionOrientation : 80|4@1+ (1,0) [0|15] "" Vector__XXX
 SG_ Obj_02_BrakeLight : 84|1@1+ (1,0) [0|1] "" Vector__XXX
 SG_ Obj_02_TurnIndicatorRight : 85|1@1+ (1,0) [0|1] "" Vector__XXX
 SG_ Obj_02_TurnIndicatorLeft : 86|1@1+ (1,0) [0|1] "" Vector__XXX
 SG_ Obj_02_LightIndicatorValidity : 87|1@1+ (1,0) [0|1] "" Vector__XXX
 SG_ Obj_02_LaneAssignment : 88|3@1+ (1,0) [0|7] "" Vector__XXX
 SG_ Obj_02_LaneAssignmentV : 91|1@1+ (1,0) [0|1] "" Vector__XXX
 SG_ Obj_02_Width : 92|9@1+ (0.01,0.4) [0.40|5.51] "m" Vector__XXX
 SG_ Obj_02_WidthV : 101|1@1+ (1,0) [0|1] "" Vector__XXX
 SG_ Obj_02_WidthSTD : 102|11@1+ (0.001,0) [0.000|2.047] "m" Vector__XXX
 SG_ Obj_02_WidthSTDV : 113|1@1+ (1,0) [0|1] "" Vector__XXX
 SG_ Obj_02_Length : 114|9@1+ (0.05,1.2) [1.20|26.75] "m" Vector__XXX
 SG_ Obj_02_LengthV : 123|1@1+ (1,0) [0|1] "" Vector__XXX
 SG_ Obj_02_LengthSTD : 124|10@1+ (0.01,0) [0.00|10.23] "m" Vector__XXX
 SG_ Obj_02_LengthSTDV : 134|1@1+ (1,0) [0|1] "" Vector__XXX
 SG_ Obj_02_RadarID : 135|8@1+ (1,0) [0|255] "" Vector__XXX
 SG_ Obj_02_Height : 143|9@1+ (0.01,0) [0.00|5.11] "m" Vector__XXX
 SG_ Obj_02_HeightV : 152|1@1+ (1,0) [0|1] "" Vector__XXX
 SG_ Obj_02_HeightSTD : 153|11@1+ (0.001,0) [0.000|2.047] "m" Vector__XXX
 SG_ Obj_02_HeightSTDV : 164|1@1+ (1,0) [0|1] "" Vector__XXX
 SG_ Obj_02_Heading : 165|10@1+ (0.01,-3.14) [-3.14|7.09] "rad" Vector__XXX
 SG_ Obj_02_HeadingV : 175|1@1+ (1,0) [0|1] "" Vector__XXX
 SG_ Obj_02_HeadingSTD : 176|15@1+ (0.00010,0) [0.00000|3.27670] "rad" Vector__XXX
 SG_ Obj_02_HeadingSTDV : 191|1@1+ (1,0) [0|1] "" Vector__XXX
 SG_ Obj_02_AngleRateSTD : 192|15@1+ (0.00010,0) [0.00000|3.27670] "RPS" Vector__XXX
 SG_ Obj_02_AngleRateSTDV : 207|1@1+ (1,0) [0|1] "" Vector__XXX
 SG_ Obj_02_AngleRate : 208|12@1+ (0.002,-2.234) [-2.234|5.956] "RPS" Vector__XXX
 SG_ Obj_02_AngleRateV : 220|1@1+ (1,0) [0|1] "" Vector__XXX
 SG_ Obj_02_AngleRight : 221|14@1+ (0.00020,-1.571) [-1.57100|1.70560] "rad" Vector__XXX
 SG_ Obj_02_AngleRightV : 235|1@1+ (1,0) [0|1] "" Vector__XXX
 SG_ Obj_02_AngleRightSTD : 236|14@1+ (0.00010,0) [0.00000|1.63830] "rad" Vector__XXX
 SG_ Obj_02_AngleRightSTDV : 250|1@1+ (1,0) [0|1] "" Vector__XXX
 SG_ Obj_02_AngleLeft : 251|14@1+ (0.00020,-1.571) [-1.57100|1.70560] "rad" Vector__XXX
 SG_ Obj_02_AngleLeftV : 265|1@1+ (1,0) [0|1] "" Vector__XXX
 SG_ Obj_02_AngleLeftSTD : 266|14@1+ (0.00010,0) [0.00000|1.63830] "rad" Vector__XXX
 SG_ Obj_02_AngleLeftSTDV : 280|1@1+ (1,0) [0|1] "" Vector__XXX
 SG_ Obj_02_AngleSide : 281|14@1+ (0.00020,-1.571) [-1.57100|1.70560] "rad" Vector__XXX
 SG_ Obj_02_AngleSideV : 295|1@1+ (1,0) [0|1] "" Vector__XXX
 SG_ Obj_02_AngleSideSTD : 296|14@1+ (0.00010,0) [0.00000|1.63830] "rad" Vector__XXX
 SG_ Obj_02_AngleSideSTDV : 310|1@1+ (1,0) [0|1] "" Vector__XXX
 SG_ Obj_02_AngleBottomV : 311|1@1+ (1,0) [0|1] "" Vector__XXX
 SG_ Obj_02_AngleBottom : 312|14@1+ (0.00020,-1.571) [-1.57100|1.70560] "rad" Vector__XXX
 SG_ Obj_02_AngleBottomSTD : 326|14@1+ (0.00010,0) [0.00000|1.63830] "rad" Vector__XXX
 SG_ Obj_02_AngleBottomSTDV : 340|1@1+ (1,0) [0|1] "" Vector__XXX

BO_ 262 FVCM_Obj02_B: 64 FVCM
 SG_ OD_02_B_Head_CRC : 0|16@1+ (1,0) [0|65535] "" Vector__XXX
 SG_ OD_02_B_Head_ALIVE : 16|8@1+ (1,0) [0|255] "" Vector__XXX
 SG_ Obj_02_Id_B : 24|8@1+ (1,0) [0|255] "" Vector__XXX
 SG_ Obj_02_SyncCounter_B : 32|8@1+ (1,0) [0|255] "" Vector__XXX
 SG_ Obj_02_AbsLongVelocity : 40|12@1+ (0.05,-100) [-100.00|104.75] "m/s" Vector__XXX
 SG_ Obj_02_AbsLongVelocityV : 52|1@1+ (1,0) [0|1] "" Vector__XXX
 SG_ Obj_02_AbsLongVelocitySTD : 53|13@1+ (0.01,0) [0.00|81.91] "m/s" Vector__XXX
 SG_ Obj_02_AbsLongVelSTDV : 66|1@1+ (1,0) [0|1] "" Vector__XXX
 SG_ Obj_02_AbsLatVelocity : 67|11@1+ (0.05,-50) [-50.00|52.35] "m/s" Vector__XXX
 SG_ Obj_02_AbsLatVelocityV : 78|1@1+ (1,0) [0|1] "" Vector__XXX
 SG_ Obj_02_AbsLatVelocitySTD : 79|13@1+ (0.01,0) [0.00|81.91] "m/s" Vector__XXX
 SG_ Obj_02_AbsLatVelSTDV : 92|1@1+ (1,0) [0|1] "" Vector__XXX
 SG_ Obj_02_AbsLongAcc : 93|9@1+ (0.05,-10) [-10.00|15.55] "m/s²" Vector__XXX
 SG_ Obj_02_AbsLongAccV : 102|1@1+ (1,0) [0|1] "" Vector__XXX
 SG_ Obj_02_AbsLongAccSTD : 103|10@1+ (0.01,0) [0.00|10.23] "m/s²" Vector__XXX
 SG_ Obj_02_AbsLongAccSTDV : 113|1@1+ (1,0) [0|1] "" Vector__XXX
 SG_ Obj_02_AbsLatAcc : 114|9@1+ (0.05,-10) [-10.00|15.55] "m/s²" Vector__XXX
 SG_ Obj_02_AbsLatAccV : 123|1@1+ (1,0) [0|1] "" Vector__XXX
 SG_ Obj_02_AbsLatAccSTD : 124|10@1+ (0.01,0) [0.00|10.23] "m/s²" Vector__XXX
 SG_ Obj_02_AbsLatAccSTDV : 134|1@1+ (1,0) [0|1] "" Vector__XXX
 SG_ Obj_02_AbsAcceleration : 135|9@1+ (0.05,-12.7) [-12.70|12.85] "m/s²" Vector__XXX
 SG_ Obj_02_AbsAccelerationV : 144|1@1+ (1,0) [0|1] "" Vector__XXX
 SG_ Obj_02_AbsAccSTD : 145|10@1+ (0.01,0) [0.00|10.23] "m/s²" Vector__XXX
 SG_ Obj_02_AbsAccSTDV : 155|1@1+ (1,0) [0|1] "" Vector__XXX
 SG_ Obj_02_InvTTC : 156|11@1+ (0.01,-8) [-8.00|12.47] "1/s" Vector__XXX
 SG_ Obj_02_InvTTCV : 167|1@1+ (1,0) [0|1] "" Vector__XXX
 SG_ Obj_02_InvTTCSTD : 168|12@1+ (0.001,0) [0.000|4.095] "1/s" Vector__XXX
 SG_ Obj_02_InvTTCSTDV : 180|1@1+ (1,0) [0|1] "" Vector__XXX
 SG_ Obj_02_RelativeLongAcc : 181|10@1+ (0.05,-20) [-20.00|31.15] "m/s²" Vector__XXX
 SG_ Obj_02_RelativeLongAccV : 191|1@1+ (1,0) [0|1] "" Vector__XXX
 SG_ Obj_02_RelativeLongAccSTD : 192|10@1+ (0.01,0) [0.00|10.23] "m/s²" Vector__XXX
 SG_ Obj_02_RelLongAccSTDV : 202|1@1+ (1,0) [0|1] "" Vector__XXX
 SG_ Obj_02_LongtRltvSpd : 203|13@1+ (0.05,-120) [-120.00|289.55] "m/s" Vector__XXX
 SG_ Obj_02_LongtRltvSpdV : 216|1@1+ (1,0) [0|1] "" Vector__XXX
 SG_ Obj_02_LongtRltvSpdSTD : 217|14@1+ (0.01,0) [0.00|163.83] "m/s" Vector__XXX
 SG_ Obj_02_LongtRltvSpdSTDV : 231|1@1+ (1,0) [0|1] "" Vector__XXX
 SG_ Obj_02_RelativeLatVelocity : 232|11@1+ (0.05,-50) [-50.00|52.35] "m/s" Vector__XXX
 SG_ Obj_02_RelativeLatVelocityV : 243|1@1+ (1,0) [0|1] "" Vector__XXX
 SG_ Obj_02_RelativeLatVelocitySTD : 244|13@1+ (0.01,0) [0.00|81.91] "m/s" Vector__XXX
 SG_ Obj_02_RelLatVelSTDV : 257|1@1+ (1,0) [0|1] "" Vector__XXX
 SG_ Obj_02_LongtRltvDist : 258|14@1+ (0.05,-200) [-200.00|619.15] "m" Vector__XXX
 SG_ Obj_02_LongDistanceV : 272|1@1+ (1,0) [0|1] "" Vector__XXX
 SG_ Obj_02_LongDistanceSTD : 273|15@1+ (0.01,0) [0.00|327.67] "m" Vector__XXX
 SG_ Obj_02_LongDistanceSTDV : 288|1@1+ (1,0) [0|1] "" Vector__XXX
 SG_ Obj_02_LatRltvDist : 289|12@1+ (0.05,-100) [-100.00|104.75] "m" Vector__XXX
 SG_ Obj_02_LatDistanceV : 301|1@1+ (1,0) [0|1] "" Vector__XXX
 SG_ Obj_02_LatDistanceSTD : 302|14@1+ (0.01,0) [0.00|163.83] "m" Vector__XXX
 SG_ Obj_02_LatDistanceSTDV : 316|1@1+ (1,0) [0|1] "" Vector__XXX
 SG_ Obj_02_AbsoluteSpeed : 317|12@1+ (0.05,-65) [-65.00|139.75] "m/s" Vector__XXX
 SG_ Obj_02_AbsoluteSpeedV : 329|1@1+ (1,0) [0|1] "" Vector__XXX
 SG_ Obj_02_AbsoluteSpeedSTD : 330|13@1+ (0.01,0) [0.00|81.91] "m/s" Vector__XXX
 SG_ Obj_02_AbsoluteSpeedSTDV : 343|1@1+ (1,0) [0|1] "" Vector__XXX

BO_ 263 FVCM_Obj03_A: 64 FVCM
 SG_ OD_03_A_Head_CRC : 0|16@1+ (1,0) [0|65535] "" Vector__XXX
 SG_ OD_03_A_Head_ALIVE : 16|8@1+ (1,0) [0|255] "" Vector__XXX
 SG_ Obj_03_Id_A : 24|8@1+ (1,0) [0|255] "" Vector__XXX
 SG_ Obj_03_SyncCounter_A : 32|8@1+ (1,0) [0|255] "" Vector__XXX
 SG_ Obj_03_ExistPrblty : 40|8@1+ (0.01,0) [0.00|2.55] "" Vector__XXX
 SG_ Obj_03_MotionCategory : 48|4@1+ (1,0) [0|15] "" Vector__XXX
 SG_ Obj_03_Age : 52|11@1+ (1,0) [0|2047] "" Vector__XXX
 SG_ Obj_03_MeasSts : 63|3@1+ (1,0) [0|7] "" Vector__XXX
 SG_ Obj_03_Typ : 66|4@1+ (1,0) [0|15] "" Vector__XXX
 SG_ Obj_03_ClassProbability : 70|7@1+ (0.01,0) [0.00|1.27] "" Vector__XXX
 SG_ Obj_03_MotionSts : 77|3@1+ (1,0) [0|7] "" Vector__XXX
 SG_ Obj_03_MotionOrientation : 80|4@1+ (1,0) [0|15] "" Vector__XXX
 SG_ Obj_03_BrakeLight : 84|1@1+ (1,0) [0|1] "" Vector__XXX
 SG_ Obj_03_TurnIndicatorRight : 85|1@1+ (1,0) [0|1] "" Vector__XXX
 SG_ Obj_03_TurnIndicatorLeft : 86|1@1+ (1,0) [0|1] "" Vector__XXX
 SG_ Obj_03_LightIndicatorValidity : 87|1@1+ (1,0) [0|1] "" Vector__XXX
 SG_ Obj_03_LaneAssignment : 88|3@1+ (1,0) [0|7] "" Vector__XXX
 SG_ Obj_03_LaneAssignmentV : 91|1@1+ (1,0) [0|1] "" Vector__XXX
 SG_ Obj_03_Width : 92|9@1+ (0.01,0.4) [0.40|5.51] "m" Vector__XXX
 SG_ Obj_03_WidthV : 101|1@1+ (1,0) [0|1] "" Vector__XXX
 SG_ Obj_03_WidthSTD : 102|11@1+ (0.001,0) [0.000|2.047] "m" Vector__XXX
 SG_ Obj_03_WidthSTDV : 113|1@1+ (1,0) [0|1] "" Vector__XXX
 SG_ Obj_03_Length : 114|9@1+ (0.05,1.2) [1.20|26.75] "m" Vector__XXX
 SG_ Obj_03_LengthV : 123|1@1+ (1,0) [0|1] "" Vector__XXX
 SG_ Obj_03_LengthSTD : 124|10@1+ (0.01,0) [0.00|10.23] "m" Vector__XXX
 SG_ Obj_03_LengthSTDV : 134|1@1+ (1,0) [0|1] "" Vector__XXX
 SG_ Obj_03_RadarID : 135|8@1+ (1,0) [0|255] "" Vector__XXX
 SG_ Obj_03_Height : 143|9@1+ (0.01,0) [0.00|5.11] "m" Vector__XXX
 SG_ Obj_03_HeightV : 152|1@1+ (1,0) [0|1] "" Vector__XXX
 SG_ Obj_03_HeightSTD : 153|11@1+ (0.001,0) [0.000|2.047] "m" Vector__XXX
 SG_ Obj_03_HeightSTDV : 164|1@1+ (1,0) [0|1] "" Vector__XXX
 SG_ Obj_03_Heading : 165|10@1+ (0.01,-3.14) [-3.14|7.09] "rad" Vector__XXX
 SG_ Obj_03_HeadingV : 175|1@1+ (1,0) [0|1] "" Vector__XXX
 SG_ Obj_03_HeadingSTD : 176|15@1+ (0.00010,0) [0.00000|3.27670] "rad" Vector__XXX
 SG_ Obj_03_HeadingSTDV : 191|1@1+ (1,0) [0|1] "" Vector__XXX
 SG_ Obj_03_AngleRateSTD : 192|15@1+ (0.00010,0) [0.00000|3.27670] "RPS" Vector__XXX
 SG_ Obj_03_AngleRateSTDV : 207|1@1+ (1,0) [0|1] "" Vector__XXX
 SG_ Obj_03_AngleRate : 208|12@1+ (0.002,-2.234) [-2.234|5.956] "RPS" Vector__XXX
 SG_ Obj_03_AngleRateV : 220|1@1+ (1,0) [0|1] "" Vector__XXX
 SG_ Obj_03_AngleRight : 221|14@1+ (0.00020,-1.571) [-1.57100|1.70560] "rad" Vector__XXX
 SG_ Obj_03_AngleRightV : 235|1@1+ (1,0) [0|1] "" Vector__XXX
 SG_ Obj_03_AngleRightSTD : 236|14@1+ (0.00010,0) [0.00000|1.63830] "rad" Vector__XXX
 SG_ Obj_03_AngleRightSTDV : 250|1@1+ (1,0) [0|1] "" Vector__XXX
 SG_ Obj_03_AngleLeft : 251|14@1+ (0.00020,-1.571) [-1.57100|1.70560] "rad" Vector__XXX
 SG_ Obj_03_AngleLeftV : 265|1@1+ (1,0) [0|1] "" Vector__XXX
 SG_ Obj_03_AngleLeftSTD : 266|14@1+ (0.00010,0) [0.00000|1.63830] "rad" Vector__XXX
 SG_ Obj_03_AngleLeftSTDV : 280|1@1+ (1,0) [0|1] "" Vector__XXX
 SG_ Obj_03_AngleSide : 281|14@1+ (0.00020,-1.571) [-1.57100|1.70560] "rad" Vector__XXX
 SG_ Obj_03_AngleSideV : 295|1@1+ (1,0) [0|1] "" Vector__XXX
 SG_ Obj_03_AngleSideSTD : 296|14@1+ (0.00010,0) [0.00000|1.63830] "rad" Vector__XXX
 SG_ Obj_03_AngleSideSTDV : 310|1@1+ (1,0) [0|1] "" Vector__XXX
 SG_ Obj_03_AngleBottomV : 311|1@1+ (1,0) [0|1] "" Vector__XXX
 SG_ Obj_03_AngleBottom : 312|14@1+ (0.00020,-1.571) [-1.57100|1.70560] "rad" Vector__XXX
 SG_ Obj_03_AngleBottomSTD : 326|14@1+ (0.00010,0) [0.00000|1.63830] "rad" Vector__XXX
 SG_ Obj_03_AngleBottomSTDV : 340|1@1+ (1,0) [0|1] "" Vector__XXX

BA_DEF_ BO_ "GenMsgCycleTime" INT 0 65535;
BA_DEF_ BO_ "GenMsgSendType" ENUM  "cyclicX","spontanX","cyclicIfActiveX","spontanWithDelay","cyclicAndSpontanX","cyclicAndSpontanWithDelay","spontanWithRepitition","cyclicIfActiveAndSpontanWD","cyclicIfActiveFast","cyclicWithRepeatOnDemand","none";
BA_DEF_ BO_ "GenMsgStartValue" STRING;
BA_DEF_ BO_ "VFrameFormat" ENUM  "StandardCAN","ExtendedCAN","reserved","reserved","reserved","reserved","reserved","reserved","reserved","reserved","reserved","reserved","reserved","reserved","StandardCAN_FD","ExtendedCAN_FD";
BA_DEF_ BU_ "NWM-Knoten" ENUM  "nein","ja";
BA_DEF_ BU_ "NWM-Stationsadresse" HEX 0 63;
BA_DEF_  "BusType" STRING;
BA_ "NWM-Knoten" BU_ FVCM 0;
BA_ "NWM-Stationsadresse" BU_ FVCM 0;

BA_ "BusType"   "CAN FD";

BA_ "GenMsgCycleTime" BO_ 513 60;
BA_ "GenMsgSendType" BO_ 513 0;
BA_ "GenMsgStartValue" BO_ 513 "00000000e80300007d00c80000000000401f803efa00800c009091411f0000006464bc4e00000000000000000000000000000000000000000000000000000000";
BA_ "VFrameFormat" BO_ 513 14;
BA_ "GenMsgCycleTime" BO_ 514 60;
BA_ "GenMsgSendType" BO_ 514 0;
BA_ "GenMsgStartValue" BO_ 514 "00000000e80300007d00c80000000000401f803efa00800c009091411f0000006464bc4e00000000000000000000000000000000000000000000000000000000";
BA_ "VFrameFormat" BO_ 514 14;
BA_ "GenMsgCycleTime" BO_ 523 60;
BA_ "GenMsgSendType" BO_ 523 0;
BA_ "GenMsgStartValue" BO_ 523 "00000000e80300007d00c80000000000401f803efa00800c009091411f0000006464bc4e00000000000000000000000000000000000000000000000000000000";
BA_ "VFrameFormat" BO_ 523 14;
BA_ "GenMsgCycleTime" BO_ 524 60;
BA_ "GenMsgSendType" BO_ 524 0;
BA_ "GenMsgStartValue" BO_ 524 "00000000e80300007d00c80000000000401f803efa00800c009091411f0000006464bc4e00000000000000000000000000000000000000000000000000000000";
BA_ "VFrameFormat" BO_ 524 14;
BA_ "GenMsgCycleTime" BO_ 525 60;
BA_ "GenMsgSendType" BO_ 525 0;
BA_ "GenMsgStartValue" BO_ 525 "00000000e80300007d00c80000000000401f803efa00800c009091411f0000006464bc4e00000000000000000000000000000000000000000000000000000000";
BA_ "VFrameFormat" BO_ 525 14;
BA_ "GenMsgCycleTime" BO_ 526 60;
BA_ "GenMsgSendType" BO_ 526 0;
BA_ "GenMsgStartValue" BO_ 526 "00000000e80300007d00c80000000000401f803efa00800c009091411f0000006464bc4e00000000000000000000000000000000000000000000000000000000";
BA_ "VFrameFormat" BO_ 526 14;
BA_ "GenMsgCycleTime" BO_ 527 60;
BA_ "GenMsgSendType" BO_ 527 0;
BA_ "GenMsgStartValue" BO_ 527 "00000000e80300007d00c80000000000401f803efa00800c009091411f0000006464bc4e00000000000000000000000000000000000000000000000000000000";
BA_ "VFrameFormat" BO_ 527 14;
BA_ "GenMsgCycleTime" BO_ 528 60;
BA_ "GenMsgSendType" BO_ 528 0;
BA_ "GenMsgStartValue" BO_ 528 "00000000e80300007d00c80000000000401f803efa00800c009091411f0000006464bc4e00000000000000000000000000000000000000000000000000000000";
BA_ "VFrameFormat" BO_ 528 14;
BA_ "GenMsgCycleTime" BO_ 529 60;
BA_ "GenMsgSendType" BO_ 529 0;
BA_ "GenMsgStartValue" BO_ 529 "00000000e80300007d00c80000000000401f803efa00800c009091411f0000006464bc4e00000000000000000000000000000000000000000000000000000000";
BA_ "VFrameFormat" BO_ 529 14;
BA_ "GenMsgCycleTime" BO_ 530 60;
BA_ "GenMsgSendType" BO_ 530 0;
BA_ "GenMsgStartValue" BO_ 530 "00000000e80300007d00c80000000000401f803efa00800c009091411f0000006464bc4e00000000000000000000000000000000000000000000000000000000";
BA_ "VFrameFormat" BO_ 530 14;
BA_ "GenMsgCycleTime" BO_ 531 60;
BA_ "GenMsgSendType" BO_ 531 0;
BA_ "GenMsgStartValue" BO_ 531 "00000000e80300007d00c80000000000401f803efa00800c009091411f0000006464bc4e00000000000000000000000000000000000000000000000000000000";
BA_ "VFrameFormat" BO_ 531 14;
BA_ "GenMsgCycleTime" BO_ 532 60;
BA_ "GenMsgSendType" BO_ 532 0;
BA_ "GenMsgStartValue" BO_ 532 "00000000e80300007d00c80000000000401f803efa00800c009091411f0000006464bc4e00000000000000000000000000000000000000000000000000000000";
BA_ "VFrameFormat" BO_ 532 14;
BA_ "GenMsgCycleTime" BO_ 515 60;
BA_ "GenMsgSendType" BO_ 515 0;
BA_ "GenMsgStartValue" BO_ 515 "00000000e80300007d00c80000000000401f803efa00800c009091411f0000006464bc4e00000000000000000000000000000000000000000000000000000000";
BA_ "VFrameFormat" BO_ 515 14;
BA_ "GenMsgCycleTime" BO_ 533 60;
BA_ "GenMsgSendType" BO_ 533 0;
BA_ "GenMsgStartValue" BO_ 533 "00000000e80300007d00c80000000000401f803efa00800c009091411f0000006464bc4e00000000000000000000000000000000000000000000000000000000";
BA_ "VFrameFormat" BO_ 533 14;
BA_ "GenMsgCycleTime" BO_ 534 60;
BA_ "GenMsgSendType" BO_ 534 0;
BA_ "GenMsgStartValue" BO_ 534 "00000000e80300007d00c80000000000401f803efa00800c009091411f0000006464bc4e00000000000000000000000000000000000000000000000000000000";
BA_ "VFrameFormat" BO_ 534 14;
BA_ "GenMsgCycleTime" BO_ 535 60;
BA_ "GenMsgSendType" BO_ 535 0;
BA_ "GenMsgStartValue" BO_ 535 "00000000e80300007d00c80000000000401f803efa00800c009091411f0000006464bc4e00000000000000000000000000000000000000000000000000000000";
BA_ "VFrameFormat" BO_ 535 14;
BA_ "GenMsgCycleTime" BO_ 536 60;
BA_ "GenMsgSendType" BO_ 536 0;
BA_ "GenMsgStartValue" BO_ 536 "00000000e80300007d00c80000000000401f803efa00800c009091411f0000006464bc4e00000000000000000000000000000000000000000000000000000000";
BA_ "VFrameFormat" BO_ 536 14;
BA_ "GenMsgCycleTime" BO_ 537 60;
BA_ "GenMsgSendType" BO_ 537 0;
BA_ "GenMsgStartValue" BO_ 537 "00000000e80300007d00c80000000000401f803efa00800c009091411f0000006464bc4e00000000000000000000000000000000000000000000000000000000";
BA_ "VFrameFormat" BO_ 537 14;
BA_ "GenMsgCycleTime" BO_ 538 60;
BA_ "GenMsgSendType" BO_ 538 0;
BA_ "GenMsgStartValue" BO_ 538 "00000000e80300007d00c80000000000401f803efa00800c009091411f0000006464bc4e00000000000000000000000000000000000000000000000000000000";
BA_ "VFrameFormat" BO_ 538 14;
BA_ "GenMsgCycleTime" BO_ 539 60;
BA_ "GenMsgSendType" BO_ 539 0;
BA_ "GenMsgStartValue" BO_ 539 "00000000e80300007d00c80000000000401f803efa00800c009091411f0000006464bc4e00000000000000000000000000000000000000000000000000000000";
BA_ "VFrameFormat" BO_ 539 14;
BA_ "GenMsgCycleTime" BO_ 540 60;
BA_ "GenMsgSendType" BO_ 540 0;
BA_ "GenMsgStartValue" BO_ 540 "00000000e80300007d00c80000000000401f803efa00800c009091411f0000006464bc4e00000000000000000000000000000000000000000000000000000000";
BA_ "VFrameFormat" BO_ 540 14;
BA_ "GenMsgCycleTime" BO_ 541 60;
BA_ "GenMsgSendType" BO_ 541 0;
BA_ "GenMsgStartValue" BO_ 541 "00000000e80300007d00c80000000000401f803efa00800c009091411f0000006464bc4e00000000000000000000000000000000000000000000000000000000";
BA_ "VFrameFormat" BO_ 541 14;
BA_ "GenMsgCycleTime" BO_ 542 60;
BA_ "GenMsgSendType" BO_ 542 0;
BA_ "GenMsgStartValue" BO_ 542 "00000000e80300007d00c80000000000401f803efa00800c009091411f0000006464bc4e00000000000000000000000000000000000000000000000000000000";
BA_ "VFrameFormat" BO_ 542 14;
BA_ "GenMsgCycleTime" BO_ 516 60;
BA_ "GenMsgSendType" BO_ 516 0;
BA_ "GenMsgStartValue" BO_ 516 "00000000e80300007d00c80000000000401f803efa00800c009091411f0000006464bc4e00000000000000000000000000000000000000000000000000000000";
BA_ "VFrameFormat" BO_ 516 14;
BA_ "GenMsgCycleTime" BO_ 543 60;
BA_ "GenMsgSendType" BO_ 543 0;
BA_ "GenMsgStartValue" BO_ 543 "00000000e80300007d00c80000000000401f803efa00800c009091411f0000006464bc4e00000000000000000000000000000000000000000000000000000000";
BA_ "VFrameFormat" BO_ 543 14;
BA_ "GenMsgCycleTime" BO_ 544 60;
BA_ "GenMsgSendType" BO_ 544 0;
BA_ "GenMsgStartValue" BO_ 544 "00000000e80300007d00c80000000000401f803efa00800c009091411f0000006464bc4e00000000000000000000000000000000000000000000000000000000";
BA_ "VFrameFormat" BO_ 544 14;
BA_ "GenMsgCycleTime" BO_ 545 60;
BA_ "GenMsgSendType" BO_ 545 0;
BA_ "GenMsgStartValue" BO_ 545 "00000000e80300007d00c80000000000401f803efa00800c009091411f0000006464bc4e00000000000000000000000000000000000000000000000000000000";
BA_ "VFrameFormat" BO_ 545 14;
BA_ "GenMsgCycleTime" BO_ 546 60;
BA_ "GenMsgSendType" BO_ 546 0;
BA_ "GenMsgStartValue" BO_ 546 "00000000e80300007d00c80000000000401f803efa00800c009091411f0000006464bc4e00000000000000000000000000000000000000000000000000000000";
BA_ "VFrameFormat" BO_ 546 14;
BA_ "GenMsgCycleTime" BO_ 547 60;
BA_ "GenMsgSendType" BO_ 547 0;
BA_ "GenMsgStartValue" BO_ 547 "00000000e80300007d00c80000000000401f803efa00800c009091411f0000006464bc4e00000000000000000000000000000000000000000000000000000000";
BA_ "VFrameFormat" BO_ 547 14;
BA_ "GenMsgCycleTime" BO_ 548 60;
BA_ "GenMsgSendType" BO_ 548 0;
BA_ "GenMsgStartValue" BO_ 548 "00000000e80300007d00c80000000000401f803efa00800c009091411f0000006464bc4e00000000000000000000000000000000000000000000000000000000";
BA_ "VFrameFormat" BO_ 548 14;
BA_ "GenMsgCycleTime" BO_ 549 60;
BA_ "GenMsgSendType" BO_ 549 0;
BA_ "GenMsgStartValue" BO_ 549 "00000000e80300007d00c80000000000401f803efa00800c009091411f0000006464bc4e00000000000000000000000000000000000000000000000000000000";
BA_ "VFrameFormat" BO_ 549 14;
BA_ "GenMsgCycleTime" BO_ 550 60;
BA_ "GenMsgSendType" BO_ 550 0;
BA_ "GenMsgStartValue" BO_ 550 "00000000e80300007d00c80000000000401f803efa00800c009091411f0000006464bc4e00000000000000000000000000000000000000000000000000000000";
BA_ "VFrameFormat" BO_ 550 14;
BA_ "GenMsgCycleTime" BO_ 551 60;
BA_ "GenMsgSendType" BO_ 551 0;
BA_ "GenMsgStartValue" BO_ 551 "00000000e80300007d00c80000000000401f803efa00800c009091411f0000006464bc4e00000000000000000000000000000000000000000000000000000000";
BA_ "VFrameFormat" BO_ 551 14;
BA_ "GenMsgCycleTime" BO_ 552 60;
BA_ "GenMsgSendType" BO_ 552 0;
BA_ "GenMsgStartValue" BO_ 552 "00000000e80300007d00c80000000000401f803efa00800c009091411f0000006464bc4e00000000000000000000000000000000000000000000000000000000";
BA_ "VFrameFormat" BO_ 552 14;
BA_ "GenMsgCycleTime" BO_ 517 60;
BA_ "GenMsgSendType" BO_ 517 0;
BA_ "GenMsgStartValue" BO_ 517 "00000000e80300007d00c80000000000401f803efa00800c009091411f0000006464bc4e00000000000000000000000000000000000000000000000000000000";
BA_ "VFrameFormat" BO_ 517 14;
BA_ "GenMsgCycleTime" BO_ 518 60;
BA_ "GenMsgSendType" BO_ 518 0;
BA_ "GenMsgStartValue" BO_ 518 "00000000e80300007d00c80000000000401f803efa00800c009091411f0000006464bc4e00000000000000000000000000000000000000000000000000000000";
BA_ "VFrameFormat" BO_ 518 14;
BA_ "GenMsgCycleTime" BO_ 519 60;
BA_ "GenMsgSendType" BO_ 519 0;
BA_ "GenMsgStartValue" BO_ 519 "00000000e80300007d00c80000000000401f803efa00800c009091411f0000006464bc4e00000000000000000000000000000000000000000000000000000000";
BA_ "VFrameFormat" BO_ 519 14;
BA_ "GenMsgCycleTime" BO_ 520 60;
BA_ "GenMsgSendType" BO_ 520 0;
BA_ "GenMsgStartValue" BO_ 520 "00000000e80300007d00c80000000000401f803efa00800c009091411f0000006464bc4e00000000000000000000000000000000000000000000000000000000";
BA_ "VFrameFormat" BO_ 520 14;
BA_ "GenMsgCycleTime" BO_ 521 60;
BA_ "GenMsgSendType" BO_ 521 0;
BA_ "GenMsgStartValue" BO_ 521 "00000000e80300007d00c80000000000401f803efa00800c009091411f0000006464bc4e00000000000000000000000000000000000000000000000000000000";
BA_ "VFrameFormat" BO_ 521 14;
BA_ "GenMsgCycleTime" BO_ 522 60;
BA_ "GenMsgSendType" BO_ 522 0;
BA_ "GenMsgStartValue" BO_ 522 "00000000e80300007d00c80000000000401f803efa00800c009091411f0000006464bc4e00000000000000000000000000000000000000000000000000000000";
BA_ "VFrameFormat" BO_ 522 14;
BA_ "GenMsgCycleTime" BO_ 512 60;
BA_ "GenMsgSendType" BO_ 512 0;
BA_ "GenMsgStartValue" BO_ 512 "00000000000000000000000000000000000000000000000000000000000000000000000000000000000000000000000000000000000000000000000000000000";
BA_ "VFrameFormat" BO_ 512 14;
BA_ "GenMsgCycleTime" BO_ 300 55;
BA_ "GenMsgSendType" BO_ 300 0;
BA_ "GenMsgStartValue" BO_ 300 "00000000000000000000000000000000000000000000000000000000000000000000000000000000000000000000000000000000000000000000000000000000";
BA_ "VFrameFormat" BO_ 300 14;
BA_ "GenMsgCycleTime" BO_ 305 55;
BA_ "GenMsgSendType" BO_ 305 0;
BA_ "GenMsgStartValue" BO_ 305 "0000000000000000e2040000000000001027000000000000803801000000000000c409000000000000204e000000000000007102000000000000000000000000";
BA_ "VFrameFormat" BO_ 305 14;
BA_ "GenMsgCycleTime" BO_ 306 55;
BA_ "GenMsgSendType" BO_ 306 0;
BA_ "GenMsgStartValue" BO_ 306 "0000000000000000e2040000000000001027000000000000803801000000000000c409000000000000204e000000000000007102000000000000000000000000";
BA_ "VFrameFormat" BO_ 306 14;
BA_ "GenMsgCycleTime" BO_ 304 55;
BA_ "GenMsgSendType" BO_ 304 0;
BA_ "GenMsgStartValue" BO_ 304 "00000000000000000000000000000000000000000000000000000000000000000000000000000000000000000000000000000000000000000000000000000000";
BA_ "VFrameFormat" BO_ 304 14;
BA_ "GenMsgCycleTime" BO_ 297 55;
BA_ "GenMsgSendType" BO_ 297 0;
BA_ "GenMsgStartValue" BO_ 297 "00000000204be8014c1d00000000dc0500000000b2841ec0d401000000c05d000000000000000000000000000000000000000000000000000000000000000000";
BA_ "VFrameFormat" BO_ 297 14;
BA_ "GenMsgCycleTime" BO_ 298 55;
BA_ "GenMsgSendType" BO_ 298 0;
BA_ "GenMsgStartValue" BO_ 298 "00000000c8127a005307000000007701000000802ca1073075000000007017000000000000000000000000000000000000000000000000000000000000000000";
BA_ "VFrameFormat" BO_ 298 14;
BA_ "GenMsgCycleTime" BO_ 257 55;
BA_ "GenMsgSendType" BO_ 257 0;
BA_ "GenMsgStartValue" BO_ 257 "0000000000000000000000801d00a007000000004027000000005de4d5030078f500005e3d0000af1e0000000000000000000000000000000000000000000000";
BA_ "VFrameFormat" BO_ 257 14;
BA_ "GenMsgCycleTime" BO_ 258 55;
BA_ "GenMsgSendType" BO_ 258 0;
BA_ "GenMsgStartValue" BO_ 258 "0000000000d00700401f000019002003007f00003200003200004b0000e80300803e0000a00f0080a20000000000000000000000000000000000000000000000";
BA_ "VFrameFormat" BO_ 258 14;
BA_ "GenMsgCycleTime" BO_ 259 55;
BA_ "GenMsgSendType" BO_ 259 0;
BA_ "GenMsgStartValue" BO_ 259 "0000000000000000000000801d00a007000000004027000000005de4d5030078f500005e3d0000af1e0000000000000000000000000000000000000000000000";
BA_ "VFrameFormat" BO_ 259 14;
BA_ "GenMsgCycleTime" BO_ 260 55;
BA_ "GenMsgSendType" BO_ 260 0;
BA_ "GenMsgStartValue" BO_ 260 "0000000000d00700401f000019002003007f00003200003200004b0000e80300803e0000a00f0080a20000000000000000000000000000000000000000000000";
BA_ "VFrameFormat" BO_ 260 14;
BA_ "GenMsgCycleTime" BO_ 261 55;
BA_ "GenMsgSendType" BO_ 261 0;
BA_ "GenMsgStartValue" BO_ 261 "0000000000000000000000801d00a007000000004027000000005de4d5030078f500005e3d0000af1e0000000000000000000000000000000000000000000000";
BA_ "VFrameFormat" BO_ 261 14;
BA_ "GenMsgCycleTime" BO_ 262 55;
BA_ "GenMsgSendType" BO_ 262 0;
BA_ "GenMsgStartValue" BO_ 262 "0000000000d00700401f000019002003007f00003200003200004b0000e80300803e0000a00f0080a20000000000000000000000000000000000000000000000";
BA_ "VFrameFormat" BO_ 262 14;
BA_ "GenMsgCycleTime" BO_ 263 55;
BA_ "GenMsgSendType" BO_ 263 0;
BA_ "GenMsgStartValue" BO_ 263 "0000000000000000000000801d00a007000000004027000000005de4d5030078f500005e3d0000af1e0000000000000000000000000000000000000000000000";
BA_ "VFrameFormat" BO_ 263 14;

VAL_ 513 IsNew_00 0 "" 1 "" 3 "";
VAL_ 513 ClassificationType_00 0 "" 1 "" 2 "" 3 "" 4 "" 5 "" 6 "" 7 "";
VAL_ 513 MeasurementStatus_00 0 "" 2 "" 3 "" 7 "";
VAL_ 513 MovementStatus_00 0 "" 1 "" 2 "" 3 "" 7 "";
VAL_ 513 ReferencePoint_00 0 "" 1 "" 2 "" 3 "" 4 "" 5 "" 6 "" 7 "" 8 "" 9 "" 15 "";
VAL_ 514 IsNew_01 0 "" 1 "" 3 "";
VAL_ 514 ClassificationType_01 0 "" 1 "" 2 "" 3 "" 4 "" 5 "" 6 "" 7 "";
VAL_ 514 MeasurementStatus_01 0 "" 2 "" 3 "" 7 "";
VAL_ 514 MovementStatus_01 0 "" 1 "" 2 "" 3 "" 7 "";
VAL_ 514 ReferencePoint_01 0 "" 1 "" 2 "" 3 "" 4 "" 5 "" 6 "" 7 "" 8 "" 9 "" 15 "";
VAL_ 523 IsNew_10 0 "" 1 "" 3 "";
VAL_ 523 ClassificationType_10 0 "" 1 "" 2 "" 3 "" 4 "" 5 "" 6 "" 7 "";
VAL_ 523 MeasurementStatus_10 0 "" 2 "" 3 "" 7 "";
VAL_ 523 MovementStatus_10 0 "" 1 "" 2 "" 3 "" 7 "";
VAL_ 523 ReferencePoint_10 0 "" 1 "" 2 "" 3 "" 4 "" 5 "" 6 "" 7 "" 8 "" 9 "" 15 "";
VAL_ 524 IsNew_11 0 "" 1 "" 3 "";
VAL_ 524 ClassificationType_11 0 "" 1 "" 2 "" 3 "" 4 "" 5 "" 6 "" 7 "";
VAL_ 524 MeasurementStatus_11 0 "" 2 "" 3 "" 7 "";
VAL_ 524 MovementStatus_11 0 "" 1 "" 2 "" 3 "" 7 "";
VAL_ 524 ReferencePoint_11 0 "" 1 "" 2 "" 3 "" 4 "" 5 "" 6 "" 7 "" 8 "" 9 "" 15 "";
VAL_ 525 IsNew_12 0 "" 1 "" 3 "";
VAL_ 525 ClassificationType_12 0 "" 1 "" 2 "" 3 "" 4 "" 5 "" 6 "" 7 "";
VAL_ 525 MeasurementStatus_12 0 "" 2 "" 3 "" 7 "";
VAL_ 525 MovementStatus_12 0 "" 1 "" 2 "" 3 "" 7 "";
VAL_ 525 ReferencePoint_12 0 "" 1 "" 2 "" 3 "" 4 "" 5 "" 6 "" 7 "" 8 "" 9 "" 15 "";
VAL_ 526 IsNew_13 0 "" 1 "" 3 "";
VAL_ 526 ClassificationType_13 0 "" 1 "" 2 "" 3 "" 4 "" 5 "" 6 "" 7 "";
VAL_ 526 MeasurementStatus_13 0 "" 2 "" 3 "" 7 "";
VAL_ 526 MovementStatus_13 0 "" 1 "" 2 "" 3 "" 7 "";
VAL_ 526 ReferencePoint_13 0 "" 1 "" 2 "" 3 "" 4 "" 5 "" 6 "" 7 "" 8 "" 9 "" 15 "";
VAL_ 527 IsNew_14 0 "" 1 "" 3 "";
VAL_ 527 ClassificationType_14 0 "" 1 "" 2 "" 3 "" 4 "" 5 "" 6 "" 7 "";
VAL_ 527 MeasurementStatus_14 0 "" 2 "" 3 "" 7 "";
VAL_ 527 MovementStatus_14 0 "" 1 "" 2 "" 3 "" 7 "";
VAL_ 527 ReferencePoint_14 0 "" 1 "" 2 "" 3 "" 4 "" 5 "" 6 "" 7 "" 8 "" 9 "" 15 "";
VAL_ 528 IsNew_15 0 "" 1 "" 3 "";
VAL_ 528 ClassificationType_15 0 "" 1 "" 2 "" 3 "" 4 "" 5 "" 6 "" 7 "";
VAL_ 528 MeasurementStatus_15 0 "" 2 "" 3 "" 7 "";
VAL_ 528 MovementStatus_15 0 "" 1 "" 2 "" 3 "" 7 "";
VAL_ 528 ReferencePoint_15 0 "" 1 "" 2 "" 3 "" 4 "" 5 "" 6 "" 7 "" 8 "" 9 "" 15 "";
VAL_ 529 IsNew_16 0 "" 1 "" 3 "";
VAL_ 529 ClassificationType_16 0 "" 1 "" 2 "" 3 "" 4 "" 5 "" 6 "" 7 "";
VAL_ 529 MeasurementStatus_16 0 "" 2 "" 3 "" 7 "";
VAL_ 529 MovementStatus_16 0 "" 1 "" 2 "" 3 "" 7 "";
VAL_ 529 ReferencePoint_16 0 "" 1 "" 2 "" 3 "" 4 "" 5 "" 6 "" 7 "" 8 "" 9 "" 15 "";
VAL_ 530 IsNew_17 0 "" 1 "" 3 "";
VAL_ 530 ClassificationType_17 0 "" 1 "" 2 "" 3 "" 4 "" 5 "" 6 "" 7 "";
VAL_ 530 MeasurementStatus_17 0 "" 2 "" 3 "" 7 "";
VAL_ 530 MovementStatus_17 0 "" 1 "" 2 "" 3 "" 7 "";
VAL_ 530 ReferencePoint_17 0 "" 1 "" 2 "" 3 "" 4 "" 5 "" 6 "" 7 "" 8 "" 9 "" 15 "";
VAL_ 531 IsNew_18 0 "" 1 "" 3 "";
VAL_ 531 ClassificationType_18 0 "" 1 "" 2 "" 3 "" 4 "" 5 "" 6 "" 7 "";
VAL_ 531 MeasurementStatus_18 0 "" 2 "" 3 "" 7 "";
VAL_ 531 MovementStatus_18 0 "" 1 "" 2 "" 3 "" 7 "";
VAL_ 531 ReferencePoint_18 0 "" 1 "" 2 "" 3 "" 4 "" 5 "" 6 "" 7 "" 8 "" 9 "" 15 "";
VAL_ 532 IsNew_19 0 "" 1 "" 3 "";
VAL_ 532 ClassificationType_19 0 "" 1 "" 2 "" 3 "" 4 "" 5 "" 6 "" 7 "";
VAL_ 532 MeasurementStatus_19 0 "" 2 "" 3 "" 7 "";
VAL_ 532 MovementStatus_19 0 "" 1 "" 2 "" 3 "" 7 "";
VAL_ 532 ReferencePoint_19 0 "" 1 "" 2 "" 3 "" 4 "" 5 "" 6 "" 7 "" 8 "" 9 "" 15 "";
VAL_ 515 IsNew_02 0 "" 1 "" 3 "";
VAL_ 515 ClassificationType_02 0 "" 1 "" 2 "" 3 "" 4 "" 5 "" 6 "" 7 "";
VAL_ 515 MeasurementStatus_02 0 "" 2 "" 3 "" 7 "";
VAL_ 515 MovementStatus_02 0 "" 1 "" 2 "" 3 "" 7 "";
VAL_ 515 ReferencePoint_02 0 "" 1 "" 2 "" 3 "" 4 "" 5 "" 6 "" 7 "" 8 "" 9 "" 15 "";
VAL_ 533 IsNew_20 0 "" 1 "" 3 "";
VAL_ 533 ClassificationType_20 0 "" 1 "" 2 "" 3 "" 4 "" 5 "" 6 "" 7 "";
VAL_ 533 MeasurementStatus_20 0 "" 2 "" 3 "" 7 "";
VAL_ 533 MovementStatus_20 0 "" 1 "" 2 "" 3 "" 7 "";
VAL_ 533 ReferencePoint_20 0 "" 1 "" 2 "" 3 "" 4 "" 5 "" 6 "" 7 "" 8 "" 9 "" 15 "";
VAL_ 534 IsNew_21 0 "" 1 "" 3 "";
VAL_ 534 ClassificationType_21 0 "" 1 "" 2 "" 3 "" 4 "" 5 "" 6 "" 7 "";
VAL_ 534 MeasurementStatus_21 0 "" 2 "" 3 "" 7 "";
VAL_ 534 MovementStatus_21 0 "" 1 "" 2 "" 3 "" 7 "";
VAL_ 534 ReferencePoint_21 0 "" 1 "" 2 "" 3 "" 4 "" 5 "" 6 "" 7 "" 8 "" 9 "" 15 "";
VAL_ 535 IsNew_22 0 "" 1 "" 3 "";
VAL_ 535 ClassificationType_22 0 "" 1 "" 2 "" 3 "" 4 "" 5 "" 6 "" 7 "";
VAL_ 535 MeasurementStatus_22 0 "" 2 "" 3 "" 7 "";
VAL_ 535 MovementStatus_22 0 "" 1 "" 2 "" 3 "" 7 "";
VAL_ 535 ReferencePoint_22 0 "" 1 "" 2 "" 3 "" 4 "" 5 "" 6 "" 7 "" 8 "" 9 "" 15 "";
VAL_ 536 IsNew_23 0 "" 1 "" 3 "";
VAL_ 536 ClassificationType_23 0 "" 1 "" 2 "" 3 "" 4 "" 5 "" 6 "" 7 "";
VAL_ 536 MeasurementStatus_23 0 "" 2 "" 3 "" 7 "";
VAL_ 536 MovementStatus_23 0 "" 1 "" 2 "" 3 "" 7 "";
VAL_ 536 ReferencePoint_23 0 "" 1 "" 2 "" 3 "" 4 "" 5 "" 6 "" 7 "" 8 "" 9 "" 15 "";
VAL_ 537 IsNew_24 0 "" 1 "" 3 "";
VAL_ 537 ClassificationType_24 0 "" 1 "" 2 "" 3 "" 4 "" 5 "" 6 "" 7 "";
VAL_ 537 MeasurementStatus_24 0 "" 2 "" 3 "" 7 "";
VAL_ 537 MovementStatus_24 0 "" 1 "" 2 "" 3 "" 7 "";
VAL_ 537 ReferencePoint_24 0 "" 1 "" 2 "" 3 "" 4 "" 5 "" 6 "" 7 "" 8 "" 9 "" 15 "";
VAL_ 538 IsNew_25 0 "" 1 "" 3 "";
VAL_ 538 ClassificationType_25 0 "" 1 "" 2 "" 3 "" 4 "" 5 "" 6 "" 7 "";
VAL_ 538 MeasurementStatus_25 0 "" 2 "" 3 "" 7 "";
VAL_ 538 MovementStatus_25 0 "" 1 "" 2 "" 3 "" 7 "";
VAL_ 538 ReferencePoint_25 0 "" 1 "" 2 "" 3 "" 4 "" 5 "" 6 "" 7 "" 8 "" 9 "" 15 "";
VAL_ 539 IsNew_26 0 "" 1 "" 3 "";
VAL_ 539 ClassificationType_26 0 "" 1 "" 2 "" 3 "" 4 "" 5 "" 6 "" 7 "";
VAL_ 539 MeasurementStatus_26 0 "" 2 "" 3 "" 7 "";
VAL_ 539 MovementStatus_26 0 "" 1 "" 2 "" 3 "" 7 "";
VAL_ 539 ReferencePoint_26 0 "" 1 "" 2 "" 3 "" 4 "" 5 "" 6 "" 7 "" 8 "" 9 "" 15 "";
VAL_ 540 IsNew_27 0 "" 1 "" 3 "";
VAL_ 540 ClassificationType_27 0 "" 1 "" 2 "" 3 "" 4 "" 5 "" 6 "" 7 "";
VAL_ 540 MeasurementStatus_27 0 "" 2 "" 3 "" 7 "";
VAL_ 540 MovementStatus_27 0 "" 1 "" 2 "" 3 "" 7 "";
VAL_ 540 ReferencePoint_27 0 "" 1 "" 2 "" 3 "" 4 "" 5 "" 6 "" 7 "" 8 "" 9 "" 15 "";
VAL_ 541 IsNew_28 0 "" 1 "" 3 "";
VAL_ 541 ClassificationType_28 0 "" 1 "" 2 "" 3 "" 4 "" 5 "" 6 "" 7 "";
VAL_ 541 MeasurementStatus_28 0 "" 2 "" 3 "" 7 "";
VAL_ 541 MovementStatus_28 0 "" 1 "" 2 "" 3 "" 7 "";
VAL_ 541 ReferencePoint_28 0 "" 1 "" 2 "" 3 "" 4 "" 5 "" 6 "" 7 "" 8 "" 9 "" 15 "";
VAL_ 542 IsNew_29 0 "" 1 "" 3 "";
VAL_ 542 ClassificationType_29 0 "" 1 "" 2 "" 3 "" 4 "" 5 "" 6 "" 7 "";
VAL_ 542 MeasurementStatus_29 0 "" 2 "" 3 "" 7 "";
VAL_ 542 MovementStatus_29 0 "" 1 "" 2 "" 3 "" 7 "";
VAL_ 542 ReferencePoint_29 0 "" 1 "" 2 "" 3 "" 4 "" 5 "" 6 "" 7 "" 8 "" 9 "" 15 "";
VAL_ 516 IsNew_03 0 "" 1 "" 3 "";
VAL_ 516 ClassificationType_03 0 "" 1 "" 2 "" 3 "" 4 "" 5 "" 6 "" 7 "";
VAL_ 516 MeasurementStatus_03 0 "" 2 "" 3 "" 7 "";
VAL_ 516 MovementStatus_03 0 "" 1 "" 2 "" 3 "" 7 "";
VAL_ 516 ReferencePoint_03 0 "" 1 "" 2 "" 3 "" 4 "" 5 "" 6 "" 7 "" 8 "" 9 "" 15 "";
VAL_ 543 IsNew_30 0 "" 1 "" 3 "";
VAL_ 543 ClassificationType_30 0 "" 1 "" 2 "" 3 "" 4 "" 5 "" 6 "" 7 "";
VAL_ 543 MeasurementStatus_30 0 "" 2 "" 3 "" 7 "";
VAL_ 543 MovementStatus_30 0 "" 1 "" 2 "" 3 "" 7 "";
VAL_ 543 ReferencePoint_30 0 "" 1 "" 2 "" 3 "" 4 "" 5 "" 6 "" 7 "" 8 "" 9 "" 15 "";
VAL_ 544 IsNew_31 0 "" 1 "" 3 "";
VAL_ 544 ClassificationType_31 0 "" 1 "" 2 "" 3 "" 4 "" 5 "" 6 "" 7 "";
VAL_ 544 MeasurementStatus_31 0 "" 2 "" 3 "" 7 "";
VAL_ 544 MovementStatus_31 0 "" 1 "" 2 "" 3 "" 7 "";
VAL_ 544 ReferencePoint_31 0 "" 1 "" 2 "" 3 "" 4 "" 5 "" 6 "" 7 "" 8 "" 9 "" 15 "";
VAL_ 545 IsNew_32 0 "" 1 "" 3 "";
VAL_ 545 ClassificationType_32 0 "" 1 "" 2 "" 3 "" 4 "" 5 "" 6 "" 7 "";
VAL_ 545 MeasurementStatus_32 0 "" 2 "" 3 "" 7 "";
VAL_ 545 MovementStatus_32 0 "" 1 "" 2 "" 3 "" 7 "";
VAL_ 545 ReferencePoint_32 0 "" 1 "" 2 "" 3 "" 4 "" 5 "" 6 "" 7 "" 8 "" 9 "" 15 "";
VAL_ 546 IsNew_33 0 "" 1 "" 3 "";
VAL_ 546 ClassificationType_33 0 "" 1 "" 2 "" 3 "" 4 "" 5 "" 6 "" 7 "";
VAL_ 546 MeasurementStatus_33 0 "" 2 "" 3 "" 7 "";
VAL_ 546 MovementStatus_33 0 "" 1 "" 2 "" 3 "" 7 "";
VAL_ 546 ReferencePoint_33 0 "" 1 "" 2 "" 3 "" 4 "" 5 "" 6 "" 7 "" 8 "" 9 "" 15 "";
VAL_ 547 IsNew_34 0 "" 1 "" 3 "";
VAL_ 547 ClassificationType_34 0 "" 1 "" 2 "" 3 "" 4 "" 5 "" 6 "" 7 "";
VAL_ 547 MeasurementStatus_34 0 "" 2 "" 3 "" 7 "";
VAL_ 547 MovementStatus_34 0 "" 1 "" 2 "" 3 "" 7 "";
VAL_ 547 ReferencePoint_34 0 "" 1 "" 2 "" 3 "" 4 "" 5 "" 6 "" 7 "" 8 "" 9 "" 15 "";
VAL_ 548 IsNew_35 0 "" 1 "" 3 "";
VAL_ 548 ClassificationType_35 0 "" 1 "" 2 "" 3 "" 4 "" 5 "" 6 "" 7 "";
VAL_ 548 MeasurementStatus_35 0 "" 2 "" 3 "" 7 "";
VAL_ 548 MovementStatus_35 0 "" 1 "" 2 "" 3 "" 7 "";
VAL_ 548 ReferencePoint_35 0 "" 1 "" 2 "" 3 "" 4 "" 5 "" 6 "" 7 "" 8 "" 9 "" 15 "";
VAL_ 549 IsNew_36 0 "" 1 "" 3 "";
VAL_ 549 ClassificationType_36 0 "" 1 "" 2 "" 3 "" 4 "" 5 "" 6 "" 7 "";
VAL_ 549 MeasurementStatus_36 0 "" 2 "" 3 "" 7 "";
VAL_ 549 MovementStatus_36 0 "" 1 "" 2 "" 3 "" 7 "";
VAL_ 549 ReferencePoint_36 0 "" 1 "" 2 "" 3 "" 4 "" 5 "" 6 "" 7 "" 8 "" 9 "" 15 "";
VAL_ 550 IsNew_37 0 "" 1 "" 3 "";
VAL_ 550 ClassificationType_37 0 "" 1 "" 2 "" 3 "" 4 "" 5 "" 6 "" 7 "";
VAL_ 550 MeasurementStatus_37 0 "" 2 "" 3 "" 7 "";
VAL_ 550 MovementStatus_37 0 "" 1 "" 2 "" 3 "" 7 "";
VAL_ 550 ReferencePoint_37 0 "" 1 "" 2 "" 3 "" 4 "" 5 "" 6 "" 7 "" 8 "" 9 "" 15 "";
VAL_ 551 IsNew_38 0 "" 1 "" 3 "";
VAL_ 551 ClassificationType_38 0 "" 1 "" 2 "" 3 "" 4 "" 5 "" 6 "" 7 "";
VAL_ 551 MeasurementStatus_38 0 "" 2 "" 3 "" 7 "";
VAL_ 551 MovementStatus_38 0 "" 1 "" 2 "" 3 "" 7 "";
VAL_ 551 ReferencePoint_38 0 "" 1 "" 2 "" 3 "" 4 "" 5 "" 6 "" 7 "" 8 "" 9 "" 15 "";
VAL_ 552 IsNew_39 0 "" 1 "" 3 "";
VAL_ 552 ClassificationType_39 0 "" 1 "" 2 "" 3 "" 4 "" 5 "" 6 "" 7 "";
VAL_ 552 MeasurementStatus_39 0 "" 2 "" 3 "" 7 "";
VAL_ 552 MovementStatus_39 0 "" 1 "" 2 "" 3 "" 7 "";
VAL_ 552 ReferencePoint_39 0 "" 1 "" 2 "" 3 "" 4 "" 5 "" 6 "" 7 "" 8 "" 9 "" 15 "";
VAL_ 517 IsNew_04 0 "" 1 "" 3 "";
VAL_ 517 ClassificationType_04 0 "" 1 "" 2 "" 3 "" 4 "" 5 "" 6 "" 7 "";
VAL_ 517 MeasurementStatus_04 0 "" 2 "" 3 "" 7 "";
VAL_ 517 MovementStatus_04 0 "" 1 "" 2 "" 3 "" 7 "";
VAL_ 517 ReferencePoint_04 0 "" 1 "" 2 "" 3 "" 4 "" 5 "" 6 "" 7 "" 8 "" 9 "" 15 "";
VAL_ 518 IsNew_05 0 "" 1 "" 3 "";
VAL_ 518 ClassificationType_05 0 "" 1 "" 2 "" 3 "" 4 "" 5 "" 6 "" 7 "";
VAL_ 518 MeasurementStatus_05 0 "" 2 "" 3 "" 7 "";
VAL_ 518 MovementStatus_05 0 "" 1 "" 2 "" 3 "" 7 "";
VAL_ 518 ReferencePoint_05 0 "" 1 "" 2 "" 3 "" 4 "" 5 "" 6 "" 7 "" 8 "" 9 "" 15 "";
VAL_ 519 IsNew_06 0 "" 1 "" 3 "";
VAL_ 519 ClassificationType_06 0 "" 1 "" 2 "" 3 "" 4 "" 5 "" 6 "" 7 "";
VAL_ 519 MeasurementStatus_06 0 "" 2 "" 3 "" 7 "";
VAL_ 519 MovementStatus_06 0 "" 1 "" 2 "" 3 "" 7 "";
VAL_ 519 ReferencePoint_06 0 "" 1 "" 2 "" 3 "" 4 "" 5 "" 6 "" 7 "" 8 "" 9 "" 15 "";
VAL_ 520 IsNew_07 0 "" 1 "" 3 "";
VAL_ 520 ClassificationType_07 0 "" 1 "" 2 "" 3 "" 4 "" 5 "" 6 "" 7 "";
VAL_ 520 MeasurementStatus_07 0 "" 2 "" 3 "" 7 "";
VAL_ 520 MovementStatus_07 0 "" 1 "" 2 "" 3 "" 7 "";
VAL_ 520 ReferencePoint_07 0 "" 1 "" 2 "" 3 "" 4 "" 5 "" 6 "" 7 "" 8 "" 9 "" 15 "";
VAL_ 521 IsNew_08 0 "" 1 "" 3 "";
VAL_ 521 ClassificationType_08 0 "" 1 "" 2 "" 3 "" 4 "" 5 "" 6 "" 7 "";
VAL_ 521 MeasurementStatus_08 0 "" 2 "" 3 "" 7 "";
VAL_ 521 MovementStatus_08 0 "" 1 "" 2 "" 3 "" 7 "";
VAL_ 521 ReferencePoint_08 0 "" 1 "" 2 "" 3 "" 4 "" 5 "" 6 "" 7 "" 8 "" 9 "" 15 "";
VAL_ 522 IsNew_09 0 "" 1 "" 3 "";
VAL_ 522 ClassificationType_09 0 "" 1 "" 2 "" 3 "" 4 "" 5 "" 6 "" 7 "";
VAL_ 522 MeasurementStatus_09 0 "" 2 "" 3 "" 7 "";
VAL_ 522 MovementStatus_09 0 "" 1 "" 2 "" 3 "" 7 "";
VAL_ 522 ReferencePoint_09 0 "" 1 "" 2 "" 3 "" 4 "" 5 "" 6 "" 7 "" 8 "" 9 "" 15 "";
VAL_ 512 InterfaceID 0 "" 1 "" 2 "" 3 "" 4 "" 5 "" 6 "" 7 "" 8 "" 9 "" 10 "" 11 "" 12 "";
VAL_ 512 ObjectListQualifier 0 "" 1 "" 2 "" 3 "" 4 "" 5 "" 7 "";
VAL_ 300 FS_TSR_Out_OF_Calib 0 "" 1 "" 3 "" 5 "" 7 "" 9 "" 11 "" 13 "" 15 "";
VAL_ 300 FS_Out_Of_Calib 0 "" 1 "";
VAL_ 300 FS_Rain 0 "" 1 "";
VAL_ 300 FS_Fog 0 "" 1 "";
VAL_ 300 FS_Splashes 0 "" 1 "";
VAL_ 300 FS_Sun_Ray 0 "" 1 "";
VAL_ 300 FS_Low_Sun 0 "" 1 "";
VAL_ 300 FS_Blur_Image 0 "" 1 "";
VAL_ 300 FS_Partial_Blockage 0 "" 1 "";
VAL_ 300 FS_Full_Blockage 0 "" 1 "";
VAL_ 300 FS_Frozen_Windshield_Lens 0 "" 1 "";
VAL_ 300 FS_Out_Of_Focus 0 "" 1 "";
VAL_ 305 LAP_INTP_Is_Valid_0 0 "" 1 "";
VAL_ 305 LAP_INTP_Type_0 0 "" 1 "";
VAL_ 305 LAP_INTP_Is_Start_0 0 "" 1 "";
VAL_ 305 LAP_INTP_SRD_0 0 "" 1 "" 2 "" 3 "" 4 "";
VAL_ 305 LAP_INTP_Role_0 0 "" 1 "" 2 "" 3 "" 4 "" 5 "" 6 "";
VAL_ 305 LAP_INTP_Is_Valid_1 0 "" 1 "";
VAL_ 305 LAP_INTP_Type_1 0 "" 1 "";
VAL_ 305 LAP_INTP_Is_Start_1 0 "" 1 "";
VAL_ 305 LAP_INTP_SRD_1 0 "" 1 "" 2 "" 3 "" 4 "";
VAL_ 305 LAP_INTP_Role_1 0 "" 1 "" 2 "" 3 "" 4 "" 5 "" 6 "";
VAL_ 305 LAP_INTP_Is_Valid_2 0 "" 1 "";
VAL_ 305 LAP_INTP_Type_2 0 "" 1 "";
VAL_ 305 LAP_INTP_Is_Start_2 0 "" 1 "";
VAL_ 305 LAP_INTP_SRD_2 0 "" 1 "" 2 "" 3 "" 4 "";
VAL_ 305 LAP_INTP_Role_2 0 "" 1 "" 2 "" 3 "" 4 "" 5 "" 6 "";
VAL_ 305 LAP_INTP_Is_Valid_3 0 "" 1 "";
VAL_ 305 LAP_INTP_Type_3 0 "" 1 "";
VAL_ 305 LAP_INTP_Is_Start_3 0 "" 1 "";
VAL_ 305 LAP_INTP_SRD_3 0 "" 1 "" 2 "" 3 "" 4 "";
VAL_ 305 LAP_INTP_Role_3 0 "" 1 "" 2 "" 3 "" 4 "" 5 "" 6 "";
VAL_ 305 LAP_INTP_Is_Valid_4 0 "" 1 "";
VAL_ 305 LAP_INTP_Type_4 0 "" 1 "";
VAL_ 305 LAP_INTP_Is_Start_4 0 "" 1 "";
VAL_ 305 LAP_INTP_SRD_4 0 "" 1 "" 2 "" 3 "" 4 "";
VAL_ 305 LAP_INTP_Role_4 0 "" 1 "" 2 "" 3 "" 4 "" 5 "" 6 "";
VAL_ 305 LAP_INTP_Is_Valid_5 0 "" 1 "";
VAL_ 305 LAP_INTP_Type_5 0 "" 1 "";
VAL_ 305 LAP_INTP_Is_Start_5 0 "" 1 "";
VAL_ 305 LAP_INTP_SRD_5 0 "" 1 "" 2 "" 3 "" 4 "";
VAL_ 305 LAP_INTP_Role_5 0 "" 1 "" 2 "" 3 "" 4 "" 5 "" 6 "";
VAL_ 306 LAP_INTP_Is_Valid_6 0 "" 1 "";
VAL_ 306 LAP_INTP_Type_6 0 "" 1 "";
VAL_ 306 LAP_INTP_Is_Start_6 0 "" 1 "";
VAL_ 306 LAP_INTP_SRD_6 0 "" 1 "" 2 "" 3 "" 4 "";
VAL_ 306 LAP_INTP_Role_6 0 "" 1 "" 2 "" 3 "" 4 "" 5 "" 6 "";
VAL_ 306 LAP_INTP_Is_Valid_7 0 "" 1 "";
VAL_ 306 LAP_INTP_Type_7 0 "" 1 "";
VAL_ 306 LAP_INTP_Is_Start_7 0 "" 1 "";
VAL_ 306 LAP_INTP_SRD_7 0 "" 1 "" 2 "" 3 "" 4 "";
VAL_ 306 LAP_INTP_Role_7 0 "" 1 "" 2 "" 3 "" 4 "" 5 "" 6 "";
VAL_ 306 LAP_INTP_Is_Valid_8 0 "" 1 "";
VAL_ 306 LAP_INTP_Type_8 0 "" 1 "";
VAL_ 306 LAP_INTP_Is_Start_8 0 "" 1 "";
VAL_ 306 LAP_INTP_SRD_8 0 "" 1 "" 2 "" 3 "" 4 "";
VAL_ 306 LAP_INTP_Role_8 0 "" 1 "" 2 "" 3 "" 4 "" 5 "" 6 "";
VAL_ 306 LAP_INTP_Is_Valid_9 0 "" 1 "";
VAL_ 306 LAP_INTP_Type_9 0 "" 1 "";
VAL_ 306 LAP_INTP_Is_Start_9 0 "" 1 "";
VAL_ 306 LAP_INTP_SRD_9 0 "" 1 "" 2 "" 3 "" 4 "";
VAL_ 306 LAP_INTP_Role_9 0 "" 1 "" 2 "" 3 "" 4 "" 5 "" 6 "";
VAL_ 306 LAP_INTP_Is_Valid_10 0 "" 1 "";
VAL_ 306 LAP_INTP_Type_10 0 "" 1 "";
VAL_ 306 LAP_INTP_Is_Start_10 0 "" 1 "";
VAL_ 306 LAP_INTP_SRD_10 0 "" 1 "" 2 "" 3 "" 4 "";
VAL_ 306 LAP_INTP_Role_10 0 "" 1 "" 2 "" 3 "" 4 "" 5 "" 6 "";
VAL_ 306 LAP_INTP_Is_Valid_11 0 "" 1 "";
VAL_ 306 LAP_INTP_Type_11 0 "" 1 "";
VAL_ 306 LAP_INTP_Is_Start_11 0 "" 1 "";
VAL_ 306 LAP_INTP_SRD_11 0 "" 1 "" 2 "" 3 "" 4 "";
VAL_ 306 LAP_INTP_Role_11 0 "" 1 "" 2 "" 3 "" 4 "" 5 "" 6 "";
VAL_ 304 LAP_Is_Construction_Area 0 "" 1 "";
VAL_ 304 LAP_Is_Construction_Area_Rear 0 "" 1 "";
VAL_ 304 LAP_Snow_On_Road 0 "" 1 "";
VAL_ 304 LAP_INTP_Available 0 "" 1 "";
VAL_ 304 LAP_Exit_Merge_Available 0 "" 1 "";
VAL_ 304 LAP_Is_Highway_Merge_Left 0 "" 1 "";
VAL_ 304 LAP_Is_Highway_Merge_Right 0 "" 1 "";
VAL_ 304 LAP_Is_Highway_Exit_Left 0 "" 1 "";
VAL_ 304 LAP_Is_Highway_Exit_Right 0 "" 1 "";
VAL_ 304 LAP_Vertical_Surface_Available 0 "" 1 "";
VAL_ 304 LAP_Path_Pred_Available 0 "" 1 "";
VAL_ 304 LAP_Path_Pred_First_Valid 0 "" 1 "";
VAL_ 304 LAP_Path_Pred_Second_Valid 0 "" 1 "";
VAL_ 297 LaneIsBlockedLeft 0 "" 1 "";
VAL_ 297 LaneIsBlockedRight 0 "" 1 "";
VAL_ 297 Lane0_MarkerColor 0 "" 1 "" 2 "" 3 "" 4 "" 5 "" 6 "" 7 "";
VAL_ 297 Lane0_MeasureType 0 "" 1 "" 2 "" 3 "";
VAL_ 297 Lane0_MarkerType 0 "" 1 "" 2 "" 3 "" 4 "" 5 "" 6 "" 7 "" 8 "" 9 "";
VAL_ 297 Lane1_MarkerColor 0 "" 1 "" 2 "" 3 "" 4 "" 5 "" 6 "" 7 "";
VAL_ 297 Lane1_MeasureType 0 "" 1 "" 2 "" 3 "";
VAL_ 297 Lane1_MarkerType 0 "" 1 "" 2 "" 3 "" 4 "" 5 "" 6 "" 7 "" 8 "" 9 "";
VAL_ 297 Lane1_TypeConf 0 "" 1 "" 2 "" 3 "" 4 "" 5 "" 6 "" 7 "" 8 "" 9 "" 10 "" 11 "" 12 "" 13 "" 14 "" 15 "" 16 "" 17 "" 18 "" 19 "" 20 "" 21 "" 22 "" 23 "" 24 "" 25 "" 26 "" 27 "" 28 "" 29 "" 30 "" 31 "" 32 "" 33 "" 34 "" 35 "" 36 "" 37 "" 38 "" 39 "" 40 "" 41 "" 42 "" 43 "" 44 "" 45 "" 46 "" 47 "" 48 "" 49 "" 50 "" 51 "" 52 "" 53 "" 54 "" 55 "" 56 "" 57 "" 58 "" 59 "" 60 "" 61 "" 62 "" 63 "" 64 "" 65 "" 66 "" 67 "" 68 "" 69 "" 70 "" 71 "" 72 "" 73 "" 74 "" 75 "" 76 "" 77 "" 78 "" 79 "" 80 "" 81 "" 82 "" 83 "" 84 "" 85 "" 86 "" 87 "" 88 "" 89 "" 90 "" 91 "" 92 "" 93 "" 94 "" 95 "" 96 "" 97 "" 98 "" 99 "" 100 "" 101 "" 102 "" 103 "" 104 "" 105 "" 106 "" 107 "" 108 "" 109 "" 110 "" 111 "" 112 "" 113 "" 114 "" 115 "" 116 "" 117 "" 118 "" 119 "" 120 "" 121 "" 122 "" 123 "" 124 "" 125 "" 126 "" 127 "";
VAL_ 298 Lane2_MarkerColor 0 "" 1 "" 2 "" 3 "" 4 "" 5 "" 6 "" 7 "";
VAL_ 298 Lane2_MeasureType 0 "" 1 "" 2 "" 3 "";
VAL_ 298 Lane2_MarkerType 0 "" 1 "" 2 "" 3 "" 4 "" 5 "" 6 "" 7 "" 8 "" 9 "";
VAL_ 298 Lane3_MarkerColor 0 "" 1 "" 2 "" 3 "" 4 "" 5 "" 6 "" 7 "";
VAL_ 298 Lane3_MeasureType 0 "" 1 "" 2 "" 3 "";
VAL_ 298 Lane3_MarkerType 0 "" 1 "" 2 "" 3 "" 4 "" 5 "" 6 "" 7 "" 8 "" 9 "";
VAL_ 298 Lane3_TypeConf 0 "" 1 "" 2 "" 3 "" 4 "" 5 "" 6 "" 7 "" 8 "" 9 "" 10 "" 11 "" 12 "" 13 "" 14 "" 15 "" 16 "" 17 "" 18 "" 19 "" 20 "" 21 "" 22 "" 23 "" 24 "" 25 "" 26 "" 27 "" 28 "" 29 "" 30 "" 31 "" 32 "" 33 "" 34 "" 35 "" 36 "" 37 "" 38 "" 39 "" 40 "" 41 "" 42 "" 43 "" 44 "" 45 "" 46 "" 47 "" 48 "" 49 "" 50 "" 51 "" 52 "" 53 "" 54 "" 55 "" 56 "" 57 "" 58 "" 59 "" 60 "" 61 "" 62 "" 63 "" 64 "" 65 "" 66 "" 67 "" 68 "" 69 "" 70 "" 71 "" 72 "" 73 "" 74 "" 75 "" 76 "" 77 "" 78 "" 79 "" 80 "" 81 "" 82 "" 83 "" 84 "" 85 "" 86 "" 87 "" 88 "" 89 "" 90 "" 91 "" 92 "" 93 "" 94 "" 95 "" 96 "" 97 "" 98 "" 99 "" 100 "" 101 "" 102 "" 103 "" 104 "" 105 "" 106 "" 107 "" 108 "" 109 "" 110 "" 111 "" 112 "" 113 "" 114 "" 115 "" 116 "" 117 "" 118 "" 119 "" 120 "" 121 "" 122 "" 123 "" 124 "" 125 "" 126 "" 127 "";
VAL_ 257 Obj_00_MotionCategory 0 "" 1 "" 2 "" 3 "" 4 "" 5 "" 6 "" 7 "" 8 "" 9 "" 10 "" 11 "" 12 "" 13 "";
VAL_ 257 Obj_00_MeasSts 0 "" 1 "" 2 "" 3 "" 4 "" 5 "" 6 "" 7 "";
VAL_ 257 Obj_00_Typ 0 "" 1 "" 2 "" 3 "" 4 "" 5 "" 6 "" 7 "" 8 "";
VAL_ 257 Obj_00_MotionSts 0 "" 1 "" 2 "" 3 "" 4 "" 5 "";
VAL_ 257 Obj_00_MotionOrientation 0 "" 1 "" 3 "" 5 "" 6 "" 7 "" 9 "" 11 "" 12 "" 13 "";
VAL_ 257 Obj_00_BrakeLight 0 "" 1 "";
VAL_ 257 Obj_00_TurnIndicatorRight 0 "" 1 "";
VAL_ 257 Obj_00_TurnIndicatorLeft 0 "" 1 "";
VAL_ 257 Obj_00_LightIndicatorValidity 0 "" 1 "";
VAL_ 257 Obj_00_LaneAssignment 0 "" 1 "" 2 "" 3 "" 4 "" 5 "";
VAL_ 257 Obj_00_LaneAssignmentV 0 "" 1 "";
VAL_ 257 Obj_00_WidthV 0 "" 1 "";
VAL_ 257 Obj_00_WidthSTDV 0 "" 1 "";
VAL_ 257 Obj_00_LengthV 0 "" 1 "";
VAL_ 257 Obj_00_LengthSTDV 0 "" 1 "";
VAL_ 257 Obj_00_HeightV 0 "" 1 "";
VAL_ 257 Obj_00_HeightSTDV 0 "" 1 "";
VAL_ 257 Obj_00_HeadingV 0 "" 1 "";
VAL_ 257 Obj_00_HeadingSTDV 0 "" 1 "";
VAL_ 257 Obj_00_AngleRateSTDV 0 "" 1 "";
VAL_ 257 Obj_00_AngleRateV 0 "" 1 "";
VAL_ 257 Obj_00_AngleRightV 0 "" 1 "";
VAL_ 257 Obj_00_AngleRightSTDV 0 "" 1 "";
VAL_ 257 Obj_00_AngleLeftV 0 "" 1 "";
VAL_ 257 Obj_00_AngleLeftSTDV 0 "" 1 "";
VAL_ 257 Obj_00_AngleSideV 0 "" 1 "";
VAL_ 257 Obj_00_AngleSideSTDV 0 "" 1 "";
VAL_ 257 Obj_00_AngleBottomV 0 "" 1 "";
VAL_ 257 Obj_00_AngleBottomSTDV 0 "" 1 "";
VAL_ 258 Obj_00_AbsLongVelocityV 0 "" 1 "";
VAL_ 258 Obj_00_AbsLongVelSTDV 0 "" 1 "";
VAL_ 258 Obj_00_AbsLatVelocityV 0 "" 1 "";
VAL_ 258 Obj_00_AbsLatVelSTDV 0 "" 1 "";
VAL_ 258 Obj_00_AbsLongAccV 0 "" 1 "";
VAL_ 258 Obj_00_AbsLongAccSTDV 0 "" 1 "";
VAL_ 258 Obj_00_AbsLatAccV 0 "" 1 "";
VAL_ 258 Obj_00_AbsLatAccSTDV 0 "" 1 "";
VAL_ 258 Obj_00_AbsAccelerationV 0 "" 1 "";
VAL_ 258 Obj_00_AbsAccSTDV 0 "" 1 "";
VAL_ 258 Obj_00_InvTTCV 0 "" 1 "";
VAL_ 258 Obj_00_InvTTCSTDV 0 "" 1 "";
VAL_ 258 Obj_00_RelativeLongAccV 0 "" 1 "";
VAL_ 258 Obj_00_RelLongAccSTDV 0 "" 1 "";
VAL_ 258 Obj_00_LongtRltvSpdV 0 "" 1 "";
VAL_ 258 Obj_00_LongtRltvSpdSTDV 0 "" 1 "";
VAL_ 258 Obj_00_RelativeLatVelocityV 0 "" 1 "";
VAL_ 258 Obj_00_RelLatVelSTDV 0 "" 1 "";
VAL_ 258 Obj_00_LongDistanceV 0 "" 1 "";
VAL_ 258 Obj_00_LongDistanceSTDV 0 "" 1 "";
VAL_ 258 Obj_00_LatDistanceV 0 "" 1 "";
VAL_ 258 Obj_00_LatDistanceSTDV 0 "" 1 "";
VAL_ 258 Obj_00_AbsoluteSpeedV 0 "" 1 "";
VAL_ 258 Obj_00_AbsoluteSpeedSTDV 0 "" 1 "";
VAL_ 259 Obj_01_MotionCategory 0 "" 1 "" 2 "" 3 "" 4 "" 5 "" 6 "" 7 "" 8 "" 9 "" 10 "" 11 "" 12 "" 13 "";
VAL_ 259 Obj_01_MeasSts 0 "" 1 "" 2 "" 3 "" 4 "" 5 "" 6 "" 7 "";
VAL_ 259 Obj_01_Typ 0 "" 1 "" 2 "" 3 "" 4 "" 5 "" 6 "" 7 "" 8 "";
VAL_ 259 Obj_01_MotionSts 0 "" 1 "" 2 "" 3 "" 4 "" 5 "";
VAL_ 259 Obj_01_MotionOrientation 0 "" 1 "" 3 "" 5 "" 6 "" 7 "" 9 "" 11 "" 12 "" 13 "";
VAL_ 259 Obj_01_BrakeLight 0 "" 1 "";
VAL_ 259 Obj_01_TurnIndicatorRight 0 "" 1 "";
VAL_ 259 Obj_01_TurnIndicatorLeft 0 "" 1 "";
VAL_ 259 Obj_01_LightIndicatorValidity 0 "" 1 "";
VAL_ 259 Obj_01_LaneAssignment 0 "" 1 "" 2 "" 3 "" 4 "" 5 "";
VAL_ 259 Obj_01_LaneAssignmentV 0 "" 1 "";
VAL_ 259 Obj_01_WidthV 0 "" 1 "";
VAL_ 259 Obj_01_WidthSTDV 0 "" 1 "";
VAL_ 259 Obj_01_LengthV 0 "" 1 "";
VAL_ 259 Obj_01_LengthSTDV 0 "" 1 "";
VAL_ 259 Obj_01_HeightV 0 "" 1 "";
VAL_ 259 Obj_01_HeightSTDV 0 "" 1 "";
VAL_ 259 Obj_01_HeadingV 0 "" 1 "";
VAL_ 259 Obj_01_HeadingSTDV 0 "" 1 "";
VAL_ 259 Obj_01_AngleRateSTDV 0 "" 1 "";
VAL_ 259 Obj_01_AngleRateV 0 "" 1 "";
VAL_ 259 Obj_01_AngleRightV 0 "" 1 "";
VAL_ 259 Obj_01_AngleRightSTDV 0 "" 1 "";
VAL_ 259 Obj_01_AngleLeftV 0 "" 1 "";
VAL_ 259 Obj_01_AngleLeftSTDV 0 "" 1 "";
VAL_ 259 Obj_01_AngleSideV 0 "" 1 "";
VAL_ 259 Obj_01_AngleSideSTDV 0 "" 1 "";
VAL_ 259 Obj_01_AngleBottomV 0 "" 1 "";
VAL_ 259 Obj_01_AngleBottomSTDV 0 "" 1 "";
VAL_ 260 Obj_01_AbsLongVelocityV 0 "" 1 "";
VAL_ 260 Obj_01_AbsLongVelSTDV 0 "" 1 "";
VAL_ 260 Obj_01_AbsLatVelocityV 0 "" 1 "";
VAL_ 260 Obj_01_AbsLatVelSTDV 0 "" 1 "";
VAL_ 260 Obj_01_AbsLongAccV 0 "" 1 "";
VAL_ 260 Obj_01_AbsLongAccSTDV 0 "" 1 "";
VAL_ 260 Obj_01_AbsLatAccV 0 "" 1 "";
VAL_ 260 Obj_01_AbsLatAccSTDV 0 "" 1 "";
VAL_ 260 Obj_01_AbsAccelerationV 0 "" 1 "";
VAL_ 260 Obj_01_AbsAccSTDV 0 "" 1 "";
VAL_ 260 Obj_01_InvTTCV 0 "" 1 "";
VAL_ 260 Obj_01_InvTTCSTDV 0 "" 1 "";
VAL_ 260 Obj_01_RelativeLongAccV 0 "" 1 "";
VAL_ 260 Obj_01_RelLongAccSTDV 0 "" 1 "";
VAL_ 260 Obj_01_LongtRltvSpdV 0 "" 1 "";
VAL_ 260 Obj_01_LongtRltvSpdSTDV 0 "" 1 "";
VAL_ 260 Obj_01_RelativeLatVelocityV 0 "" 1 "";
VAL_ 260 Obj_01_RelLatVelSTDV 0 "" 1 "";
VAL_ 260 Obj_01_LongDistanceV 0 "" 1 "";
VAL_ 260 Obj_01_LongDistanceSTDV 0 "" 1 "";
VAL_ 260 Obj_01_LatDistanceV 0 "" 1 "";
VAL_ 260 Obj_01_LatDistanceSTDV 0 "" 1 "";
VAL_ 260 Obj_01_AbsoluteSpeedV 0 "" 1 "";
VAL_ 260 Obj_01_AbsoluteSpeedSTDV 0 "" 1 "";
VAL_ 261 Obj_02_MotionCategory 0 "" 1 "" 2 "" 3 "" 4 "" 5 "" 6 "" 7 "" 8 "" 9 "" 10 "" 11 "" 12 "" 13 "";
VAL_ 261 Obj_02_MeasSts 0 "" 1 "" 2 "" 3 "" 4 "" 5 "" 6 "" 7 "";
VAL_ 261 Obj_02_Typ 0 "" 1 "" 2 "" 3 "" 4 "" 5 "" 6 "" 7 "" 8 "";
VAL_ 261 Obj_02_MotionSts 0 "" 1 "" 2 "" 3 "" 4 "" 5 "";
VAL_ 261 Obj_02_MotionOrientation 0 "" 1 "" 3 "" 5 "" 6 "" 7 "" 9 "" 11 "" 12 "" 13 "";
VAL_ 261 Obj_02_BrakeLight 0 "" 1 "";
VAL_ 261 Obj_02_TurnIndicatorRight 0 "" 1 "";
VAL_ 261 Obj_02_TurnIndicatorLeft 0 "" 1 "";
VAL_ 261 Obj_02_LightIndicatorValidity 0 "" 1 "";
VAL_ 261 Obj_02_LaneAssignment 0 "" 1 "" 2 "" 3 "" 4 "" 5 "";
VAL_ 261 Obj_02_LaneAssignmentV 0 "" 1 "";
VAL_ 261 Obj_02_WidthV 0 "" 1 "";
VAL_ 261 Obj_02_WidthSTDV 0 "" 1 "";
VAL_ 261 Obj_02_LengthV 0 "" 1 "";
VAL_ 261 Obj_02_LengthSTDV 0 "" 1 "";
VAL_ 261 Obj_02_HeightV 0 "" 1 "";
VAL_ 261 Obj_02_HeightSTDV 0 "" 1 "";
VAL_ 261 Obj_02_HeadingV 0 "" 1 "";
VAL_ 261 Obj_02_HeadingSTDV 0 "" 1 "";
VAL_ 261 Obj_02_AngleRateSTDV 0 "" 1 "";
VAL_ 261 Obj_02_AngleRateV 0 "" 1 "";
VAL_ 261 Obj_02_AngleRightV 0 "" 1 "";
VAL_ 261 Obj_02_AngleRightSTDV 0 "" 1 "";
VAL_ 261 Obj_02_AngleLeftV 0 "" 1 "";
VAL_ 261 Obj_02_AngleLeftSTDV 0 "" 1 "";
VAL_ 261 Obj_02_AngleSideV 0 "" 1 "";
VAL_ 261 Obj_02_AngleSideSTDV 0 "" 1 "";
VAL_ 261 Obj_02_AngleBottomV 0 "" 1 "";
VAL_ 261 Obj_02_AngleBottomSTDV 0 "" 1 "";
VAL_ 262 Obj_02_AbsLongVelocityV 0 "" 1 "";
VAL_ 262 Obj_02_AbsLongVelSTDV 0 "" 1 "";
VAL_ 262 Obj_02_AbsLatVelocityV 0 "" 1 "";
VAL_ 262 Obj_02_AbsLatVelSTDV 0 "" 1 "";
VAL_ 262 Obj_02_AbsLongAccV 0 "" 1 "";
VAL_ 262 Obj_02_AbsLongAccSTDV 0 "" 1 "";
VAL_ 262 Obj_02_AbsLatAccV 0 "" 1 "";
VAL_ 262 Obj_02_AbsLatAccSTDV 0 "" 1 "";
VAL_ 262 Obj_02_AbsAccelerationV 0 "" 1 "";
VAL_ 262 Obj_02_AbsAccSTDV 0 "" 1 "";
VAL_ 262 Obj_02_InvTTCV 0 "" 1 "";
VAL_ 262 Obj_02_InvTTCSTDV 0 "" 1 "";
VAL_ 262 Obj_02_RelativeLongAccV 0 "" 1 "";
VAL_ 262 Obj_02_RelLongAccSTDV 0 "" 1 "";
VAL_ 262 Obj_02_LongtRltvSpdV 0 "" 1 "";
VAL_ 262 Obj_02_LongtRltvSpdSTDV 0 "" 1 "";
VAL_ 262 Obj_02_RelativeLatVelocityV 0 "" 1 "";
VAL_ 262 Obj_02_RelLatVelSTDV 0 "" 1 "";
VAL_ 262 Obj_02_LongDistanceV 0 "" 1 "";
VAL_ 262 Obj_02_LongDistanceSTDV 0 "" 1 "";
VAL_ 262 Obj_02_LatDistanceV 0 "" 1 "";
VAL_ 262 Obj_02_LatDistanceSTDV 0 "" 1 "";
VAL_ 262 Obj_02_AbsoluteSpeedV 0 "" 1 "";
VAL_ 262 Obj_02_AbsoluteSpeedSTDV 0 "" 1 "";
VAL_ 263 Obj_03_MotionCategory 0 "" 1 "" 2 "" 3 "" 4 "" 5 "" 6 "" 7 "" 8 "" 9 "" 10 "" 11 "" 12 "" 13 "";
VAL_ 263 Obj_03_MeasSts 0 "" 1 "" 2 "" 3 "" 4 "" 5 "" 6 "" 7 "";
VAL_ 263 Obj_03_Typ 0 "" 1 "" 2 "" 3 "" 4 "" 5 "" 6 "" 7 "" 8 "";
VAL_ 263 Obj_03_MotionSts 0 "" 1 "" 2 "" 3 "" 4 "" 5 "";
VAL_ 263 Obj_03_MotionOrientation 0 "" 1 "" 3 "" 5 "" 6 "" 7 "" 9 "" 11 "" 12 "" 13 "";
VAL_ 263 Obj_03_BrakeLight 0 "" 1 "";
VAL_ 263 Obj_03_TurnIndicatorRight 0 "" 1 "";
VAL_ 263 Obj_03_TurnIndicatorLeft 0 "" 1 "";
VAL_ 263 Obj_03_LightIndicatorValidity 0 "" 1 "";
VAL_ 263 Obj_03_LaneAssignment 0 "" 1 "" 2 "" 3 "" 4 "" 5 "";
VAL_ 263 Obj_03_LaneAssignmentV 0 "" 1 "";
VAL_ 263 Obj_03_WidthV 0 "" 1 "";
VAL_ 263 Obj_03_WidthSTDV 0 "" 1 "";
VAL_ 263 Obj_03_LengthV 0 "" 1 "";
VAL_ 263 Obj_03_LengthSTDV 0 "" 1 "";
VAL_ 263 Obj_03_HeightV 0 "" 1 "";
VAL_ 263 Obj_03_HeightSTDV 0 "" 1 "";
VAL_ 263 Obj_03_HeadingV 0 "" 1 "";
VAL_ 263 Obj_03_HeadingSTDV 0 "" 1 "";
VAL_ 263 Obj_03_AngleRateSTDV 0 "" 1 "";
VAL_ 263 Obj_03_AngleRateV 0 "" 1 "";
VAL_ 263 Obj_03_AngleRightV 0 "" 1 "";
VAL_ 263 Obj_03_AngleRightSTDV 0 "" 1 "";
VAL_ 263 Obj_03_AngleLeftV 0 "" 1 "";
VAL_ 263 Obj_03_AngleLeftSTDV 0 "" 1 "";
VAL_ 263 Obj_03_AngleSideV 0 "" 1 "";
VAL_ 263 Obj_03_AngleSideSTDV 0 "" 1 "";
VAL_ 263 Obj_03_AngleBottomV 0 "" 1 "";
VAL_ 263 Obj_03_AngleBottomSTDV 0 "" 1 "";
SIG_VALTYPE_ 304 LAP_Vertical_Surface_C0 : 1;
SIG_VALTYPE_ 304 LAP_Vertical_Surface_C1 : 1;
SIG_VALTYPE_ 304 LAP_Vertical_Surface_C2 : 1;
SIG_VALTYPE_ 304 LAP_Vertical_Surface_C3 : 1;
SIG_VALTYPE_ 304 LAP_Path_Pred_First_C0 : 1;
SIG_VALTYPE_ 304 LAP_Path_Pred_First_C1 : 1;
SIG_VALTYPE_ 304 LAP_Path_Pred_First_C2 : 1;
SIG_VALTYPE_ 304 LAP_Path_Pred_First_C3 : 1;
SIG_VALTYPE_ 304 LAP_Path_Pred_Second_C0 : 1;
SIG_VALTYPE_ 304 LAP_Path_Pred_Second_C1 : 1;
SIG_VALTYPE_ 304 LAP_Path_Pred_Second_C2 : 1;
SIG_VALTYPE_ 304 LAP_Path_Pred_Second_C3 : 1;
SIG_GROUP_ 513 FDR_Object_0 1 :;
SIG_GROUP_ 514 FDR_Object_1 1 :;
SIG_GROUP_ 523 FDR_Object_10 1 :;
SIG_GROUP_ 524 FDR_Object_11 1 :;
SIG_GROUP_ 525 FDR_Object_12 1 :;
SIG_GROUP_ 526 FDR_Object_13 1 :;
SIG_GROUP_ 527 FDR_Object_14 1 :;
SIG_GROUP_ 528 FDR_Object_15 1 :;
SIG_GROUP_ 529 FDR_Object_16 1 :;
SIG_GROUP_ 530 FDR_Object_17 1 :;
SIG_GROUP_ 531 FDR_Object_18 1 :;
SIG_GROUP_ 532 FDR_Object_19 1 :;
SIG_GROUP_ 515 FDR_Object_2 1 :;
SIG_GROUP_ 533 FDR_Object_20 1 :;
SIG_GROUP_ 534 FDR_Object_21 1 :;
SIG_GROUP_ 535 FDR_Object_22 1 :;
SIG_GROUP_ 536 FDR_Object_23 1 :;
SIG_GROUP_ 537 FDR_Object_24 1 :;
SIG_GROUP_ 538 FDR_Object_25 1 :;
SIG_GROUP_ 539 FDR_Object_26 1 :;
SIG_GROUP_ 540 FDR_Object_27 1 :;
SIG_GROUP_ 541 FDR_Object_28 1 :;
SIG_GROUP_ 542 FDR_Object_29 1 :;
SIG_GROUP_ 516 FDR_Object_3 1 :;
SIG_GROUP_ 543 FDR_Object_30 1 :;
SIG_GROUP_ 544 FDR_Object_31 1 :;
SIG_GROUP_ 545 FDR_Object_32 1 :;
SIG_GROUP_ 546 FDR_Object_33 1 :;
SIG_GROUP_ 547 FDR_Object_34 1 :;
SIG_GROUP_ 548 FDR_Object_35 1 :;
SIG_GROUP_ 549 FDR_Object_36 1 :;
SIG_GROUP_ 550 FDR_Object_37 1 :;
SIG_GROUP_ 551 FDR_Object_38 1 :;
SIG_GROUP_ 552 FDR_Object_39 1 :;
SIG_GROUP_ 517 FDR_Object_4 1 :;
SIG_GROUP_ 518 FDR_Object_5 1 :;
SIG_GROUP_ 519 FDR_Object_6 1 :;
SIG_GROUP_ 520 FDR_Object_7 1 :;
SIG_GROUP_ 521 FDR_Object_8 1 :;
SIG_GROUP_ 522 FDR_Object_9 1 :;
SIG_GROUP_ 512 FDR_Object_Header 1 :;
SIG_GROUP_ 300 FVCM_FS 1 :;
SIG_GROUP_ 305 FVCM_LAP_A 1 :;
SIG_GROUP_ 306 FVCM_LAP_B 1 :;
SIG_GROUP_ 304 FVCM_LAP_General_Information 1 :;
SIG_GROUP_ 297 FVCM_Lane_A 1 :;
SIG_GROUP_ 298 FVCM_Lane_B 1 :;
SIG_GROUP_ 257 FVCM_Obj00_A 1 :;
SIG_GROUP_ 258 FVCM_Obj00_B 1 :;
SIG_GROUP_ 259 FVCM_Obj01_A 1 :;
SIG_GROUP_ 260 FVCM_Obj01_B 1 :;
SIG_GROUP_ 261 FVCM_Obj02_A 1 :;
SIG_GROUP_ 262 FVCM_Obj02_B 1 :;
SIG_GROUP_ 263 FVCM_Obj03_A 1 :;
